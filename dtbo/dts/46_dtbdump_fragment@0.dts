/dts-v1/;

/ {

	fragment@0 {
		target = <0xffffffff>;

		__overlay__ {
			compatible = "huawei,dev_detect";
			touch_panel = <0x00>;
			compass = <0x00>;
			g_sensor = <0x00>;
			camera_main = <0x00>;
			camera_slave = <0x00>;
			keypad = <0x00>;
			aps = <0x00>;
			gyroscope = <0x00>;
			nfc = <0x00>;
			dc_dc = <0x00>;
			speaker = <0x00>;
			ofn = <0x00>;
			tps = <0x00>;
			l_sensor = <0x00>;
			charge = <0x00>;
			battery = <0x00>;
			nct = <0x00>;
			mhl = <0x00>;
			audience = <0x00>;
			irda = <0x00>;
			hand_sensor = <0x00>;
			usb_switch = <0x00>;
			pmu_dcdc = <0x00>;
			camera_pmu = <0x00>;
			fm = <0x00>;
			wifi = <0x00>;
			bt = <0x00>;
			gps = <0x00>;
			gpu = <0x00>;
			cpu_chip = <0x00>;
			antenna_ctl = <0x00>;
			airpress = <0x00>;
			handpress = <0x00>;
			vibrator_lra = <0x00>;
			laser = <0x00>;
			camera_pmic = <0x00>;
			typec = <0x00>;
			anc_max14744 = <0x00>;
			charge_loadswitch = <0x00>;
			max77813 = <0x00>;
			coul = <0x00>;
			dtv = <0x00>;
			ap_color = <0x00>;
			status = "ok";
		};
	};

	fragment@1 {
		target = <0xffffffff>;

		__overlay__ {
			pinctrl-names = "default\0state_id0_default\0state_id0_bias_up\0state_id0_bias_down\0state_id1_default\0state_id1_bias_up\0state_id1_bias_down\0state_id2_default\0state_id2_bias_up\0state_id2_bias_down";
			pinctrl-0 = <0x01>;
			pinctrl-1 = <0x02>;
			pinctrl-2 = <0x03>;
			pinctrl-3 = <0x04>;
			pinctrl-4 = <0x05>;
			pinctrl-5 = <0x06>;
			pinctrl-6 = <0x07>;
			pinctrl-7 = <0x08>;
			pinctrl-8 = <0x09>;
			pinctrl-9 = <0x0a>;
			status = "ok";
		};
	};

	fragment@2 {
		target = <0xffffffff>;

		__overlay__ {

			ant_pins_all_default {
				phandle = <0x01>;
			};

			ant_pins_id0_default {
				phandle = <0x02>;

				pins_cmd_dat {
					pinmux = <0xb000>;
					slew-rate = <0x00>;
					bias-disable;
				};
			};

			ant_pins_id0_bias_up {
				phandle = <0x03>;

				pins_cmd_dat {
					pinmux = <0xb000>;
					slew-rate = <0x00>;
					bias-pull-up;
				};
			};

			ant_pins_id0_bias_down {
				phandle = <0x04>;

				pins_cmd_dat {
					pinmux = <0xb000>;
					slew-rate = <0x00>;
					bias-pull-down;
				};
			};

			ant_pins_id1_default {
				phandle = <0x05>;

				pins_cmd_dat {
					pinmux = <0xaf00>;
					slew-rate = <0x00>;
					bias-disable;
				};
			};

			ant_pins_id1_bias_up {
				phandle = <0x06>;

				pins_cmd_dat {
					pinmux = <0xaf00>;
					slew-rate = <0x00>;
					bias-pull-up;
				};
			};

			ant_pins_id1_bias_down {
				phandle = <0x07>;

				pins_cmd_dat {
					pinmux = <0xaf00>;
					slew-rate = <0x00>;
					bias-pull-down;
				};
			};

			ant_pins_id2_default {
				phandle = <0x08>;

				pins_cmd_dat {
					pinmux = <0xac00>;
					slew-rate = <0x00>;
					bias-disable;
				};
			};

			ant_pins_id2_bias_up {
				phandle = <0x09>;

				pins_cmd_dat {
					pinmux = <0xac00>;
					slew-rate = <0x00>;
					bias-pull-up;
				};
			};

			ant_pins_id2_bias_down {
				phandle = <0x0a>;

				pins_cmd_dat {
					pinmux = <0xac00>;
					slew-rate = <0x00>;
					bias-pull-down;
				};
			};
		};
	};

	fragment@3 {
		target = <0xffffffff>;

		__overlay__ {
			pinctrl-names = "default\0idle";
			pinctrl-0 = <0x0b>;
			pinctrl-1 = <0x0c>;
			gpio_count = <0x01>;
			debounce-interval = <0x0f>;
		};
	};

	fragment@4 {
		target = <0xffffffff>;

		__overlay__ {

			ant_cable_det_default {
				phandle = <0x0b>;

				pins_cmd_dat {
					pinmux = <0x200>;
					slew-rate = <0x00>;
					bias-disable;
				};
			};

			ant_cable_det_idle {
				phandle = <0x0c>;

				pins_cmd_dat {
					pinmux = <0x200>;
					slew-rate = <0x00>;
					bias-disable;
				};
			};
		};
	};

	fragment@5 {
		target = <0xffffffff>;

		__overlay__ {

			led@0 {
				compatible = "mediatek,red";
				max_brightness = <0x02>;
				led_mode = <0x00>;
				data = <0x01>;
				pwm_config = <0x00 0x00 0x00 0x00 0x00>;
				phandle = <0x34>;
			};

			led@1 {
				compatible = "mediatek,green";
				max_brightness = <0x02>;
				led_mode = <0x00>;
				data = <0x01>;
				pwm_config = <0x00 0x00 0x00 0x00 0x00>;
				phandle = <0x35>;
			};

			led@2 {
				compatible = "mediatek,blue";
				max_brightness = <0x02>;
				led_mode = <0x00>;
				data = <0x01>;
				pwm_config = <0x00 0x00 0x00 0x00 0x00>;
				phandle = <0x36>;
			};

			led@3 {
				compatible = "mediatek,jogball-backlight";
				led_mode = <0x00>;
				data = <0x01>;
				pwm_config = <0x00 0x00 0x00 0x00 0x00>;
				phandle = <0x37>;
			};

			led@4 {
				compatible = "mediatek,keyboard-backlight";
				led_mode = <0x00>;
				data = <0x01>;
				pwm_config = <0x00 0x00 0x00 0x00 0x00>;
				phandle = <0x38>;
			};

			led@5 {
				compatible = "mediatek,button-backlight";
				led_mode = <0x00>;
				data = <0x01>;
				pwm_config = <0x00 0x00 0x00 0x00 0x00>;
				phandle = <0x39>;
			};

			led@6 {
				compatible = "mediatek,lcd-backlight";
				led_mode = <0x04>;
				data = <0x01>;
				pwm_config = <0x00 0x03 0x00 0x00 0x00>;
				phandle = <0x3a>;
			};

			vibrator@0 {
				compatible = "mediatek,vibrator";
				vib_timer = <0x19>;
				vib_limit = <0x09>;
				vib_vol = <0x0b>;
				vib_vol_cal = <0x0a>;
				phandle = <0x3b>;
			};
		};
	};

	fragment@6 {
		target = <0xffffffff>;

		__overlay__ {

			bled {
				mt,max_bled_brightness = <0x555>;
			};

			dsv {
				db_vbst_del;
				db_delay_del;
			};
		};
	};

	fragment@7 {
		target = <0xffffffff>;

		__overlay__ {

			eint@0 {
				phandle = <0x0d>;

				pins_cmd_dat {
					pinmux = <0x00>;
					slew-rate = <0x00>;
					bias-disable;
				};
			};

			eintoutput0 {
				phandle = <0x0e>;

				pins_cmd_dat {
					pinmux = <0x00>;
					slew-rate = <0x01>;
					output-low;
				};
			};

			eintoutput1 {
				phandle = <0x0f>;

				pins_cmd_dat {
					pinmux = <0x00>;
					slew-rate = <0x01>;
					output-high;
				};
			};

			rstoutput0 {
				phandle = <0x10>;

				pins_cmd_dat {
					pinmux = <0xae00>;
					slew-rate = <0x01>;
					output-low;
				};
			};

			rstoutput1 {
				phandle = <0x11>;

				pins_cmd_dat {
					pinmux = <0xae00>;
					slew-rate = <0x01>;
					output-high;
				};
			};
		};
	};

	fragment@8 {
		target = <0xffffffff>;

		__overlay__ {
			status = "okay";
			compatible = "huawei,ts_kit";
			bus_type = "i2c";
			product = "durahms";
			bus_id = <0x00>;
			has_virtualkey = <0x00>;
			debounce = <0x06 0x00>;
			interrupt-parent = <0xffffffff>;
			interrupts = <0x00 0x02 0x00 0x00>;
			aft_enable = <0x00>;
			drv_stop_width = <0x00>;
			lcd_width = <0x00>;
			lcd_height = <0x00>;
			need_i2c_hwlock = <0x00>;
			register_charger_notifier = <0x00>;
			hide_plain_id = <0x01>;

			touchscreen@38 {
				compatible = "fts";
				slave_address = <0x38>;
				irq_config = <0x03>;
				projectid_len = <0x0a>;
				ic_type = <0x02>;
				x_max = <0x2d0>;
				y_max = <0x5a0>;
				x_max_mt = <0x2d0>;
				y_max_mt = <0x5a0>;
				flip_x = <0x01>;
				flip_y = <0x01>;
				pinctrl-names = "state_eint_as_int\0state_eint_output0\0state_eint_output1\0state_rst_output0\0state_rst_output1";
				pinctrl-0 = <0x0d>;
				pinctrl-1 = <0x0e>;
				pinctrl-2 = <0x0f>;
				pinctrl-3 = <0x10>;
				pinctrl-4 = <0x11>;
				parade,is_parade_solution = <0x00>;
				parade,direct_proc_cmd = <0x00>;
				parade,sleep_in_mode = <0x00>;
				roi_supported = <0x01>;
				roi_control_addr = <0x9b>;
				glove_supported = <0x00>;
				holster_supported = <0x00>;
				pen_support = <0x00>;
				support_3d_func = <0x00>;
				charger_supported = <0x01>;
				check_bulcked = <0x00>;
				support_aft = <0x00>;
				use_lcdkit_power_notify = <0x01>;
				fp_tp_report_touch_minor_event = <0x00>;
				algo_id = <0x01>;
				need_wd_check_status = <0x01>;
				check_status_watchdog_timeout = <0xbb8>;
				touch_switch_flag = <0x02>;
				get_brightness_info_flag = <0x00>;
				has_virtualkey = <0x00>;
				lcd_full = <0x00>;
				provide_panel_id_support = <0x01>;
				chip_id = <0x54>;
				hard_reset_delay = <0xc8>;
				erase_min_delay = <0x546>;
				calc_crc_delay = <0x12c>;
				reboot_delay = <0x12c>;
				erase_query_delay = <0x32>;
				write_flash_query_times = <0x1e>;
				read_ecc_query_times = <0x64>;
				erase_flash_query_times = <0x64>;
				upgrade_loop_times = <0x05>;
				pram_projectid_addr = <0xd7a0>;
				rawdata_newformatflag = <0x01>;
				fts,fw_only_depend_on_lcd = <0x00>;
				fts,need_distinguish_lcd = <0x00>;
				only_open_once_captest_threshold = <0x01>;
				allow_print_fw_version = <0x01>;
				allow_refresh_ic_type = <0x01>;
				phandle = <0x3c>;

				dura532600 {
					producer = "hlt";
					compatible = "fts-dura532600";
					row_column_delta_test = <0x00>;
					lcd_noise_data_test = <0x01>;
					threshold,point_by_point_judge = <0x01>;
					row_column_delta_test_point_by_point = <0x01>;
					threshold,in_csv_file = <0x01>;
				};

				dura442600 {
					producer = "hlt";
					compatible = "fts-dura442600";
					row_column_delta_test = <0x00>;
					lcd_noise_data_test = <0x01>;
					threshold,point_by_point_judge = <0x01>;
					row_column_delta_test_point_by_point = <0x01>;
					threshold,in_csv_file = <0x01>;
				};

				dura440200 {
					producer = "truly";
					compatible = "fts-dura440200";
					row_column_delta_test = <0x00>;
					lcd_noise_data_test = <0x01>;
					threshold,point_by_point_judge = <0x01>;
					row_column_delta_test_point_by_point = <0x01>;
					threshold,in_csv_file = <0x01>;
				};

				dura440201 {
					producer = "truly";
					compatible = "fts-dura440201";
					row_column_delta_test = <0x00>;
					lcd_noise_data_test = <0x01>;
					threshold,point_by_point_judge = <0x01>;
					row_column_delta_test_point_by_point = <0x01>;
					threshold,in_csv_file = <0x01>;
				};
			};

			mstar_ts@26 {
				compatible = "mstar";
				ic_type = <0xbf>;
				algo_id = <0x01>;
				slave_address = <0x26>;
				need_wd_check_status = <0x01>;
				check_status_watchdog_timeout = <0xbb8>;
				mstar_irq_config = <0x03>;
				x_max = <0x2d0>;
				y_max = <0x5a0>;
				x_max_mt = <0x2d0>;
				y_max_mt = <0x5a0>;
				power_self_ctrl = <0x00>;
				pinctrl-names = "state_eint_as_int\0state_eint_output0\0state_eint_output1\0state_rst_output0\0state_rst_output1";
				pinctrl-0 = <0x0d>;
				pinctrl-1 = <0x0e>;
				pinctrl-2 = <0x0f>;
				pinctrl-3 = <0x10>;
				pinctrl-4 = <0x11>;
				roi_supported = <0x01>;
				unite_cap_test_interface = <0x01>;
				report_rate_test = <0x00>;
				fw_upgrade_delay = <0x2710>;
				capacitance_test_config = <0x01>;
				chip_id = <0xbf>;
				write_flash_query_times = <0x1e>;
				read_ecc_query_times = <0x64>;
				erase_flash_query_times = <0x0f>;
				upgrade_loop_times = <0x05>;
				glove_switch_addr = <0xc0>;
				mstar_mp_flow = <0x02>;
				mstar_mp_retry = <0x03>;
				rawdata_timeout = <0x0a>;
				mstar,product_id = "MSG2836A";
				mstar,test-types = <0x80007>;
				mstar,panel-max = <0x800>;
				mstar,panel-min = <0x800>;
				mstar,panel-deviation = <0xabe0>;
				mstar,key-max = <0x00>;
				mstar,key-min = <0x00>;
				mstar,key-nc = <0x00>;
				support_get_tp_color = <0x00>;
				gesture_supported = <0x00>;

				dura292600_hjc {
					producer = "hlt";
					compatible = "mstar-dura292600";
				};

				dura292601_boe {
					producer = "hlt";
					compatible = "mstar-dura292601";
				};
			};
		};
	};

	fragment@9 {
		target = <0xffffffff>;

		__overlay__ {

			eta6937@6A {
				status = "okay";
				compatible = "eta,eta6937";
				reg = <0x6a>;
				ti,eta6937,enable-term;
				ti,eta6937,current-sensor-mohm = <0x44>;
				ti,eta6937,charge-voltage = <0x1130>;
				ti,eta6937,charge-current = <0x1f4>;
				ti,eta6937,input-current-limit = <0x1f4>;
				ti,eta6937,input-voltage-limit = <0x1194>;
				ti,eta6937,vbatlow-volt = <0xdac>;
				ti,eta6937,term-current = <0x96>;
				ti,eta6937,safety-max-charge-current = <0x4e2>;
				ti,eta6937,safety-max-charge-voltage = <0x1130>;
			};
		};
	};

	fragment@10 {
		target = <0xffffffff>;

		__overlay__ {
			ac_charger_current = <0x1312d0>;
			ac_charger_input_current = <0x1312d0>;
			non_std_ac_charger_current = <0x124f80>;
			dpm_enable;
			power_path_disable;
			jeita_ibus_limit_en;
			battery_cv = <0x42d560>;
			iterm = <0x249f0>;
			jeita_temp_t3_to_t4_cur = <0xcf850>;
			jeita_temp_t2_to_t3_cur = <0x1312d0>;
			jeita_temp_t1_to_t2_cur = <0xd5de0>;
			jeita_temp_t0_to_t1_cur = <0x7a120>;
			vdpm_buf_limit = <0x64>;
			vdpm_para = "-32767\04000\04200\050\04000\04200\04400\050\04200\032767\04600\050";
			charge_full_design = <0x2e14e0>;
		};
	};

	fragment@11 {
		target = <0xffffffff>;

		__overlay__ {
			compatible = "huawei,charger";
			status = "okay";
		};
	};

	fragment@12 {
		target = <0xffffffff>;

		__overlay__ {
			compatible = "huawei,battery";
			voltage_max_design = <0x432380>;
			status = "okay";
		};
	};

	fragment@13 {
		target = <0xffffffff>;

		__overlay__ {
			ac_charger_current = <0x100590>;
			ac_charger_input_current = <0x100590>;
			non_std_ac_charger_current = <0x100590>;
			power_path_disable;
			r_charger_1 = <0x12c>;
		};
	};

	fragment@14 {
		target = <0xffffffff>;

		__overlay__ {

			charger {
				status = "disabled";
			};
		};
	};

	fragment@15 {
		target = <0xffffffff>;

		__overlay__ {
			interrupt-parent = <0xffffffff>;
			interrupts = <0x29 0x08 0x29 0x00>;
			otg_bigcurr_disable;
			status = "okay";
		};
	};

	fragment@16 {
		target = <0xffffffff>;

		__overlay__ {
			bat_para = "xinwangda\0590000\0690000\0desay\0250000\0350000\0feimaotui\0400000\0510000";
			batt_id_channel = <0x04>;
			min_fcc = <0x200b20>;
			max_fcc = <0x2e14e0>;
			rbat_pull_up_r = <0x4204>;
			vbus_r_charger_1 = <0x12c>;
			dlpt_optimization;
			batt_temperature_table_num = <0x15>;
			batt_temperature_table = <0xffffffd8 0x32190 0xffffffdd 0x25cb0 0xffffffe2 0x1cc8c 0xffffffe7 0x16242 0xffffffec 0x112e2 0xfffffff1 0xd71e 0xfffffff6 0xa9b0 0xfffffffb 0x86e2 0x00 0x6bf8 0x05 0x56fe 0x0a 0x468c 0x0f 0x3994 0x14 0x2f4e 0x19 0x2710 0x1e 0x2075 0x23 0x1b1d 0x28 0x16c4 0x2d 0x1334 0x32 0x1045 0x37 0xdd7 0x3c 0xbd3>;
			battery0_profile_t0_num = <0x64>;
			battery0_profile_t0 = <0x00 0xaae6 0x44c 0x138 0xaa4a 0x44c 0x271 0xa9b9 0x44c 0x3a9 0xa930 0x44c 0x4e1 0xa8ac 0x44c 0x61a 0xa82f 0x44c 0x752 0xa7b2 0x44c 0x88a 0xa73a 0x458 0x9c3 0xa6c3 0x465 0xafb 0xa646 0x466 0xc33 0xa5d1 0x479 0xd6c 0xa556 0x46f 0xea4 0xa4dd 0x465 0xfdc 0xa467 0x469 0x1115 0xa3f2 0x47c 0x124d 0xa37d 0x47e 0x1385 0xa308 0x47e 0x14bd 0xa293 0x47e 0x15f6 0xa21e 0x47f 0x172e 0xa1b1 0x493 0x1866 0xa144 0x4a6 0x199f 0xa0d6 0x4b0 0x1ad7 0xa069 0x4b0 0x1c0f 0x9ffc 0x4b0 0x1d48 0x9f8e 0x4b0 0x1e80 0x9f26 0x4bd 0x1fb8 0x9ec1 0x4c9 0x20f1 0x9e5b 0x4c9 0x2229 0x9df6 0x4c9 0x2361 0x9d95 0x4d9 0x249a 0x9d36 0x4ed 0x25d2 0x9cd8 0x4fb 0x270a 0x9c7b 0x4fb 0x2843 0x9c25 0x50f 0x297b 0x9bcf 0x522 0x2ab3 0x9b79 0x52d 0x2bec 0x9b23 0x52d 0x2d24 0x9acd 0x52d 0x2e5c 0x9a77 0x53e 0x2f95 0x9a22 0x546 0x30cd 0x99c7 0x540 0x3205 0x9961 0x52b 0x333e 0x98f3 0x504 0x3476 0x9880 0x4ce 0x35ae 0x9813 0x4a6 0x36e7 0x97b2 0x493 0x381f 0x9764 0x47f 0x3957 0x971d 0x47e 0x3a90 0x96dc 0x47e 0x3bc8 0x969d 0x47e 0x3d00 0x965f 0x47e 0x3e38 0x9629 0x47e 0x3f71 0x95f8 0x48e 0x40a9 0x95c5 0x48d 0x41e1 0x9593 0x483 0x431a 0x956c 0x496 0x4452 0x953d 0x497 0x458a 0x9513 0x4a4 0x46c3 0x94ec 0x4b0 0x47fb 0x94c5 0x4b2 0x4933 0x949e 0x4c6 0x4a6c 0x9477 0x4b9 0x4ba4 0x9455 0x4bb 0x4cdc 0x9435 0x4ce 0x4e15 0x9416 0x4e2 0x4f4d 0x93f7 0x4f5 0x5085 0x93d8 0x4fb 0x51be 0x93b8 0x503 0x52f6 0x9398 0x514 0x542e 0x9371 0x514 0x5567 0x9328 0x4d0 0x569f 0x92da 0x4a4 0x57d7 0x9293 0x49d 0x5910 0x925d 0x4b1 0x5a48 0x922e 0x4c4 0x5b80 0x91f9 0x4ba 0x5cb9 0x91ca 0x4b9 0x5df1 0x91a3 0x4c9 0x5f29 0x917c 0x4c9 0x6062 0x9155 0x4c9 0x619a 0x912e 0x4c9 0x62d2 0x9101 0x4d0 0x640b 0x90ca 0x4e1 0x6543 0x908b 0x4cd 0x667b 0x904d 0x4c9 0x67b3 0x900b 0x4c9 0x68ec 0x8fc3 0x4c9 0x6a24 0x8f74 0x4c9 0x6b5c 0x8f3b 0x4c9 0x6c95 0x8f14 0x4d7 0x6dcd 0x8eef 0x4ea 0x6f05 0x8ebe 0x500 0x703e 0x8e7f 0x527 0x7176 0x8e0c 0x54e 0x72ae 0x8d16 0x554 0x73e7 0x8b95 0x557 0x751f 0x8997 0x592 0x7657 0x86d8 0x5e0 0x7790 0x8309 0x6ae 0x78c8 0x7f12 0x52d>;
			battery0_profile_t1_num = <0x64>;
			battery0_profile_t1 = <0x00 0xaa50 0x62c 0x138 0xa9ac 0x628 0x271 0xa924 0x643 0x3a9 0xa8a4 0x659 0x4e1 0xa820 0x659 0x61a 0xa7a3 0x659 0x752 0xa72d 0x66a 0x88a 0xa6b3 0x672 0x9c3 0xa639 0x678 0xafb 0xa5c4 0x68b 0xc33 0xa547 0x68b 0xd6c 0xa4d0 0x69a 0xea4 0xa45b 0x6a4 0xfdc 0xa3e5 0x6a8 0x1115 0xa370 0x6bb 0x124d 0xa2fb 0x6bd 0x1385 0xa286 0x6c9 0x14bd 0xa214 0x6dd 0x15f6 0xa1a6 0x6ee 0x172e 0xa131 0x6da 0x1866 0xa0c2 0x6e5 0x199f 0xa054 0x6f9 0x1ad7 0x9fe9 0x708 0x1c0f 0x9f83 0x708 0x1d48 0x9f1e 0x72d 0x1e80 0x9eb8 0x73a 0x1fb8 0x9e53 0x742 0x20f1 0x9dee 0x755 0x2229 0x9d90 0x769 0x2361 0x9d31 0x76c 0x249a 0x9cd2 0x76c 0x25d2 0x9c77 0x772 0x270a 0x9c21 0x785 0x2843 0x9bc3 0x785 0x297b 0x9b6b 0x793 0x2ab3 0x9b15 0x79e 0x2bec 0x9abe 0x79e 0x2d24 0x9a60 0x79e 0x2e5c 0x99fc 0x77b 0x2f95 0x9996 0x760 0x30cd 0x992e 0x740 0x3205 0x98c1 0x706 0x333e 0x985c 0x6df 0x3476 0x97fc 0x6b8 0x35ae 0x97a6 0x69a 0x36e7 0x9758 0x68b 0x381f 0x970a 0x68b 0x3957 0x96ca 0x68b 0x3a90 0x9691 0x68b 0x3bc8 0x965a 0x68b 0x3d00 0x9623 0x68b 0x3e38 0x95ed 0x68b 0x3f71 0x95bc 0x69b 0x40a9 0x958e 0x6a4 0x41e1 0x955f 0x6a4 0x431a 0x9530 0x6a4 0x4452 0x9508 0x6b7 0x458a 0x94e1 0x6bd 0x46c3 0x94be 0x6c5 0x47fb 0x949e 0x6d8 0x4933 0x947f 0x6ec 0x4a6c 0x9460 0x6ff 0x4ba4 0x9441 0x713 0x4cdc 0x9421 0x721 0x4e15 0x9402 0x721 0x4f4d 0x93e3 0x721 0x5085 0x93c4 0x721 0x51be 0x93a4 0x721 0x52f6 0x9385 0x721 0x542e 0x9366 0x721 0x5567 0x9339 0x710 0x569f 0x930a 0x6fc 0x57d7 0x92db 0x6ef 0x5910 0x92ad 0x6ef 0x5a48 0x927e 0x6ef 0x5b80 0x9255 0x6fe 0x5cb9 0x922e 0x708 0x5df1 0x9207 0x708 0x5f29 0x91e0 0x708 0x6062 0x91b9 0x71a 0x619a 0x9188 0x72d 0x62d2 0x914e 0x73a 0x640b 0x9110 0x73b 0x6543 0x90d1 0x74f 0x667b 0x908d 0x753 0x67b3 0x903f 0x753 0x68ec 0x8fec 0x753 0x6a24 0x8fa6 0x753 0x6b5c 0x8f7c 0x78c 0x6c95 0x8f4f 0x7c7 0x6dcd 0x8f1a 0x811 0x6f05 0x8ed6 0x878 0x703e 0x8e68 0x901 0x7176 0x8d76 0x947 0x72ae 0x8be7 0x9a3 0x73e7 0x89ba 0xa51 0x751f 0x8700 0xb8b 0x7657 0x82ec 0xd76 0x7790 0x805c 0x866 0x78c8 0x805c 0x866>;
			battery0_profile_t2_num = <0x64>;
			battery0_profile_t2 = <0x00 0xa97e 0x94c 0x138 0xa8c3 0x948 0x271 0xa823 0x971 0x3a9 0xa796 0x99b 0x4e1 0xa711 0x9ae 0x61a 0xa68c 0x9c2 0x752 0xa60e 0x9e6 0x88a 0xa596 0xa0d 0x9c3 0xa51f 0xa28 0xafb 0xa4a2 0xa29 0xc33 0xa425 0xa3c 0xd6c 0xa3ae 0xa50 0xea4 0xa339 0xa63 0xfdc 0xa2c3 0xa77 0x1115 0xa24e 0xa8a 0x124d 0xa1d9 0xa9e 0x1385 0xa169 0xab1 0x14bd 0xa0fc 0xac5 0x15f6 0xa08e 0xad8 0x172e 0xa021 0xaec 0x1866 0x9fb4 0xaf0 0x199f 0x9f46 0xaf0 0x1ad7 0x9edb 0xaf9 0x1c0f 0x9e75 0xb20 0x1d48 0x9e17 0xb34 0x1e80 0x9db4 0xb3b 0x1fb8 0x9d52 0xb43 0x20f1 0x9cf4 0xb56 0x2229 0x9c96 0xb6a 0x2361 0x9c37 0xb6d 0x249a 0x9bd8 0xb78 0x25d2 0x9b7d 0xb86 0x270a 0x9b27 0xb86 0x2843 0x9ac9 0xb86 0x297b 0x9a6b 0xb78 0x2ab3 0x9a0a 0xb5b 0x2bec 0x99a5 0xb34 0x2d24 0x993f 0xb0d 0x2e5c 0x98d3 0xae6 0x2f95 0x986a 0xabf 0x30cd 0x9807 0xa98 0x3205 0x97aa 0xa74 0x333e 0x975c 0xa87 0x3476 0x9714 0xa8c 0x35ae 0x96ce 0xa8c 0x36e7 0x968b 0xa90 0x381f 0x9654 0xaa4 0x3957 0x961d 0xab7 0x3a90 0x95e7 0xabe 0x3bc8 0x95b3 0xac5 0x3d00 0x9584 0xad7 0x3e38 0x9555 0xad7 0x3f71 0x952d 0xaf6 0x40a9 0x9506 0xb13 0x41e1 0x94df 0xb27 0x431a 0x94b8 0xb3a 0x4452 0x9490 0xb3b 0x458a 0x946f 0xb56 0x46c3 0x9450 0xb75 0x47fb 0x942f 0xb86 0x4933 0x9408 0xb86 0x4a6c 0x93ee 0xb96 0x4ba4 0x93d7 0xbc0 0x4cdc 0x93bd 0xbea 0x4e15 0x939e 0xbea 0x4f4d 0x9387 0xbea 0x5085 0x936f 0xbf8 0x51be 0x9354 0xc0b 0x52f6 0x9335 0xc19 0x542e 0x9316 0xc05 0x5567 0x92f0 0xc14 0x569f 0x92c4 0xc1c 0x57d7 0x9295 0xc1c 0x5910 0x9267 0xc1d 0x5a48 0x9240 0xc30 0x5b80 0x9219 0xc52 0x5cb9 0x91ea 0xc79 0x5df1 0x91b2 0xca0 0x5f29 0x9174 0xcc7 0x6062 0x912e 0xcdd 0x619a 0x90ed 0xd15 0x62d2 0x90a9 0xd71 0x640b 0x9059 0xde1 0x6543 0x8ff4 0xe08 0x667b 0x8f9b 0xe7b 0x67b3 0x8f51 0xf21 0x68ec 0x8f12 0x1003 0x6a24 0x8ed4 0x114f 0x6b5c 0x8e85 0x1327 0x6c95 0x8e10 0x1594 0x6dcd 0x8d41 0x18c0 0x6f05 0x8bec 0x1cb8 0x703e 0x89d5 0x2014 0x7176 0x874c 0x19eb 0x72ae 0x8520 0x1469 0x73e7 0x8520 0x1469 0x751f 0x8520 0x1469 0x7657 0x8520 0x1469 0x7790 0x8520 0x1469 0x78c8 0x8520 0x1469>;
			battery0_profile_t3_num = <0x64>;
			battery0_profile_t3 = <0x00 0xa83e 0xec4 0x138 0xa754 0xec0 0x271 0xa69c 0xf21 0x3a9 0xa5ff 0xf88 0x4e1 0xa56d 0xfc2 0x61a 0xa4e8 0xffd 0x752 0xa464 0x1037 0x88a 0xa3e3 0x1072 0x9c3 0xa367 0x10a0 0xafb 0xa2ea 0x10b4 0xc33 0xa275 0x10c7 0xd6c 0xa200 0x10e9 0xea4 0xa18b 0x1110 0xfdc 0xa115 0x1130 0x1115 0xa0a0 0x1130 0x124d 0xa032 0x1154 0x1385 0x9fc5 0x117b 0x14bd 0x9f5a 0x11a2 0x15f6 0x9ef4 0x11c6 0x172e 0x9e87 0x11c6 0x1866 0x9e20 0x11d5 0x199f 0x9dba 0x11e9 0x1ad7 0x9d55 0x1201 0x1c0f 0x9cef 0x1228 0x1d48 0x9c8a 0x123c 0x1e80 0x9c2f 0x1250 0x1fb8 0x9bd6 0x1264 0x20f1 0x9b77 0x1275 0x2229 0x9b12 0x1275 0x2361 0x9ab1 0x1265 0x249a 0x9a52 0x1267 0x25d2 0x99f0 0x1264 0x270a 0x9983 0x122a 0x2843 0x991d 0x122a 0x297b 0x98b8 0x120d 0x2ab3 0x9852 0x11f8 0x2bec 0x97ef 0x11fb 0x2d24 0x9799 0x120f 0x2e5c 0x974a 0x1211 0x2f95 0x96fc 0x1211 0x30cd 0x96b3 0x1224 0x3205 0x9675 0x125d 0x333e 0x9636 0x1270 0x3476 0x95fe 0x1275 0x35ae 0x95c7 0x129b 0x36e7 0x9592 0x12dd 0x381f 0x9563 0x12f1 0x3957 0x9535 0x1316 0x3a90 0x9506 0x133d 0x3bc8 0x94da 0x135d 0x3d00 0x94b3 0x1374 0x3e38 0x948c 0x13ae 0x3f71 0x9465 0x13ba 0x40a9 0x9442 0x13e3 0x41e1 0x9422 0x141e 0x431a 0x9403 0x141e 0x4452 0x93e4 0x1456 0x458a 0x93ca 0x1484 0x46c3 0x93b3 0x14a3 0x47fb 0x939b 0x14bd 0x4933 0x9384 0x150b 0x4a6c 0x936c 0x1528 0x4ba4 0x9359 0x1552 0x4cdc 0x9348 0x1592 0x4e15 0x9330 0x15e0 0x4f4d 0x9311 0x1607 0x5085 0x92ec 0x1612 0x51be 0x92c2 0x162b 0x52f6 0x9294 0x166f 0x542e 0x926d 0x16e4 0x5567 0x923f 0x1748 0x569f 0x920c 0x17aa 0x57d7 0x91d3 0x1811 0x5910 0x9194 0x1888 0x5a48 0x914e 0x1938 0x5b80 0x9101 0x1a14 0x5cb9 0x90b3 0x1b10 0x5df1 0x9062 0x1c2d 0x5f29 0x9005 0x1d78 0x6062 0x8f99 0x1f0b 0x619a 0x8f30 0x211f 0x62d2 0x8ed0 0x23db 0x640b 0x8e7b 0x2750 0x6543 0x8e2f 0x2b10 0x667b 0x8dee 0x2a6b 0x67b3 0x8da2 0x29ac 0x68ec 0x8d29 0x288b 0x6a24 0x8c43 0x2640 0x6b5c 0x8bba 0x24d1 0x6c95 0x8bba 0x24d1 0x6dcd 0x8bba 0x24d1 0x6f05 0x8bba 0x24d1 0x703e 0x8bba 0x24d1 0x7176 0x8bba 0x24d1 0x72ae 0x8bba 0x24d1 0x73e7 0x8bba 0x24d1 0x751f 0x8bba 0x24d1 0x7657 0x8bba 0x24d1 0x7790 0x8bba 0x24d1 0x78c8 0x8bba 0x24d1>;
			battery0_profile_t4_num = <0x64>;
			battery0_profile_t4 = <0x00 0xa564 0x1b12 0x138 0xa42c 0x1b0e 0x271 0xa348 0x1c26 0x3a9 0xa296 0x1d4e 0x4e1 0xa1fc 0x1dfb 0x61a 0xa16f 0x1e97 0x752 0xa0f0 0x1eee 0x88a 0xa06f 0x1f25 0x9c3 0x9fef 0x1f5f 0xafb 0x9f7a 0x1fc0 0xc33 0x9f0d 0x2022 0xd6c 0x9e9a 0x203a 0xea4 0x9e25 0x2056 0xfdc 0x9db1 0x2090 0x1115 0x9d44 0x20cb 0x124d 0x9cd6 0x2117 0x1385 0x9c6e 0x2165 0x14bd 0x9c08 0x2191 0x15f6 0x9ba3 0x2184 0x172e 0x9b3d 0x21d3 0x1866 0x9ad8 0x21d4 0x199f 0x9a76 0x21d4 0x1ad7 0x9a17 0x21f5 0x1c0f 0x99b1 0x2243 0x1d48 0x994c 0x2235 0x1e80 0x98e6 0x222e 0x1fb8 0x9884 0x222e 0x20f1 0x9826 0x2230 0x2229 0x97c8 0x2244 0x2361 0x9771 0x2267 0x249a 0x971b 0x2284 0x25d2 0x96ca 0x22b1 0x270a 0x9683 0x2326 0x2843 0x963d 0x234e 0x297b 0x95fc 0x2375 0x2ab3 0x95c1 0x239c 0x2bec 0x958a 0x23c3 0x2d24 0x9554 0x23ea 0x2e5c 0x9524 0x2433 0x2f95 0x94f5 0x248c 0x30cd 0x94c8 0x24d1 0x3205 0x94a1 0x24d3 0x333e 0x947a 0x2548 0x3476 0x9459 0x2584 0x35ae 0x9436 0x25b4 0x36e7 0x9412 0x25f8 0x381f 0x93fa 0x266e 0x3957 0x93dc 0x269d 0x3a90 0x93c2 0x26c4 0x3bc8 0x93aa 0x2717 0x3d00 0x9394 0x27bf 0x3e38 0x937c 0x27d3 0x3f71 0x9365 0x2812 0x40a9 0x934a 0x2869 0x41e1 0x932c 0x28d8 0x431a 0x9314 0x2988 0x4452 0x92f6 0x2a03 0x458a 0x92d2 0x2a9c 0x46c3 0x92ab 0x2b52 0x47fb 0x9283 0x2c17 0x4933 0x9255 0x2ced 0x4a6c 0x9226 0x2e01 0x4ba4 0x91ef 0x2f12 0x4cdc 0x91b1 0x3021 0x4e15 0x9172 0x316c 0x4f4d 0x9139 0x325f 0x5085 0x9105 0x3211 0x51be 0x90c8 0x3175 0x52f6 0x908f 0x30e9 0x542e 0x904e 0x3045 0x5567 0x900a 0x2fa1 0x569f 0x8fbb 0x2eed 0x57d7 0x8f65 0x2e08 0x5910 0x8f14 0x2d70 0x5a48 0x8f0c 0x2d37 0x5b80 0x8f0c 0x2d37 0x5cb9 0x8f0c 0x2d37 0x5df1 0x8f0c 0x2d37 0x5f29 0x8f0c 0x2d37 0x6062 0x8f0c 0x2d37 0x619a 0x8f0c 0x2d37 0x62d2 0x8f0c 0x2d37 0x640b 0x8f0c 0x2d37 0x6543 0x8f0c 0x2d37 0x667b 0x8f0c 0x2d37 0x67b3 0x8f0c 0x2d37 0x68ec 0x8f0c 0x2d37 0x6a24 0x8f0c 0x2d37 0x6b5c 0x8f0c 0x2d37 0x6c95 0x8f0c 0x2d37 0x6dcd 0x8f0c 0x2d37 0x6f05 0x8f0c 0x2d37 0x703e 0x8f0c 0x2d37 0x7176 0x8f0c 0x2d37 0x72ae 0x8f0c 0x2d37 0x73e7 0x8f0c 0x2d37 0x751f 0x8f0c 0x2d37 0x7657 0x8f0c 0x2d37 0x7790 0x8f0c 0x2d37 0x78c8 0x8f0c 0x2d37>;
			battery1_profile_t0_num = <0x64>;
			battery1_profile_t0 = <0x00 0xaadc 0x3d4 0x12e 0xaa54 0x3d0 0x25c 0xa9d1 0x3cf 0x38a 0xa956 0x3cf 0x4b8 0xa8e5 0x3cf 0x5e6 0xa864 0x3bc 0x714 0xa7e9 0x3b6 0x841 0xa773 0x3bd 0x96f 0xa702 0x3cf 0xa9d 0xa689 0x3cf 0xbcb 0xa610 0x3cf 0xcf9 0xa59b 0x3d7 0xe27 0xa529 0x3e7 0xf55 0xa4b0 0x3d4 0x1083 0xa43d 0x3dd 0x11b1 0xa3c8 0x3e8 0x12df 0xa350 0x3ea 0x140d 0xa2df 0x3fd 0x153b 0xa26e 0x401 0x1668 0xa1fd 0x401 0x1796 0xa18c 0x401 0x18c4 0xa11a 0x401 0x19f2 0xa0af 0x410 0x1b20 0xa046 0x41a 0x1c4e 0x9fdc 0x41d 0x1d7c 0x9f72 0x430 0x1eaa 0x9f0f 0x443 0x1fd8 0x9ea9 0x44c 0x2106 0x9e42 0x44f 0x2234 0x9de7 0x462 0x2362 0x9d84 0x476 0x248f 0x9d21 0x47e 0x25bd 0x9cc1 0x482 0x26eb 0x9c66 0x495 0x2819 0x9c12 0x4a8 0x2947 0x9bbb 0x4b0 0x2a75 0x9b62 0x4b5 0x2ba3 0x9b0f 0x4c8 0x2cd1 0x9abc 0x4db 0x2dff 0x9a6e 0x505 0x2f2d 0x9a1a 0x522 0x305b 0x99b0 0x4fc 0x3189 0x9929 0x4a0 0x32b7 0x98a6 0x44e 0x33e4 0x982f 0x40e 0x3512 0x97cd 0x3e8 0x3640 0x9781 0x3d5 0x376e 0x973b 0x3cf 0x389c 0x96fa 0x3cf 0x39ca 0x96bd 0x3cf 0x3af8 0x9681 0x3cf 0x3c26 0x964a 0x3cf 0x3d54 0x9618 0x3d6 0x3e82 0x95ea 0x3e8 0x3fb0 0x95b5 0x3e8 0x40de 0x9586 0x3e8 0x420b 0x9558 0x3e8 0x4339 0x952c 0x3e9 0x4467 0x9506 0x3fc 0x4595 0x94e0 0x40f 0x46c3 0x94ba 0x41a 0x47f1 0x9495 0x41d 0x491f 0x9477 0x443 0x4a4d 0x9459 0x45a 0x4b7b 0x943b 0x465 0x4ca9 0x941d 0x467 0x4dd7 0x93fe 0x47a 0x4f05 0x93e0 0x47e 0x5033 0x93be 0x47e 0x5160 0x9396 0x476 0x528e 0x9359 0x43d 0x53bc 0x930a 0x405 0x54ea 0x92c6 0x3f1 0x5618 0x9292 0x401 0x5746 0x9265 0x401 0x5874 0x9238 0x401 0x59a2 0x920b 0x401 0x5ad0 0x91df 0x401 0x5bfe 0x91b9 0x401 0x5d2c 0x919a 0x411 0x5e5a 0x9178 0x41a 0x5f87 0x914f 0x41a 0x60b5 0x911a 0x41a 0x61e3 0x90d7 0x409 0x6311 0x909c 0x40c 0x643f 0x9064 0x41a 0x656d 0x9020 0x41a 0x669b 0x8fd5 0x3e6 0x67c9 0x8fb2 0x3e5 0x68f7 0x8fa8 0x406 0x6a25 0x8f99 0x419 0x6b53 0x8f91 0x451 0x6c81 0x8f75 0x47e 0x6dae 0x8f26 0x48b 0x6edc 0x8e7f 0x465 0x700a 0x8cd9 0x465 0x7138 0x8abd 0x4a5 0x7266 0x87f1 0x51e 0x7394 0x843a 0x5cd 0x74c2 0x7e68 0x384>;
			battery1_profile_t1_num = <0x64>;
			battery1_profile_t1 = <0x00 0xaa3c 0x5fa 0x12e 0xa9ad 0x5f6 0x25c 0xa92c 0x602 0x38a 0xa8b1 0x60e 0x4b8 0xa831 0x60e 0x5e6 0xa7b8 0x60e 0x714 0xa73f 0x60e 0x841 0xa6c9 0x615 0x96f 0xa658 0x627 0xa9d 0xa5df 0x627 0xbcb 0xa566 0x627 0xcf9 0xa4f1 0x62f 0xe27 0xa47f 0x63f 0xf55 0xa406 0x62c 0x1083 0xa393 0x627 0x11b1 0xa325 0x637 0x12df 0xa2ba 0x659 0x140d 0xa241 0x659 0x153b 0xa1d4 0x668 0x1668 0xa167 0x67b 0x1796 0xa0f7 0x68d 0x18c4 0xa08d 0x6a0 0x19f2 0xa01d 0x695 0x1b20 0x9fb3 0x694 0x1c4e 0x9f53 0x6aa 0x1d7c 0x9f00 0x6cf 0x1eaa 0x9ea1 0x6f5 0x1fd8 0x9e37 0x711 0x2106 0x9dc6 0x721 0x2234 0x9d55 0x721 0x2362 0x9ce8 0x721 0x248f 0x9c85 0x736 0x25bd 0x9c2b 0x753 0x26eb 0x9bd0 0x753 0x2819 0x9b7c 0x753 0x2947 0x9b2e 0x75e 0x2a75 0x9ae2 0x771 0x2ba3 0x9a97 0x784 0x2cd1 0x9a36 0x762 0x2dff 0x99c6 0x730 0x2f2d 0x9949 0x6e2 0x305b 0x98c1 0x65e 0x3189 0x984f 0x610 0x32b7 0x97ec 0x5dd 0x33e4 0x9799 0x5c3 0x3512 0x9755 0x5c3 0x3640 0x9711 0x5b0 0x376e 0x96d2 0x5aa 0x389c 0x9698 0x5aa 0x39ca 0x9663 0x5aa 0x3af8 0x962e 0x5bd 0x3c26 0x95ff 0x5d0 0x3d54 0x95cf 0x5d5 0x3e82 0x959b 0x5c4 0x3fb0 0x9575 0x5ea 0x40de 0x954a 0x5e8 0x420b 0x951f 0x5e3 0x4339 0x94fa 0x5f7 0x4467 0x94dc 0x61d 0x4595 0x94b8 0x627 0x46c3 0x9495 0x62f 0x47f1 0x9477 0x640 0x491f 0x9459 0x640 0x4a4d 0x943b 0x64e 0x4b7b 0x941d 0x659 0x4ca9 0x93ff 0x657 0x4dd7 0x93e0 0x644 0x4f05 0x93c2 0x64f 0x5033 0x93a0 0x647 0x5160 0x937b 0x627 0x528e 0x9355 0x627 0x53bc 0x9329 0x608 0x54ea 0x92ff 0x5f5 0x5618 0x92da 0x5f5 0x5746 0x92b4 0x5f5 0x5874 0x9288 0x5e5 0x59a2 0x9262 0x5dc 0x5ad0 0x9244 0x5e3 0x5bfe 0x9226 0x609 0x5d2c 0x91fb 0x60e 0x5e5a 0x91c5 0x60e 0x5f87 0x918b 0x60e 0x60b5 0x9156 0x60e 0x61e3 0x9121 0x630 0x6311 0x90db 0x635 0x643f 0x908d 0x622 0x656d 0x9051 0x610 0x669b 0x903e 0x631 0x67c9 0x902f 0x656 0x68f7 0x9020 0x686 0x6a25 0x9011 0x6d2 0x6b53 0x8ff3 0x731 0x6c81 0x8f72 0x747 0x6dae 0x8e64 0x73a 0x6edc 0x8c9f 0x73a 0x700a 0x8a0e 0x7be 0x7138 0x8660 0x8cf 0x7266 0x8173 0x972 0x7394 0x7f8a 0x672 0x74c2 0x7f8a 0x672>;
			battery1_profile_t2_num = <0x64>;
			battery1_profile_t2 = <0x00 0xa8ac 0xba4 0x12e 0xa7d9 0xba0 0x25c 0xa733 0xbc5 0x38a 0xa6a9 0xbf7 0x4b8 0xa629 0xc1c 0x5e6 0xa5a8 0xc09 0x714 0xa533 0xc1d 0x841 0xa4bf 0xc35 0x96f 0xa446 0xc36 0xa9d 0xa3d5 0xc49 0xbcb 0xa364 0xc4e 0xcf9 0xa2f0 0xc4e 0xe27 0xa278 0xc51 0xf55 0xa20e 0xc77 0x1083 0xa19f 0xc80 0x11b1 0xa12e 0xc88 0x12df 0xa0bd 0xc9d 0x140d 0xa054 0xcc3 0x153b 0x9ff0 0xcda 0x1668 0x9f91 0xcf5 0x1796 0x9f37 0xd20 0x18c4 0x9ee4 0xd6b 0x19f2 0x9e7f 0xd98 0x1b20 0x9e04 0xd9a 0x1c4e 0x9d74 0xd74 0x1d7c 0x9ce5 0xd4f 0x1eaa 0x9c6e 0xd48 0x1fd8 0x9c0c 0xd5b 0x2106 0x9bbc 0xd84 0x2234 0x9b78 0xdbd 0x2362 0x9b25 0xda4 0x248f 0x9ad1 0xd93 0x25bd 0x9a80 0xd8f 0x26eb 0x9a35 0xd7c 0x2819 0x99c7 0xd35 0x2947 0x9951 0xcea 0x2a75 0x98d8 0xca3 0x2ba3 0x9860 0xc6b 0x2cd1 0x97fc 0xc20 0x2dff 0x97a3 0xbf7 0x2f2d 0x9754 0xbef 0x305b 0x9711 0xc02 0x3189 0x96d4 0xc03 0x32b7 0x9697 0xbf7 0x33e4 0x965d 0xbf0 0x3512 0x9629 0xc03 0x3640 0x95f4 0xc16 0x376e 0x95c4 0xc29 0x389c 0x9597 0xc42 0x39ca 0x9569 0xc67 0x3af8 0x953c 0xc7a 0x3c26 0x9514 0xc73 0x3d54 0x94ee 0xc6e 0x3e82 0x94c9 0xc82 0x3fb0 0x94ab 0xcbb 0x40de 0x9487 0xcd8 0x420b 0x9464 0xcf3 0x4339 0x9446 0xd15 0x4467 0x9428 0xd02 0x4595 0x940a 0xd0b 0x46c3 0x93ef 0xd26 0x47f1 0x93d7 0xd48 0x491f 0x93b9 0xd48 0x4a4d 0x93a6 0xd73 0x4b7b 0x9394 0xd93 0x4ca9 0x937d 0xd97 0x4dd7 0x9367 0xdbd 0x4f05 0x934a 0xde3 0x5033 0x932c 0xdee 0x5160 0x930d 0xde6 0x528e 0x92e7 0xe1f 0x53bc 0x92c1 0xe57 0x54ea 0x929b 0xe7d 0x5618 0x9276 0xe9d 0x5746 0x9250 0xefb 0x5874 0x9217 0xf3a 0x59a2 0x91db 0xf68 0x5ad0 0x919e 0xf95 0x5bfe 0x9162 0xfe1 0x5d2c 0x911f 0x105d 0x5e5a 0x90d3 0x10b9 0x5f87 0x908a 0x1112 0x60b5 0x9064 0x11e2 0x61e3 0x904c 0x127f 0x6311 0x9035 0x1340 0x643f 0x901f 0x144c 0x656d 0x9008 0x15d8 0x669b 0x8fb3 0x1731 0x67c9 0x8eb7 0x1879 0x68f7 0x8d10 0x1a06 0x6a25 0x8ac4 0x1c61 0x6b53 0x8799 0x1a97 0x6c81 0x8321 0xf6b 0x6dae 0x81f6 0xc80 0x6edc 0x81f6 0xc80 0x700a 0x81f6 0xc80 0x7138 0x81f6 0xc80 0x7266 0x81f6 0xc80 0x7394 0x81f6 0xc80 0x74c2 0x81f6 0xc80>;
			battery1_profile_t3_num = <0x64>;
			battery1_profile_t3 = <0x00 0xa960 0x10ea 0x12e 0xa8b2 0x10e6 0x25c 0xa80f 0x1125 0x38a 0xa761 0x1169 0x4b8 0xa690 0x117e 0x5e6 0xa4f8 0x1202 0x714 0xa3ea 0x1529 0x841 0xa333 0x1830 0x96f 0xa2ac 0x191d 0xa9d 0xa233 0x1968 0xbcb 0xa1c0 0x1998 0xcf9 0xa14c 0x1998 0xe27 0xa0d4 0x1964 0xf55 0xa06a 0x1964 0x1083 0xa00c 0x19c7 0x11b1 0x9fb1 0x1a33 0x12df 0x9f57 0x1a75 0x140d 0x9efc 0x1a62 0x153b 0x9e84 0x1a7b 0x1668 0x9dfa 0x1a99 0x1796 0x9d62 0x1aa4 0x18c4 0x9cc3 0x1a7e 0x19f2 0x9c43 0x1a4a 0x1b20 0x9bd2 0x1a1a 0x1c4e 0x9b6b 0x1a06 0x1d7c 0x9b18 0x1a51 0x1eaa 0x9abf 0x1a5e 0x1fd8 0x9a61 0x1a42 0x2106 0x99fd 0x1a13 0x2234 0x9994 0x1a13 0x2362 0x9921 0x19e1 0x248f 0x98b7 0x1993 0x25bd 0x9857 0x193e 0x26eb 0x97fc 0x1905 0x2819 0x97a8 0x1945 0x2947 0x975e 0x194e 0x2a75 0x971a 0x1937 0x2ba3 0x96d6 0x194a 0x2cd1 0x9699 0x194b 0x2dff 0x9662 0x1990 0x2f2d 0x962d 0x19ec 0x305b 0x95f8 0x1a12 0x3189 0x95c3 0x19ca 0x32b7 0x9593 0x1a0f 0x33e4 0x9566 0x1a5f 0x3512 0x9539 0x1a14 0x3640 0x9513 0x1a83 0x376e 0x94e8 0x1acf 0x389c 0x94c0 0x1ae1 0x39ca 0x94a1 0x1aab 0x3af8 0x947c 0x1b55 0x3c26 0x9456 0x1b56 0x3d54 0x9436 0x1b56 0x3e82 0x941f 0x1bd3 0x3fb0 0x9401 0x1b9a 0x40de 0x93ed 0x1be8 0x420b 0x93db 0x1c40 0x4339 0x93c5 0x1c58 0x4467 0x93ae 0x1cb6 0x4595 0x9397 0x1d3f 0x46c3 0x937d 0x1d8f 0x47f1 0x935f 0x1d8c 0x491f 0x9341 0x1e22 0x4a4d 0x9323 0x1e80 0x4b7b 0x9301 0x1ebb 0x4ca9 0x92dc 0x1ef8 0x4dd7 0x92b6 0x1fee 0x4f05 0x928a 0x205d 0x5033 0x9256 0x20b1 0x5160 0x921b 0x2117 0x528e 0x91e6 0x21ae 0x53bc 0x91ab 0x22b1 0x54ea 0x9167 0x2394 0x5618 0x911a 0x2438 0x5746 0x90c7 0x24bc 0x5874 0x9094 0x258f 0x59a2 0x906e 0x26ac 0x5ad0 0x9052 0x282f 0x5bfe 0x903b 0x2a78 0x5d2c 0x9017 0x2c2e 0x5e5a 0x8fe0 0x2ddc 0x5f87 0x8f70 0x2e24 0x60b5 0x8e66 0x2b96 0x61e3 0x8c91 0x2714 0x6311 0x8a17 0x20d2 0x643f 0x8728 0x197d 0x656d 0x8728 0x197d 0x669b 0x8728 0x197d 0x67c9 0x8728 0x197d 0x68f7 0x8728 0x197d 0x6a25 0x8728 0x197d 0x6b53 0x8728 0x197d 0x6c81 0x8728 0x197d 0x6dae 0x8728 0x197d 0x6edc 0x8728 0x197d 0x700a 0x8728 0x197d 0x7138 0x8728 0x197d 0x7266 0x8728 0x197d 0x7394 0x8728 0x197d 0x74c2 0x8728 0x197d>;
			battery1_profile_t4_num = <0x64>;
			battery1_profile_t4 = <0x00 0xa708 0x272e 0x12e 0xa64b 0x272a 0x25c 0xa5a3 0x27cf 0x38a 0xa507 0x2888 0x4b8 0xa470 0x28d3 0x5e6 0xa3e1 0x290c 0x714 0xa35c 0x2903 0x841 0xa2e1 0x290e 0x96f 0xa270 0x2965 0xa9d 0xa1f7 0x292d 0xbcb 0xa163 0x290f 0xcf9 0xa0af 0x2904 0xe27 0x9fd4 0x2908 0xf55 0x9e97 0x2941 0x1083 0x9d3d 0x2c94 0x11b1 0x9c1b 0x30dd 0x12df 0x9b55 0x34c9 0x140d 0x9abe 0x3643 0x153b 0x9a3e 0x371b 0x1668 0x99cc 0x37a3 0x1796 0x9964 0x37dd 0x18c4 0x9901 0x3720 0x19f2 0x98a5 0x3765 0x1b20 0x984e 0x3759 0x1c4e 0x97fc 0x36c3 0x1d7c 0x97b1 0x369e 0x1eaa 0x976c 0x3704 0x1fd8 0x9728 0x3717 0x2106 0x96e5 0x36c6 0x2234 0x96a9 0x36b3 0x2362 0x966c 0x3670 0x248f 0x9634 0x366a 0x25bd 0x95ff 0x369f 0x26eb 0x95ca 0x36c4 0x2819 0x959c 0x36da 0x2947 0x956b 0x3736 0x2a75 0x9538 0x37a1 0x2ba3 0x950a 0x377c 0x2cd1 0x94e4 0x379a 0x2dff 0x94be 0x37e1 0x2f2d 0x9498 0x3827 0x305b 0x9473 0x3827 0x3189 0x9454 0x384a 0x32b7 0x9431 0x38e2 0x33e4 0x940b 0x396b 0x3512 0x93e6 0x390c 0x3640 0x93bb 0x38ca 0x376e 0x938c 0x3872 0x389c 0x935c 0x37ea 0x39ca 0x932f 0x3776 0x3af8 0x92f7 0x36f4 0x3c26 0x92b7 0x3649 0x3d54 0x927e 0x35cc 0x3e82 0x923c 0x3522 0x3fb0 0x91f8 0x347f 0x40de 0x91b5 0x33d7 0x420b 0x915f 0x3302 0x4339 0x9118 0x324b 0x4467 0x90f0 0x31d7 0x4595 0x90ce 0x319b 0x46c3 0x90b4 0x315a 0x47f1 0x909c 0x311f 0x491f 0x907b 0x30cc 0x4a4d 0x906a 0x30a2 0x4b7b 0x906a 0x30a2 0x4ca9 0x906a 0x30a2 0x4dd7 0x906a 0x30a2 0x4f05 0x906a 0x30a2 0x5033 0x906a 0x30a2 0x5160 0x906a 0x30a2 0x528e 0x906a 0x30a2 0x53bc 0x906a 0x30a2 0x54ea 0x906a 0x30a2 0x5618 0x906a 0x30a2 0x5746 0x906a 0x30a2 0x5874 0x906a 0x30a2 0x59a2 0x906a 0x30a2 0x5ad0 0x906a 0x30a2 0x5bfe 0x906a 0x30a2 0x5d2c 0x906a 0x30a2 0x5e5a 0x906a 0x30a2 0x5f87 0x906a 0x30a2 0x60b5 0x906a 0x30a2 0x61e3 0x906a 0x30a2 0x6311 0x906a 0x30a2 0x643f 0x906a 0x30a2 0x656d 0x906a 0x30a2 0x669b 0x906a 0x30a2 0x67c9 0x906a 0x30a2 0x68f7 0x906a 0x30a2 0x6a25 0x906a 0x30a2 0x6b53 0x906a 0x30a2 0x6c81 0x906a 0x30a2 0x6dae 0x906a 0x30a2 0x6edc 0x906a 0x30a2 0x700a 0x906a 0x30a2 0x7138 0x906a 0x30a2 0x7266 0x906a 0x30a2 0x7394 0x906a 0x30a2 0x74c2 0x906a 0x30a2>;
			battery2_profile_t0_num = <0x64>;
			battery2_profile_t0 = <0x00 0xaae6 0x3e8 0x130 0xaa3f 0x3e8 0x261 0xa9ac 0x3f5 0x391 0xa923 0x3fa 0x4c2 0xa89b 0x3e9 0x5f2 0xa821 0x3fc 0x723 0xa7a7 0x401 0x853 0xa72a 0x3f9 0x984 0xa6ab 0x3ea 0xab4 0xa639 0x3fd 0xbe4 0xa5c0 0x401 0xd15 0xa546 0x401 0xe45 0xa4cd 0x3fe 0xf76 0xa453 0x3eb 0x10a6 0xa3e6 0x409 0x11d7 0xa373 0x410 0x1307 0xa2fb 0x401 0x1438 0xa289 0x401 0x1568 0xa217 0x401 0x1698 0xa1a9 0x40d 0x17c9 0xa13d 0x41a 0x18f9 0xa0cb 0x41a 0x1a2a 0xa060 0x42d 0x1b5a 0x9ff5 0x433 0x1c8b 0x9f8b 0x433 0x1dbb 0x9f20 0x433 0x1eec 0x9eb6 0x433 0x201c 0x9e56 0x441 0x214c 0x9df8 0x44c 0x227d 0x9d94 0x44e 0x23ad 0x9d2f 0x461 0x24de 0x9ccb 0x465 0x260e 0x9c70 0x46f 0x273f 0x9c1b 0x47a 0x286f 0x9bc0 0x467 0x29a0 0x9b6b 0x486 0x2ad0 0x9b1c 0x4ac 0x2c00 0x9ace 0x4c9 0x2d31 0x9a7a 0x4c9 0x2e61 0x9a26 0x4db 0x2f92 0x99d2 0x4ee 0x30c2 0x997a 0x4f5 0x31f3 0x9917 0x4e2 0x3323 0x989e 0x4aa 0x3454 0x9829 0x470 0x3584 0x97bc 0x43e 0x36b4 0x975a 0x419 0x37e5 0x970e 0x406 0x3915 0x96c8 0x3f3 0x3a46 0x9686 0x3e8 0x3b76 0x964a 0x3e8 0x3ca7 0x9615 0x3e8 0x3dd7 0x95e6 0x3f7 0x3f08 0x95b5 0x3f8 0x4038 0x9582 0x3eb 0x4168 0x955c 0x3fe 0x4299 0x952f 0x401 0x43c9 0x9506 0x40b 0x44fa 0x94e0 0x41a 0x462a 0x94b9 0x41a 0x475b 0x9493 0x41a 0x488b 0x946d 0x41a 0x49bc 0x9449 0x41a 0x4aec 0x942b 0x41a 0x4c1c 0x940d 0x42c 0x4d4d 0x93ee 0x433 0x4e7d 0x93d2 0x440 0x4fae 0x93bb 0x465 0x50de 0x939d 0x465 0x520f 0x9379 0x465 0x533f 0x934a 0x44e 0x5470 0x930c 0x418 0x55a0 0x92c0 0x405 0x56d0 0x928b 0x401 0x5801 0x9261 0x401 0x5931 0x923a 0x401 0x5a62 0x920c 0x401 0x5b92 0x91e4 0x401 0x5cc3 0x91be 0x401 0x5df3 0x9198 0x401 0x5f24 0x9172 0x401 0x6054 0x914c 0x412 0x6184 0x9119 0x41a 0x62b5 0x90dc 0x41a 0x63e5 0x909f 0x41a 0x6516 0x9062 0x42c 0x6646 0x9017 0x41b 0x6777 0x8fd0 0x3fb 0x68a7 0x8fa2 0x3e8 0x69d8 0x8f9a 0x40e 0x6b08 0x8f93 0x435 0x6c38 0x8f88 0x463 0x6d69 0x8f74 0x49b 0x6e99 0x8f37 0x4c1 0x6fca 0x8e54 0x48e 0x70fa 0x8ce2 0x480 0x722b 0x8ae0 0x4bc 0x735b 0x881c 0x508 0x748c 0x83cc 0x614 0x75bc 0x7e90 0x401>;
			battery2_profile_t1_num = <0x64>;
			battery2_profile_t1 = <0x00 0xaa5a 0x60e 0x130 0xa9ba 0x60e 0x261 0xa92a 0x60e 0x391 0xa8a4 0x60e 0x4c2 0xa823 0x60e 0x5f2 0xa7a9 0x60e 0x723 0xa72f 0x60e 0x853 0xa6b2 0x606 0x984 0xa633 0x5f5 0xab4 0xa5c1 0x5f5 0xbe4 0xa548 0x5f5 0xd15 0xa4d2 0x5f5 0xe45 0xa460 0x5f8 0xf76 0xa3ee 0x60b 0x10a6 0xa375 0x5fe 0x11d7 0xa300 0x5f5 0x1307 0xa28f 0x5f9 0x1438 0xa225 0x60c 0x1568 0xa1b3 0x60e 0x1698 0xa141 0x60e 0x17c9 0xa0d1 0x614 0x18f9 0xa066 0x627 0x1a2a 0x9ffc 0x63a 0x1b5a 0x9f96 0x640 0x1c8b 0x9f36 0x647 0x1dbb 0x9eda 0x65a 0x1eec 0x9e77 0x66d 0x201c 0x9e0f 0x68e 0x214c 0x9da1 0x6a4 0x227d 0x9d30 0x6a6 0x23ad 0x9cc2 0x6b9 0x24de 0x9c5d 0x6bd 0x260e 0x9c02 0x6c7 0x273f 0x9bae 0x6d6 0x286f 0x9b5b 0x6d6 0x29a0 0x9b0e 0x6e7 0x2ad0 0x9abd 0x6ef 0x2c00 0x9a6a 0x6f4 0x2d31 0x9a16 0x707 0x2e61 0x99bb 0x6f6 0x2f92 0x9956 0x6d8 0x30c2 0x98e9 0x6a6 0x31f3 0x9877 0x65a 0x3323 0x980d 0x60e 0x3454 0x97ac 0x5e8 0x3584 0x9757 0x5ce 0x36b4 0x970b 0x5a9 0x37e5 0x96c6 0x596 0x3915 0x9687 0x591 0x3a46 0x964e 0x591 0x3b76 0x9618 0x591 0x3ca7 0x95e3 0x591 0x3dd7 0x95b4 0x591 0x3f08 0x9586 0x591 0x4038 0x955a 0x594 0x4168 0x9534 0x5a7 0x4299 0x950e 0x5aa 0x43c9 0x94e8 0x5b4 0x44fa 0x94c2 0x5c3 0x462a 0x949b 0x5c3 0x475b 0x947c 0x5c3 0x488b 0x945e 0x5ce 0x49bc 0x943f 0x5dc 0x4aec 0x9421 0x5dc 0x4c1c 0x9403 0x5ee 0x4d4d 0x93e9 0x5f5 0x4e7d 0x93d0 0x5f5 0x4fae 0x93b1 0x5f5 0x50de 0x939b 0x5f5 0x520f 0x937e 0x5f5 0x533f 0x9360 0x5ed 0x5470 0x9341 0x5da 0x55a0 0x931b 0x5c7 0x56d0 0x92f5 0x5b4 0x5801 0x92cf 0x5aa 0x5931 0x92a9 0x5ad 0x5a62 0x9283 0x5c0 0x5b92 0x925c 0x5c3 0x5cc3 0x923a 0x5cd 0x5df3 0x9219 0x5dc 0x5f24 0x91eb 0x5dc 0x6054 0x91b0 0x5ed 0x6184 0x9173 0x5f5 0x62b5 0x9136 0x5fa 0x63e5 0x90f9 0x60d 0x6516 0x90a7 0x60e 0x6646 0x9062 0x602 0x6777 0x9036 0x601 0x68a7 0x902e 0x627 0x69d8 0x901f 0x64d 0x6b08 0x900f 0x681 0x6c38 0x8ff6 0x6cb 0x6d69 0x8fc3 0x725 0x6e99 0x8f0c 0x74b 0x6fca 0x8d79 0x771 0x70fa 0x8b4d 0x7e7 0x722b 0x8874 0x8d8 0x735b 0x842c 0xa7b 0x748c 0x7fc6 0x6fd 0x75bc 0x7fc6 0x708>;
			battery2_profile_t2_num = <0x64>;
			battery2_profile_t2 = <0x00 0xa910 0xc9e 0x130 0xa833 0xc9a 0x261 0xa78b 0xce7 0x391 0xa6fd 0xd2f 0x4c2 0xa675 0xd2e 0x5f2 0xa5fb 0xd1b 0x723 0xa57c 0xd24 0x853 0xa4fe 0xd1f 0x984 0xa485 0xcff 0xab4 0xa413 0xd12 0xbe4 0xa3a0 0xd16 0xd15 0xa32e 0xd16 0xe45 0xa2bc 0xd13 0xf76 0xa24a 0xd00 0x10a6 0xa1de 0xd2e 0x11d7 0xa170 0xd5d 0x1307 0xa0ff 0xd7e 0x1438 0xa095 0xd91 0x1568 0xa02a 0xd93 0x1698 0x9fc4 0xd9f 0x17c9 0x9f66 0xdb7 0x18f9 0x9f12 0xddd 0x1a2a 0x9eb7 0xe28 0x1b5a 0x9e47 0xe35 0x1c8b 0x9dc5 0xe22 0x1dbb 0x9d35 0xe0e 0x1eec 0x9cac 0xdd5 0x201c 0x9c3f 0xde1 0x214c 0x9be5 0xdf7 0x227d 0x9b99 0xdf9 0x23ad 0x9b4b 0xe0c 0x24de 0x9b04 0xe2f 0x260e 0x9abc 0xe1c 0x273f 0x9a70 0xde2 0x286f 0x9a24 0xdf5 0x29a0 0x99c4 0xe08 0x2ad0 0x9958 0xdf0 0x2c00 0x98e6 0xda0 0x2d31 0x9874 0xd08 0x2e61 0x9809 0xcfd 0x2f92 0x97a8 0xce6 0x30c2 0x974f 0xcb4 0x31f3 0x96fb 0xc68 0x3323 0x96b6 0xc67 0x3454 0x9677 0xc74 0x3584 0x963d 0xc87 0x36b4 0x9607 0xc9b 0x37e5 0x95d2 0xcc1 0x3915 0x95a3 0xcf5 0x3a46 0x9572 0xd0e 0x3b76 0x953e 0xcf7 0x3ca7 0x9518 0xcbe 0x3dd7 0x94f2 0xcdf 0x3f08 0x94cf 0xd21 0x4038 0x94b0 0xd67 0x4168 0x948a 0xd8d 0x4299 0x946a 0xd62 0x43c9 0x9448 0xd48 0x44fa 0x9425 0xd55 0x462a 0x940e 0xd8e 0x475b 0x93f7 0xdc7 0x488b 0x93e0 0xe0b 0x49bc 0x93ca 0xe2d 0x4aec 0x93b3 0xde1 0x4c1c 0x93a3 0xe3a 0x4d4d 0x9394 0xe8d 0x4e7d 0x9385 0xeb9 0x4fae 0x9375 0xea6 0x50de 0x935f 0xeba 0x520f 0x9342 0xf1e 0x533f 0x9324 0xf50 0x5470 0x9305 0xf12 0x55a0 0x92df 0xf71 0x56d0 0x92b3 0xfd0 0x5801 0x9289 0xffb 0x5931 0x9262 0xff3 0x5a62 0x9234 0x102c 0x5b92 0x91fa 0x10a4 0x5cc3 0x91b9 0x1133 0x5df3 0x9176 0x11b5 0x5f24 0x9139 0x11db 0x6054 0x90e8 0x1277 0x6184 0x909d 0x12f7 0x62b5 0x9060 0x1387 0x63e5 0x903a 0x14a4 0x6516 0x9022 0x1544 0x6646 0x900c 0x166c 0x6777 0x8ff0 0x180d 0x68a7 0x8fca 0x19fc 0x69d8 0x8f41 0x1c37 0x6b08 0x8de8 0x1e61 0x6c38 0x8be9 0x2044 0x6d69 0x895b 0x1f0c 0x6e99 0x85f1 0x165a 0x6fca 0x8368 0x101d 0x70fa 0x8368 0x101d 0x722b 0x8368 0x101d 0x735b 0x8368 0x101d 0x748c 0x8368 0x101d 0x75bc 0x8368 0x101d>;
			battery2_profile_t3_num = <0x64>;
			battery2_profile_t3 = <0x00 0xa956 0x15cc 0x130 0xa8a7 0x15c8 0x261 0xa7de 0x15fb 0x391 0xa6d6 0x1647 0x4c2 0xa57e 0x16b4 0x5f2 0xa48a 0x1928 0x723 0xa3d5 0x1a9d 0x853 0xa342 0x1b99 0x984 0xa2c2 0x1c5f 0xab4 0xa248 0x1cd2 0xbe4 0xa1ce 0x1cd9 0xd15 0xa158 0x1ca0 0xe45 0xa0e7 0x1c41 0xf76 0xa07d 0x1be2 0x10a6 0xa019 0x1c89 0x11d7 0x9fba 0x1d1c 0x1307 0x9f5f 0x1d3d 0x1438 0x9f03 0x1c92 0x1568 0x9e93 0x1cdc 0x1698 0x9e0a 0x1d24 0x17c9 0x9d72 0x1d41 0x18f9 0x9cd9 0x1d1b 0x1a2a 0x9c57 0x1c85 0x1b5a 0x9be5 0x1c13 0x1c8b 0x9b83 0x1bf6 0x1dbb 0x9b2f 0x1c54 0x1eec 0x9adb 0x1c8d 0x201c 0x9a88 0x1c8f 0x214c 0x9a31 0x1c9b 0x227d 0x99d4 0x1ccd 0x23ad 0x9966 0x1cba 0x24de 0x98fb 0x1c0c 0x260e 0x988d 0x1b60 0x273f 0x981f 0x1b14 0x286f 0x97c4 0x1bbf 0x29a0 0x976f 0x1b50 0x2ad0 0x9724 0x1b18 0x2c00 0x96df 0x1b21 0x2d31 0x969b 0x1b0e 0x2e61 0x965d 0x1bac 0x2f92 0x9625 0x1bee 0x30c2 0x95f0 0x1bc0 0x31f3 0x95bb 0x1b28 0x3323 0x958d 0x1c1b 0x3454 0x955f 0x1bf7 0x3584 0x9534 0x1bba 0x36b4 0x950e 0x1c3e 0x37e5 0x94e0 0x1cb1 0x3915 0x94b8 0x1c51 0x3a46 0x9495 0x1c6e 0x3b76 0x9476 0x1d6e 0x3ca7 0x9450 0x1cd6 0x3dd7 0x9436 0x1d3e 0x3f08 0x941f 0x1d6a 0x4038 0x9408 0x1d33 0x4168 0x93f1 0x1dcb 0x4299 0x93e1 0x1dd2 0x43c9 0x93d2 0x1dfc 0x44fa 0x93c1 0x1e81 0x462a 0x93aa 0x1f8c 0x475b 0x938c 0x1f2b 0x488b 0x9372 0x1f5b 0x49bc 0x9359 0x1ffb 0x4aec 0x933b 0x2081 0x4c1c 0x9315 0x203b 0x4d4d 0x92f4 0x210d 0x4e7d 0x92d3 0x221c 0x4fae 0x92ad 0x227b 0x50de 0x9277 0x22c7 0x520f 0x9242 0x2306 0x533f 0x920a 0x23d6 0x5470 0x91cd 0x2579 0x55a0 0x9190 0x264a 0x56d0 0x9142 0x26b5 0x5801 0x90ee 0x271b 0x5931 0x909e 0x27b6 0x5a62 0x9069 0x28d3 0x5b92 0x9047 0x2b3c 0x5cc3 0x902c 0x2d38 0x5df3 0x9014 0x2e83 0x5f24 0x8ff6 0x2f68 0x6054 0x8fc6 0x2efb 0x6184 0x8f59 0x2de0 0x62b5 0x8e3e 0x2b30 0x63e5 0x8c59 0x2677 0x6516 0x89ea 0x2079 0x6646 0x88c2 0x1d7e 0x6777 0x88c2 0x1d7e 0x68a7 0x88c2 0x1d7e 0x69d8 0x88c2 0x1d7e 0x6b08 0x88c2 0x1d7e 0x6c38 0x88c2 0x1d7e 0x6d69 0x88c2 0x1d7e 0x6e99 0x88c2 0x1d7e 0x6fca 0x88c2 0x1d7e 0x70fa 0x88c2 0x1d7e 0x722b 0x88c2 0x1d7e 0x735b 0x88c2 0x1d7e 0x748c 0x88c2 0x1d7e 0x75bc 0x88c2 0x1d7e>;
			battery2_profile_t4_num = <0x64>;
			battery2_profile_t4 = <0x00 0xa7e4 0x2c24 0x130 0xa73d 0x2c24 0x261 0xa6a0 0x2d1c 0x391 0xa60a 0x2dbf 0x4c2 0xa57a 0x2d1b 0x5f2 0xa4e9 0x2ce2 0x723 0xa45e 0x2ce1 0x853 0xa3d2 0x2d0d 0x984 0xa344 0x2d3e 0xab4 0xa2ca 0x2ca6 0xbe4 0xa22c 0x2c69 0xd15 0xa149 0x2c97 0xe45 0xa01b 0x2dc3 0xf76 0x9eb6 0x3200 0x10a6 0x9dd3 0x33ff 0x11d7 0x9d12 0x3524 0x1307 0x9c5d 0x35cc 0x1438 0x9bae 0x362b 0x1568 0x9b1b 0x35b9 0x1698 0x9a94 0x3533 0x17c9 0x9a19 0x34cf 0x18f9 0x99ae 0x34bc 0x1a2a 0x994b 0x3564 0x1b5a 0x98f2 0x3538 0x1c8b 0x989f 0x34f0 0x1dbb 0x984c 0x3532 0x1eec 0x9807 0x3474 0x201c 0x97bd 0x33fa 0x214c 0x9777 0x33ca 0x227d 0x973a 0x33d9 0x23ad 0x96f5 0x33c6 0x24de 0x96b6 0x33e0 0x260e 0x967d 0x3444 0x273f 0x9648 0x34d8 0x286f 0x9613 0x34eb 0x29a0 0x95dd 0x34ee 0x2ad0 0x95a8 0x3480 0x2c00 0x9574 0x340b 0x2d31 0x9547 0x34f0 0x2e61 0x9519 0x348f 0x2f92 0x94eb 0x3437 0x30c2 0x94be 0x341c 0x31f3 0x9490 0x3456 0x3323 0x946a 0x3532 0x3454 0x943f 0x3553 0x3584 0x9411 0x354c 0x36b4 0x93e3 0x35ce 0x37e5 0x93b6 0x356e 0x3915 0x9383 0x3635 0x3a46 0x934d 0x36cf 0x3b76 0x9317 0x3668 0x3ca7 0x92d7 0x3690 0x3dd7 0x929a 0x3600 0x3f08 0x9258 0x355e 0x4038 0x9212 0x34b6 0x4168 0x91c8 0x33f4 0x4299 0x917f 0x333d 0x43c9 0x913a 0x3290 0x44fa 0x9103 0x3221 0x462a 0x90df 0x31c6 0x475b 0x90c4 0x316a 0x488b 0x90a6 0x311f 0x49bc 0x907f 0x30bf 0x4aec 0x904f 0x3057 0x4c1c 0x8fe4 0x2f4a 0x4d4d 0x8f7a 0x2e4a 0x4e7d 0x8f7a 0x2e4a 0x4fae 0x8f7a 0x2e4a 0x50de 0x8f7a 0x2e4a 0x520f 0x8f7a 0x2e4a 0x533f 0x8f7a 0x2e4a 0x5470 0x8f7a 0x2e4a 0x55a0 0x8f7a 0x2e4a 0x56d0 0x8f7a 0x2e4a 0x5801 0x8f7a 0x2e4a 0x5931 0x8f7a 0x2e4a 0x5a62 0x8f7a 0x2e4a 0x5b92 0x8f7a 0x2e4a 0x5cc3 0x8f7a 0x2e4a 0x5df3 0x8f7a 0x2e4a 0x5f24 0x8f7a 0x2e4a 0x6054 0x8f7a 0x2e4a 0x6184 0x8f7a 0x2e4a 0x62b5 0x8f7a 0x2e4a 0x63e5 0x8f7a 0x2e4a 0x6516 0x8f7a 0x2e4a 0x6646 0x8f7a 0x2e4a 0x6777 0x8f7a 0x2e4a 0x68a7 0x8f7a 0x2e4a 0x69d8 0x8f7a 0x2e4a 0x6b08 0x8f7a 0x2e4a 0x6c38 0x8f7a 0x2e4a 0x6d69 0x8f7a 0x2e4a 0x6e99 0x8f7a 0x2e4a 0x6fca 0x8f7a 0x2e4a 0x70fa 0x8f7a 0x2e4a 0x722b 0x8f7a 0x2e4a 0x735b 0x8f7a 0x2e4a 0x748c 0x8f7a 0x2e4a 0x75bc 0x8f7a 0x2e4a>;
		};
	};

	fragment@17 {
		target = <0xffffffff>;

		__overlay__ {
			status = "okay";
		};
	};

	fragment@18 {
		target = <0xffffffff>;

		__overlay__ {
			compatible = "huawei,huawei_wifi_info";
			status = "okay";
			ini_type = "DUA_LX9N";
			wifi_chiptype = "WIFI_MTK_6631";
			power_limit = "DRA";
		};
	};

	fragment@19 {
		target = <0xffffffff>;

		__overlay__ {

			lcd_kit_dura_auo_otm1901a_5p2_1080p_video_default {
				compatible = "auo_otm1901a_5p2_1080p_video_default";
				lcd-kit,panel-name = "AUO_OTM1901A 5.2' VIDEO TFT 1080 x 1920 DEFAULT";
				lcd-kit,panel-type = <0x01>;
				lcd-kit,panel-xres = <0x2d0>;
				lcd-kit,panel-yres = <0x640>;
				lcd-kit,panel-width = <0x41>;
				lcd-kit,panel-height = <0x8c>;
				lcd-kit,panel-on-cmds = <0x29 0x01 0x00 0x00 0x0a 0x00 0x02 0x00 0x00 0x29 0x01 0x00 0x00 0x0a 0x00 0x04 0xff 0x19 0x01 0x01 0x29 0x01 0x00 0x00 0x0a 0x00 0x02 0x00 0x80 0x29 0x01 0x00 0x00 0x0a 0x00 0x03 0xff 0x19 0x01 0x29 0x01 0x00 0x00 0x0a 0x00 0x02 0x00 0x88 0x29 0x01 0x00 0x00 0x0a 0x00 0x02 0xf3 0x00 0x29 0x01 0x00 0x00 0x0a 0x00 0x02 0x00 0xb0 0x29 0x01 0x00 0x00 0x0a 0x00 0x02 0xca 0x01 0x29 0x01 0x00 0x00 0x0a 0x00 0x02 0x00 0xb1 0x29 0x01 0x00 0x00 0x0a 0x00 0x02 0xca 0x01 0x29 0x01 0x00 0x00 0x0a 0x00 0x02 0x00 0xb3 0x29 0x01 0x00 0x00 0x0a 0x00 0x02 0xca 0x40 0x29 0x01 0x00 0x00 0x0a 0x00 0x02 0x00 0x00 0x29 0x01 0x00 0x00 0x0a 0x00 0x04 0xff 0xff 0xff 0xff 0x15 0x01 0x00 0x00 0x0a 0x00 0x02 0x35 0x01 0x15 0x01 0x00 0x00 0x0a 0x00 0x02 0x53 0x24 0x15 0x01 0x00 0x00 0x0a 0x00 0x02 0x55 0x00 0x15 0x01 0x00 0x00 0x0a 0x00 0x02 0x5e 0x28 0x05 0x01 0x00 0x00 0x78 0x01 0x02 0x11 0x00 0x05 0x01 0x00 0x00 0x64 0x01 0x02 0x29 0x00>;
				lcd-kit,panel-off-cmds = <0x05 0x01 0x00 0x00 0x3c 0x01 0x02 0x28 0x00 0x05 0x01 0x00 0x00 0x78 0x01 0x02 0x10 0x00>;
				lcd-kit,backlight-cmds = <0x15 0x01 0x00 0x00 0x00 0x00 0x02 0x51 0x00>;
				lcd-kit,tp-color-cmds = <0x06 0x01 0x00 0x00 0x0a 0x00 0x01 0xda>;
				lcd-kit,effect-on-cmds = <0x15 0x01 0x00 0x00 0x0a 0x00 0x02 0x55 0x81>;
				lcd-kit,panel-bl-maxnit-command = <0x06 0x01 0x00 0x00 0x0a 0x00 0x01 0xdb>;
				lcd-kit,panel-bl-maxnit-command-state = "dsi_lp_mode";
				lcd-kit,panel-lcm-type = <0x02>;
				lcd-kit,panel-ldi-dsi-mode = <0x01>;
				lcd-kit,panel-dsi-switch-mode = <0x00>;
				lcd-kit,panel-dsi-switch-mode-en = <0x00>;
				lcd-kit,panel-ldi-trans-seq = <0x00>;
				lcd-kit,panel-ldi-data-padding = <0x00>;
				lcd-kit,panel-ldi-packet-size = <0x100>;
				lcd-kit,panel-ldi-ps = <0x02>;
				lcd-kit,panel-vfp-lp = <0x00>;
				lcd-kit,panel-fbk-div = <0x01>;
				lcd-kit,panel-orientation = <0x01>;
				lcd-kit,panel-bpp = <0x02>;
				lcd-kit,panel-bgr-fmt = <0x00>;
				lcd-kit,panel-cmd-type = <0x08>;
				lcd-kit,panel-pxl-clk = <0x00>;
				lcd-kit,panel-pxl-clk-div = <0x00>;
				lcd-kit,panel-data-rate = <0x29d>;
				lcd-kit,mipi-lane-nums = <0x03>;
				lcd-kit,h-back-porch = <0x28>;
				lcd-kit,h-front-porch = <0x3c>;
				lcd-kit,h-pulse-width = <0x08>;
				lcd-kit,project-id-support = <0x01>;
				lcd-kit,default-project-id = "Y1639J1700";
				lcd-kit,v-back-porch = <0x14>;
				lcd-kit,v-front-porch = <0x0c>;
				lcd-kit,v-pulse-width = <0x04>;
				lcd-kit,mipi-clk-post-adjust = <0x00>;
				lcd-kit,mipi-lp11-flag = <0x00>;
				lcd-kit,esd-support = <0x00>;
				lcd-kit,tp-color-support = <0x01>;
				lcd-kit,lcd-vsp = <0x02 0x96 0x5b8d80>;
				lcd-kit,lcd-vsn = <0x02 0x97 0x5b8d80>;
				lcd-kit,lcd-reset = <0x02 0x2d 0x00>;
				lcd-kit,power-on-stage = <0x05 0x00 0x02 0x07 0x01 0x00 0x03 0x01 0x03 0x04 0x01 0x0a 0x05 0x01 0x02 0x05 0x00 0x02 0x05 0x01 0x0c 0x06 0x01 0x00 0x08 0x01 0x00>;
				lcd-kit,lp-on-stage = <0x00 0x00 0x00>;
				lcd-kit,hs-on-stage = <0x00 0x00 0x00>;
				lcd-kit,hs-off-stage = <0x00 0x00 0x00>;
				lcd-kit,lp-off-stage = <0x00 0x00 0x00>;
				lcd-kit,power-off-stage = <0x07 0x00 0x00 0x06 0x00 0x00 0x08 0x00 0x00 0x05 0x00 0x02 0x04 0x00 0x00 0x03 0x00 0x05>;
				lcd-kit,pt-support = <0x01>;
				lcd-kit,panel-density = <0x140>;
				lcd-kit,ssc-disable = <0x01>;
				lcd-kit,inversion-support = <0x00>;
				lcd-kit,check-reg-support = <0x00>;
				lcd-kit,panel-bl-min = <0x1e>;
				lcd-kit,panel-bl-max = <0x20d0>;
				lcd-kit,panel-bl-max-nit = <0x1c2>;
				lcd-kit,mipi-non-continue-enable = <0x00>;
				lcd-kit,panel-getblmaxnit-type = <0x01>;
				lcd-kit,panel-bl-ic-ctrl-type = <0x00>;
				lcd-kit,panel-bias-ic-ctrl-type = <0x00>;
				lcd-kit,panel-gpio-offset = <0x00>;
				phandle = <0x3d>;
			};
		};
	};

	fragment@20 {
		target = <0xffffffff>;

		__overlay__ {

			lcd_kit_dura_boe_gc9702p_5p45 {
				compatible = "boe_gc9702p_5p45_720p_video";
				lcd-kit,panel-name = "BOE_GC9702P 5.45' VIDEO TFT 720 x 1440";
				lcd-kit,panel-type = <0x01>;
				lcd-kit,panel-xres = <0x2d0>;
				lcd-kit,panel-yres = <0x5a0>;
				lcd-kit,panel-width = <0x3e>;
				lcd-kit,panel-height = <0x7c>;
				lcd-kit,panel-on-cmds = <0x29 0x01 0x00 0x00 0x0a 0x00 0x04 0xd5 0x61 0x74 0x97 0x29 0x01 0x00 0x00 0x0a 0x00 0x02 0xd0 0x10 0x29 0x01 0x00 0x00 0x0a 0x00 0x02 0x60 0x07 0x29 0x01 0x00 0x00 0x0a 0x00 0x02 0x61 0x3f 0x29 0x01 0x00 0x00 0x0a 0x00 0x02 0x62 0xc3 0x29 0x01 0x00 0x00 0x0a 0x00 0x02 0x63 0x17 0x29 0x01 0x00 0x00 0x0a 0x00 0x02 0x64 0x02 0x29 0x01 0x00 0x00 0x0a 0x00 0x02 0x66 0x40 0x29 0x01 0x00 0x00 0x0a 0x00 0x02 0x67 0x08 0x29 0x01 0x00 0x00 0x0a 0x00 0x02 0x68 0xfb 0x29 0x01 0x00 0x00 0x0a 0x00 0x02 0x69 0x02 0x29 0x01 0x00 0x00 0x0a 0x00 0x02 0x6a 0x0c 0x29 0x01 0x00 0x00 0x0a 0x00 0x02 0x6b 0x7e 0x29 0x01 0x00 0x00 0x0a 0x00 0x02 0xb6 0x22 0x29 0x01 0x00 0x00 0x0a 0x00 0x02 0xa5 0x1b 0x29 0x01 0x00 0x00 0x0a 0x00 0x02 0xa1 0xff 0x29 0x01 0x00 0x00 0x0a 0x00 0x02 0xa4 0x55 0x29 0x01 0x00 0x00 0x0a 0x00 0x02 0xa6 0x9c 0x29 0x01 0x00 0x00 0x0a 0x00 0x02 0xa7 0x30 0x29 0x01 0x00 0x00 0x0a 0x00 0x02 0xa0 0xaa 0x29 0x01 0x00 0x00 0x0a 0x00 0x02 0xf1 0x54 0x29 0x01 0x00 0x00 0x0a 0x00 0x02 0xf2 0x03 0x29 0x01 0x00 0x00 0x0a 0x00 0x02 0xe8 0x0f 0x29 0x01 0x00 0x00 0x0a 0x00 0x02 0xe9 0xff 0x29 0x01 0x00 0x00 0x0a 0x00 0x02 0xea 0x4f 0x29 0x01 0x00 0x00 0x0a 0x00 0x04 0x9d 0x9d 0x9d 0x9d 0x29 0x01 0x00 0x00 0x0a 0x00 0x03 0xc1 0x01 0x5f 0x29 0x01 0x00 0x00 0x0a 0x00 0x02 0xff 0xff 0x29 0x01 0x00 0x00 0x0a 0x00 0x02 0xff 0xff 0x29 0x01 0x00 0x00 0x0a 0x00 0x02 0xff 0xff 0x29 0x01 0x00 0x00 0x0a 0x00 0x02 0xff 0xff 0x29 0x01 0x00 0x00 0x0a 0x00 0x02 0xd0 0x11 0x29 0x01 0x00 0x00 0x0a 0x00 0x02 0x60 0x06 0x29 0x01 0x00 0x00 0x0a 0x00 0x02 0x62 0xc8 0x29 0x01 0x00 0x00 0x0a 0x00 0x02 0x63 0x60 0x29 0x01 0x00 0x00 0x0a 0x00 0x02 0x64 0x04 0x29 0x01 0x00 0x00 0x0a 0x00 0x02 0x66 0x89 0x29 0x01 0x00 0x00 0x0a 0x00 0x02 0x67 0x13 0x29 0x01 0x00 0x00 0x0a 0x00 0x02 0x68 0x89 0x29 0x01 0x00 0x00 0x0a 0x00 0x02 0x69 0xc3 0x29 0x01 0x00 0x00 0x0a 0x00 0x03 0xb8 0x05 0x50 0x29 0x01 0x00 0x00 0x0a 0x00 0x02 0xb9 0xc3 0x29 0x01 0x00 0x00 0x0a 0x00 0x02 0xb7 0x07 0x29 0x01 0x00 0x00 0x0a 0x00 0x03 0xbc 0x00 0x1b 0x29 0x01 0x00 0x00 0x0a 0x00 0x2d 0xb3 0x35 0x36 0x07 0x01 0x24 0x26 0x18 0x1a 0x3f 0x3f 0x3f 0x3f 0x3f 0x3f 0x3f 0x3f 0x3f 0x34 0x34 0x34 0x33 0x38 0x35 0x36 0x06 0x00 0x14 0x16 0x08 0x0a 0x3f 0x3f 0x3f 0x3f 0x3f 0x3f 0x3f 0x3f 0x3f 0x34 0x34 0x34 0x33 0x38 0x29 0x01 0x00 0x00 0x0a 0x00 0x09 0xa0 0x30 0x13 0x15 0x6d 0x30 0x14 0x15 0x6d 0x29 0x01 0x00 0x00 0x0a 0x00 0x09 0xa3 0x30 0x15 0x15 0x6d 0x30 0x16 0x15 0x6d 0x29 0x01 0x00 0x00 0x0a 0x00 0x06 0xa7 0x33 0x15 0x6d 0x15 0x6d 0x29 0x01 0x00 0x00 0x0a 0x00 0x0b 0xa8 0x00 0x15 0x05 0xbd 0x03 0x00 0x16 0x05 0xbe 0x03 0x29 0x01 0x00 0x00 0x0a 0x00 0x0b 0xa9 0x00 0x17 0x05 0xbf 0x03 0x00 0x18 0x05 0xc0 0x03 0x29 0x01 0x00 0x00 0x0a 0x00 0x0b 0xae 0x00 0x19 0x05 0xc1 0x03 0x00 0x1a 0x05 0xc2 0x03 0x29 0x01 0x00 0x00 0x0a 0x00 0x0b 0xaf 0x00 0x1b 0x05 0xc3 0x03 0x00 0x1c 0x05 0xc4 0x03 0x29 0x01 0x00 0x00 0x0a 0x00 0x08 0xb0 0x12 0x22 0x12 0x22 0x22 0x22 0x44 0x29 0x01 0x00 0x00 0x0a 0x00 0x04 0xe7 0x01 0x01 0x6f 0x29 0x01 0x00 0x00 0x0a 0x00 0x02 0xed 0x07 0x29 0x01 0x00 0x00 0x0a 0x00 0x02 0xee 0x75 0x29 0x01 0x00 0x00 0x0a 0x00 0x04 0xe6 0xe7 0x1a 0x70 0x29 0x01 0x00 0x00 0x0a 0x00 0x14 0xf1 0x7f 0x73 0x69 0x60 0x61 0x54 0x5a 0x44 0x5c 0x57 0x4f 0x65 0x4c 0x51 0x40 0x3a 0x35 0x26 0x00 0x29 0x01 0x00 0x00 0x0a 0x00 0x14 0xf2 0x7f 0x73 0x69 0x60 0x61 0x54 0x5a 0x44 0x5c 0x57 0x4f 0x65 0x4c 0x51 0x40 0x3a 0x35 0x26 0x00 0x29 0x01 0x00 0x00 0x0a 0x00 0x03 0xe3 0x00 0x00 0x29 0x01 0x00 0x00 0x0a 0x00 0x02 0xc2 0x00 0x29 0x01 0x00 0x00 0x0a 0x00 0x02 0xff 0xff 0x29 0x01 0x00 0x00 0x0a 0x00 0x02 0xff 0xff 0x29 0x01 0x00 0x00 0x0a 0x00 0x02 0xff 0xff 0x29 0x01 0x00 0x00 0x0a 0x00 0x02 0xff 0xff 0x29 0x01 0x00 0x00 0x0a 0x00 0x02 0xd0 0x00 0x29 0x01 0x00 0x00 0x0a 0x00 0x02 0xff 0xff 0x29 0x01 0x00 0x00 0x0a 0x00 0x02 0x35 0x00 0x29 0x01 0x00 0x00 0x0a 0x00 0x02 0x53 0x24 0x29 0x01 0x00 0x00 0x0a 0x00 0x02 0x51 0x00 0x29 0x01 0x00 0x00 0x64 0x01 0x02 0x11 0x00 0x29 0x01 0x00 0x00 0x01 0x01 0x02 0x29 0x00>;
				lcd-kit,panel-on-cmds-state = "dsi_lp_mode";
				lcd-kit,panel-off-cmds = <0x05 0x01 0x00 0x00 0x14 0x01 0x02 0x28 0x00 0x05 0x01 0x00 0x00 0x3c 0x01 0x02 0x10 0x00>;
				lcd-kit,panel-off-cmds-state = "dsi_lp_mode";
				lcd-kit,backlight-cmds = <0x15 0x01 0x00 0x00 0x00 0x00 0x02 0x51 0x00>;
				lcd-kit,backlight-cmds-state = "dsi_lp_mode";
				lcd-kit,tp-color-cmds = <0x06 0x01 0x00 0x00 0x0a 0x00 0x01 0xda>;
				lcd-kit,inversion-dot-cmds = <0x29 0x01 0x00 0x00 0x05 0x01 0x02 0xb7 0x03>;
				lcd-kit,inversion-column-cmds = <0x29 0x01 0x00 0x00 0x05 0x01 0x02 0xb7 0x04>;
				lcd-kit,esd-reg-cmds = <0x06 0x01 0x00 0x00 0x0a 0x00 0x01 0x0a 0x06 0x01 0x00 0x00 0x0a 0x00 0x01 0x0d 0x06 0x01 0x00 0x00 0x0a 0x00 0x01 0x54>;
				lcd-kit,esd-reg-cmds-state = "dsi_lp_mode";
				lcd-kit,esd-value = <0x9c 0x00 0x24>;
				lcd-kit,check-reg-cmds = <0x06 0x01 0x00 0x00 0x0a 0x00 0x01 0x0a>;
				lcd-kit,check-reg-cmds-state = "dsi_lp_mode";
				lcd-kit,check-reg-value = <0x9c>;
				lcd-kit,barcode-2d-cmds;
				lcd-kit,project-id-cmds;
				lcd-kit,project-id-cmds-state = "dsi_lp_mode";
				lcd-kit,panel-bl-maxnit-command = <0x06 0x01 0x00 0x00 0x0a 0x00 0x01 0xdb>;
				lcd-kit,panel-bl-maxnit-command-state = "dsi_lp_mode";
				lcd-kit,panel-lcm-type = <0x02>;
				lcd-kit,panel-ldi-dsi-mode = <0x01>;
				lcd-kit,panel-dsi-switch-mode = <0x00>;
				lcd-kit,panel-dsi-switch-mode-en = <0x00>;
				lcd-kit,panel-ldi-trans-seq = <0x00>;
				lcd-kit,panel-ldi-data-padding = <0x00>;
				lcd-kit,panel-ldi-packet-size = <0x100>;
				lcd-kit,panel-ldi-ps = <0x02>;
				lcd-kit,panel-vfp-lp = <0x00>;
				lcd-kit,panel-fbk-div = <0x01>;
				lcd-kit,panel-orientation = <0x01>;
				lcd-kit,panel-bpp = <0x02>;
				lcd-kit,panel-bgr-fmt = <0x00>;
				lcd-kit,panel-cmd-type = <0x08>;
				lcd-kit,panel-pxl-clk = <0x00>;
				lcd-kit,panel-pxl-clk-div = <0x00>;
				lcd-kit,panel-data-rate = <0x2a0>;
				lcd-kit,mipi-lane-nums = <0x03>;
				lcd-kit,h-back-porch = <0x48>;
				lcd-kit,h-front-porch = <0x3c>;
				lcd-kit,h-pulse-width = <0x08>;
				lcd-kit,project-id-support = <0x00>;
				lcd-kit,default-project-id = "Y1639J1700";
				lcd-kit,v-back-porch = <0x28>;
				lcd-kit,v-front-porch = <0x28>;
				lcd-kit,v-pulse-width = <0x08>;
				lcd-kit,mipi-clk-post-adjust = <0x00>;
				lcd-kit,mipi-lp11-flag = <0x00>;
				lcd-kit,esd-support = <0x01>;
				lcd-kit,esd-recovery-bl-support = <0x01>;
				lcd-kit,esd-te-check-support = <0x01>;
				lcd-kit,tp-color-support = <0x00>;
				lcd-kit,lcd-vsp = <0x02 0x96 0x53ec60>;
				lcd-kit,lcd-vsn = <0x02 0x97 0x53ec60>;
				lcd-kit,lcd-reset = <0x02 0x2d 0x00>;
				lcd-kit,power-on-stage = <0x03 0x01 0x00 0x04 0x01 0x05 0x0b 0x01 0x00 0x05 0x01 0x0a 0x05 0x02 0x01 0x05 0x01 0x0a 0x07 0x01 0x00 0x06 0x01 0x00 0x08 0x01 0x00>;
				lcd-kit,lp-on-stage = <0x00 0x00 0x00>;
				lcd-kit,hs-on-stage = <0x00 0x00 0x00>;
				lcd-kit,hs-off-stage = <0x00 0x00 0x00>;
				lcd-kit,lp-off-stage = <0x00 0x00 0x00>;
				lcd-kit,power-off-stage = <0x07 0x00 0x00 0x06 0x00 0x00 0x08 0x00 0x00 0x05 0x00 0x0a 0x04 0x00 0x00 0x03 0x00 0x06>;
				lcd-kit,pt-support = <0x01>;
				lcd-kit,panel-density = <0x140>;
				lcd-kit,ssc-disable = <0x00>;
				lcd-kit,ssc-range = <0x03>;
				lcd-kit,inversion-support = <0x01>;
				lcd-kit,check-reg-support = <0x01>;
				lcd-kit,panel-bl-min = <0x03>;
				lcd-kit,panel-bl-max = <0xff>;
				lcd-kit,panel-bl-max-nit = <0x1c2>;
				lcd-kit,mipi-non-continue-enable = <0x01>;
				lcd-kit,panel-getblmaxnit-type = <0x01>;
				lcd-kit,panel-bl-ic-ctrl-type = <0x08>;
				lcd-kit,panel-bias-ic-ctrl-type = <0x03>;
				lcd-kit,oem-info-support = <0x00>;
				lcd-kit,oem-barcode-2d-support = <0x00>;
				lcd-kit,oem-barcode-2d-num-offset = <0x00>;
				lcd-kit,panel-on-always-reset = <0x01>;
				lcd-kit,panel-gpio-offset = <0x149>;
				phandle = <0x3e>;
			};
		};
	};

	fragment@21 {
		target = <0xffffffff>;

		__overlay__ {

			lcd_kit_dura_boe_ili9881c_5p45 {
				compatible = "boe_ili9881c_5p45_720p_video";
				lcd-kit,panel-name = "BOE_ILI9881C 5.45' VIDEO TFT 720 x 1440";
				lcd-kit,panel-type = <0x01>;
				lcd-kit,panel-xres = <0x2d0>;
				lcd-kit,panel-yres = <0x5a0>;
				lcd-kit,panel-width = <0x3e>;
				lcd-kit,panel-height = <0x7c>;
				lcd-kit,panel-on-cmds = <0x29 0x01 0x00 0x00 0x0a 0x00 0x04 0xff 0x98 0x81 0x03 0x29 0x01 0x00 0x00 0x0a 0x00 0x02 0x01 0x00 0x29 0x01 0x00 0x00 0x0a 0x00 0x02 0x02 0x00 0x29 0x01 0x00 0x00 0x0a 0x00 0x02 0x03 0x73 0x29 0x01 0x00 0x00 0x0a 0x00 0x02 0x04 0x00 0x29 0x01 0x00 0x00 0x0a 0x00 0x02 0x05 0x00 0x29 0x01 0x00 0x00 0x0a 0x00 0x02 0x06 0x08 0x29 0x01 0x00 0x00 0x0a 0x00 0x02 0x07 0x00 0x29 0x01 0x00 0x00 0x0a 0x00 0x02 0x08 0x00 0x29 0x01 0x00 0x00 0x0a 0x00 0x02 0x09 0x00 0x29 0x01 0x00 0x00 0x0a 0x00 0x02 0x0a 0x00 0x29 0x01 0x00 0x00 0x0a 0x00 0x02 0x0b 0x00 0x29 0x01 0x00 0x00 0x0a 0x00 0x02 0x0c 0x0b 0x29 0x01 0x00 0x00 0x0a 0x00 0x02 0x0d 0x00 0x29 0x01 0x00 0x00 0x0a 0x00 0x02 0x0e 0x00 0x29 0x01 0x00 0x00 0x0a 0x00 0x02 0x0f 0x26 0x29 0x01 0x00 0x00 0x0a 0x00 0x02 0x10 0x26 0x29 0x01 0x00 0x00 0x0a 0x00 0x02 0x11 0x00 0x29 0x01 0x00 0x00 0x0a 0x00 0x02 0x12 0x00 0x29 0x01 0x00 0x00 0x0a 0x00 0x02 0x13 0x02 0x29 0x01 0x00 0x00 0x0a 0x00 0x02 0x14 0x00 0x29 0x01 0x00 0x00 0x0a 0x00 0x02 0x15 0x00 0x29 0x01 0x00 0x00 0x0a 0x00 0x02 0x16 0x00 0x29 0x01 0x00 0x00 0x0a 0x00 0x02 0x17 0x00 0x29 0x01 0x00 0x00 0x0a 0x00 0x02 0x18 0x00 0x29 0x01 0x00 0x00 0x0a 0x00 0x02 0x19 0x00 0x29 0x01 0x00 0x00 0x0a 0x00 0x02 0x1a 0x00 0x29 0x01 0x00 0x00 0x0a 0x00 0x02 0x1b 0x00 0x29 0x01 0x00 0x00 0x0a 0x00 0x02 0x1c 0x00 0x29 0x01 0x00 0x00 0x0a 0x00 0x02 0x1d 0x00 0x29 0x01 0x00 0x00 0x0a 0x00 0x02 0x1e 0x40 0x29 0x01 0x00 0x00 0x0a 0x00 0x02 0x1f 0xc0 0x29 0x01 0x00 0x00 0x0a 0x00 0x02 0x20 0x0e 0x29 0x01 0x00 0x00 0x0a 0x00 0x02 0x21 0x09 0x29 0x01 0x00 0x00 0x0a 0x00 0x02 0x22 0x00 0x29 0x01 0x00 0x00 0x0a 0x00 0x02 0x23 0x00 0x29 0x01 0x00 0x00 0x0a 0x00 0x02 0x24 0x00 0x29 0x01 0x00 0x00 0x0a 0x00 0x02 0x25 0x00 0x29 0x01 0x00 0x00 0x0a 0x00 0x02 0x26 0x00 0x29 0x01 0x00 0x00 0x0a 0x00 0x02 0x27 0x00 0x29 0x01 0x00 0x00 0x0a 0x00 0x02 0x28 0xb3 0x29 0x01 0x00 0x00 0x0a 0x00 0x02 0x29 0x03 0x29 0x01 0x00 0x00 0x0a 0x00 0x02 0x2a 0x80 0x29 0x01 0x00 0x00 0x0a 0x00 0x02 0x2b 0x00 0x29 0x01 0x00 0x00 0x0a 0x00 0x02 0x2c 0x05 0x29 0x01 0x00 0x00 0x0a 0x00 0x02 0x2d 0x01 0x29 0x01 0x00 0x00 0x0a 0x00 0x02 0x2e 0x0d 0x29 0x01 0x00 0x00 0x0a 0x00 0x02 0x2f 0x00 0x29 0x01 0x00 0x00 0x0a 0x00 0x02 0x30 0x00 0x29 0x01 0x00 0x00 0x0a 0x00 0x02 0x31 0x00 0x29 0x01 0x00 0x00 0x0a 0x00 0x02 0x32 0x00 0x29 0x01 0x00 0x00 0x0a 0x00 0x02 0x33 0x30 0x29 0x01 0x00 0x00 0x0a 0x00 0x02 0x34 0xa3 0x29 0x01 0x00 0x00 0x0a 0x00 0x02 0x35 0x05 0x29 0x01 0x00 0x00 0x0a 0x00 0x02 0x36 0x03 0x29 0x01 0x00 0x00 0x0a 0x00 0x02 0x37 0x00 0x29 0x01 0x00 0x00 0x0a 0x00 0x02 0x38 0x00 0x29 0x01 0x00 0x00 0x0a 0x00 0x02 0x39 0x00 0x29 0x01 0x00 0x00 0x0a 0x00 0x02 0x3a 0x00 0x29 0x01 0x00 0x00 0x0a 0x00 0x02 0x3b 0x00 0x29 0x01 0x00 0x00 0x0a 0x00 0x02 0x3c 0x00 0x29 0x01 0x00 0x00 0x0a 0x00 0x02 0x3d 0x00 0x29 0x01 0x00 0x00 0x0a 0x00 0x02 0x3e 0x00 0x29 0x01 0x00 0x00 0x0a 0x00 0x02 0x3f 0x00 0x29 0x01 0x00 0x00 0x0a 0x00 0x02 0x40 0x00 0x29 0x01 0x00 0x00 0x0a 0x00 0x02 0x41 0x00 0x29 0x01 0x00 0x00 0x0a 0x00 0x02 0x42 0x00 0x29 0x01 0x00 0x00 0x0a 0x00 0x02 0x43 0x08 0x29 0x01 0x00 0x00 0x0a 0x00 0x02 0x44 0x00 0x29 0x01 0x00 0x00 0x0a 0x00 0x02 0x50 0x01 0x29 0x01 0x00 0x00 0x0a 0x00 0x02 0x51 0x23 0x29 0x01 0x00 0x00 0x0a 0x00 0x02 0x52 0x45 0x29 0x01 0x00 0x00 0x0a 0x00 0x02 0x53 0x67 0x29 0x01 0x00 0x00 0x0a 0x00 0x02 0x54 0x89 0x29 0x01 0x00 0x00 0x0a 0x00 0x02 0x55 0xab 0x29 0x01 0x00 0x00 0x0a 0x00 0x02 0x56 0x01 0x29 0x01 0x00 0x00 0x0a 0x00 0x02 0x57 0x23 0x29 0x01 0x00 0x00 0x0a 0x00 0x02 0x58 0x45 0x29 0x01 0x00 0x00 0x0a 0x00 0x02 0x59 0x67 0x29 0x01 0x00 0x00 0x0a 0x00 0x02 0x5a 0x89 0x29 0x01 0x00 0x00 0x0a 0x00 0x02 0x5b 0xab 0x29 0x01 0x00 0x00 0x0a 0x00 0x02 0x5c 0xcd 0x29 0x01 0x00 0x00 0x0a 0x00 0x02 0x5d 0xef 0x29 0x01 0x00 0x00 0x0a 0x00 0x02 0x5e 0x11 0x29 0x01 0x00 0x00 0x0a 0x00 0x02 0x5f 0x02 0x29 0x01 0x00 0x00 0x0a 0x00 0x02 0x60 0x00 0x29 0x01 0x00 0x00 0x0a 0x00 0x02 0x61 0x07 0x29 0x01 0x00 0x00 0x0a 0x00 0x02 0x62 0x06 0x29 0x01 0x00 0x00 0x0a 0x00 0x02 0x63 0x0e 0x29 0x01 0x00 0x00 0x0a 0x00 0x02 0x64 0x0f 0x29 0x01 0x00 0x00 0x0a 0x00 0x02 0x65 0x0c 0x29 0x01 0x00 0x00 0x0a 0x00 0x02 0x66 0x0d 0x29 0x01 0x00 0x00 0x0a 0x00 0x02 0x67 0x02 0x29 0x01 0x00 0x00 0x0a 0x00 0x02 0x68 0x02 0x29 0x01 0x00 0x00 0x0a 0x00 0x02 0x69 0x02 0x29 0x01 0x00 0x00 0x0a 0x00 0x02 0x6a 0x02 0x29 0x01 0x00 0x00 0x0a 0x00 0x02 0x6b 0x02 0x29 0x01 0x00 0x00 0x0a 0x00 0x02 0x6c 0x02 0x29 0x01 0x00 0x00 0x0a 0x00 0x02 0x6d 0x02 0x29 0x01 0x00 0x00 0x0a 0x00 0x02 0x6e 0x02 0x29 0x01 0x00 0x00 0x0a 0x00 0x02 0x6f 0x02 0x29 0x01 0x00 0x00 0x0a 0x00 0x02 0x70 0x02 0x29 0x01 0x00 0x00 0x0a 0x00 0x02 0x71 0x02 0x29 0x01 0x00 0x00 0x0a 0x00 0x02 0x72 0x02 0x29 0x01 0x00 0x00 0x0a 0x00 0x02 0x73 0x05 0x29 0x01 0x00 0x00 0x0a 0x00 0x02 0x74 0x01 0x29 0x01 0x00 0x00 0x0a 0x00 0x02 0x75 0x02 0x29 0x01 0x00 0x00 0x0a 0x00 0x02 0x76 0x00 0x29 0x01 0x00 0x00 0x0a 0x00 0x02 0x77 0x07 0x29 0x01 0x00 0x00 0x0a 0x00 0x02 0x78 0x06 0x29 0x01 0x00 0x00 0x0a 0x00 0x02 0x79 0x0e 0x29 0x01 0x00 0x00 0x0a 0x00 0x02 0x7a 0x0f 0x29 0x01 0x00 0x00 0x0a 0x00 0x02 0x7b 0x0c 0x29 0x01 0x00 0x00 0x0a 0x00 0x02 0x7c 0x0d 0x29 0x01 0x00 0x00 0x0a 0x00 0x02 0x7d 0x02 0x29 0x01 0x00 0x00 0x0a 0x00 0x02 0x7e 0x02 0x29 0x01 0x00 0x00 0x0a 0x00 0x02 0x7f 0x02 0x29 0x01 0x00 0x00 0x0a 0x00 0x02 0x80 0x02 0x29 0x01 0x00 0x00 0x0a 0x00 0x02 0x81 0x02 0x29 0x01 0x00 0x00 0x0a 0x00 0x02 0x82 0x02 0x29 0x01 0x00 0x00 0x0a 0x00 0x02 0x83 0x02 0x29 0x01 0x00 0x00 0x0a 0x00 0x02 0x84 0x02 0x29 0x01 0x00 0x00 0x0a 0x00 0x02 0x85 0x02 0x29 0x01 0x00 0x00 0x0a 0x00 0x02 0x86 0x02 0x29 0x01 0x00 0x00 0x0a 0x00 0x02 0x87 0x02 0x29 0x01 0x00 0x00 0x0a 0x00 0x02 0x88 0x02 0x29 0x01 0x00 0x00 0x0a 0x00 0x02 0x89 0x05 0x29 0x01 0x00 0x00 0x0a 0x00 0x02 0x8a 0x01 0x29 0x01 0x00 0x00 0x0a 0x00 0x04 0xff 0x98 0x81 0x04 0x29 0x01 0x00 0x00 0x0a 0x00 0x02 0x0b 0x90 0x29 0x01 0x00 0x00 0x0a 0x00 0x02 0x0e 0x0b 0x29 0x01 0x00 0x00 0x0a 0x00 0x02 0x00 0x00 0x29 0x01 0x00 0x00 0x0a 0x00 0x02 0x6c 0x15 0x29 0x01 0x00 0x00 0x0a 0x00 0x02 0x6e 0x1a 0x29 0x01 0x00 0x00 0x0a 0x00 0x02 0x6f 0xa5 0x29 0x01 0x00 0x00 0x0a 0x00 0x02 0x35 0x1f 0x29 0x01 0x00 0x00 0x0a 0x00 0x02 0x3a 0xa9 0x29 0x01 0x00 0x00 0x0a 0x00 0x02 0x3b 0x98 0x29 0x01 0x00 0x00 0x0a 0x00 0x02 0x8d 0x2a 0x29 0x01 0x00 0x00 0x0a 0x00 0x02 0x87 0xba 0x29 0x01 0x00 0x00 0x0a 0x00 0x02 0xb2 0xd1 0x29 0x01 0x00 0x00 0x0a 0x00 0x02 0xb5 0x07 0x29 0x01 0x00 0x00 0x0a 0x00 0x02 0x33 0x14 0x29 0x01 0x00 0x00 0x0a 0x00 0x02 0x38 0x01 0x29 0x01 0x00 0x00 0x0a 0x00 0x02 0x39 0x00 0x29 0x01 0x00 0x00 0x0a 0x00 0x02 0x92 0x0f 0x29 0x01 0x00 0x00 0x0a 0x00 0x04 0xff 0x98 0x81 0x01 0x29 0x01 0x00 0x00 0x0a 0x00 0x02 0x22 0x0a 0x29 0x01 0x00 0x00 0x0a 0x00 0x02 0x2e 0xf0 0x29 0x01 0x00 0x00 0x0a 0x00 0x02 0x31 0x00 0x29 0x01 0x00 0x00 0x0a 0x00 0x02 0x53 0x93 0x29 0x01 0x00 0x00 0x0a 0x00 0x02 0x55 0x93 0x29 0x01 0x00 0x00 0x0a 0x00 0x02 0x50 0xc9 0x29 0x01 0x00 0x00 0x0a 0x00 0x02 0x51 0xc5 0x29 0x01 0x00 0x00 0x0a 0x00 0x02 0x60 0x14 0x29 0x01 0x00 0x00 0x0a 0x00 0x02 0x61 0x00 0x29 0x01 0x00 0x00 0x0a 0x00 0x02 0x62 0x20 0x29 0x01 0x00 0x00 0x0a 0x00 0x02 0x63 0x10 0x29 0x01 0x00 0x00 0x0a 0x00 0x02 0xa0 0x08 0x29 0x01 0x00 0x00 0x0a 0x00 0x02 0xa1 0x14 0x29 0x01 0x00 0x00 0x0a 0x00 0x02 0xa2 0x1d 0x29 0x01 0x00 0x00 0x0a 0x00 0x02 0xa3 0x0f 0x29 0x01 0x00 0x00 0x0a 0x00 0x02 0xa4 0x11 0x29 0x01 0x00 0x00 0x0a 0x00 0x02 0xa5 0x22 0x29 0x01 0x00 0x00 0x0a 0x00 0x02 0xa6 0x18 0x29 0x01 0x00 0x00 0x0a 0x00 0x02 0xa7 0x1b 0x29 0x01 0x00 0x00 0x0a 0x00 0x02 0xa8 0x6f 0x29 0x01 0x00 0x00 0x0a 0x00 0x02 0xa9 0x1b 0x29 0x01 0x00 0x00 0x0a 0x00 0x02 0xaa 0x27 0x29 0x01 0x00 0x00 0x0a 0x00 0x02 0xab 0x6a 0x29 0x01 0x00 0x00 0x0a 0x00 0x02 0xac 0x1e 0x29 0x01 0x00 0x00 0x0a 0x00 0x02 0xad 0x1f 0x29 0x01 0x00 0x00 0x0a 0x00 0x02 0xae 0x52 0x29 0x01 0x00 0x00 0x0a 0x00 0x02 0xaf 0x26 0x29 0x01 0x00 0x00 0x0a 0x00 0x02 0xb0 0x2a 0x29 0x01 0x00 0x00 0x0a 0x00 0x02 0xb1 0x51 0x29 0x01 0x00 0x00 0x0a 0x00 0x02 0xb2 0x60 0x29 0x01 0x00 0x00 0x0a 0x00 0x02 0xb3 0x39 0x29 0x01 0x00 0x00 0x0a 0x00 0x02 0xc0 0x08 0x29 0x01 0x00 0x00 0x0a 0x00 0x02 0xc1 0x14 0x29 0x01 0x00 0x00 0x0a 0x00 0x02 0xc2 0x1d 0x29 0x01 0x00 0x00 0x0a 0x00 0x02 0xc3 0x0f 0x29 0x01 0x00 0x00 0x0a 0x00 0x02 0xc4 0x11 0x29 0x01 0x00 0x00 0x0a 0x00 0x02 0xc5 0x22 0x29 0x01 0x00 0x00 0x0a 0x00 0x02 0xc6 0x18 0x29 0x01 0x00 0x00 0x0a 0x00 0x02 0xc7 0x1b 0x29 0x01 0x00 0x00 0x0a 0x00 0x02 0xc8 0x6f 0x29 0x01 0x00 0x00 0x0a 0x00 0x02 0xc9 0x1b 0x29 0x01 0x00 0x00 0x0a 0x00 0x02 0xca 0x27 0x29 0x01 0x00 0x00 0x0a 0x00 0x02 0xcb 0x6a 0x29 0x01 0x00 0x00 0x0a 0x00 0x02 0xcc 0x1e 0x29 0x01 0x00 0x00 0x0a 0x00 0x02 0xcd 0x1f 0x29 0x01 0x00 0x00 0x0a 0x00 0x02 0xce 0x52 0x29 0x01 0x00 0x00 0x0a 0x00 0x02 0xcf 0x26 0x29 0x01 0x00 0x00 0x0a 0x00 0x02 0xd0 0x2a 0x29 0x01 0x00 0x00 0x0a 0x00 0x02 0xd1 0x51 0x29 0x01 0x00 0x00 0x0a 0x00 0x02 0xd2 0x60 0x29 0x01 0x00 0x00 0x0a 0x00 0x02 0xd3 0x39 0x29 0x01 0x00 0x00 0x0a 0x00 0x02 0x34 0x01 0x29 0x01 0x00 0x00 0x0a 0x00 0x04 0xff 0x98 0x81 0x02 0x29 0x01 0x00 0x00 0x0a 0x00 0x02 0x03 0x4d 0x29 0x01 0x00 0x00 0x0a 0x00 0x02 0x04 0x45 0x29 0x01 0x00 0x00 0x0a 0x00 0x02 0x05 0x44 0x29 0x01 0x00 0x00 0x0a 0x00 0x02 0x06 0x00 0x29 0x01 0x00 0x00 0x0a 0x00 0x02 0x07 0x00 0x29 0x01 0x00 0x00 0x0a 0x00 0x04 0xff 0x98 0x81 0x00 0x29 0x01 0x00 0x00 0x0a 0x00 0x03 0x51 0x00 0x00 0x29 0x01 0x00 0x00 0x0a 0x00 0x02 0x53 0x2c 0x29 0x01 0x00 0x00 0x0a 0x00 0x02 0x55 0x00 0x29 0x01 0x00 0x00 0x0a 0x00 0x02 0x35 0x00 0x29 0x01 0x00 0x00 0x41 0x01 0x02 0x11 0x00 0x29 0x01 0x00 0x00 0x14 0x01 0x02 0x29 0x00>;
				lcd-kit,panel-on-cmds-state = "dsi_lp_mode";
				lcd-kit,panel-off-cmds = <0x05 0x01 0x00 0x00 0x14 0x01 0x02 0x28 0x00 0x05 0x01 0x00 0x00 0x3c 0x01 0x02 0x10 0x00>;
				lcd-kit,panel-off-cmds-state = "dsi_lp_mode";
				lcd-kit,backlight-cmds = <0x29 0x01 0x00 0x00 0x00 0x00 0x03 0x51 0x00 0x00>;
				lcd-kit,backlight-cmds-state = "dsi_lp_mode";
				lcd-kit,tp-color-cmds = <0x06 0x01 0x00 0x00 0x0a 0x00 0x01 0xda>;
				lcd-kit,inversion-dot-cmds = <0x29 0x01 0x00 0x00 0x05 0x01 0x04 0xff 0x98 0x81 0x01 0x29 0x01 0x00 0x00 0x0a 0x00 0x02 0x50 0x42 0x29 0x01 0x00 0x00 0x0a 0x00 0x02 0x51 0x42 0x29 0x01 0x00 0x00 0x0a 0x00 0x02 0x62 0x2f 0x29 0x01 0x00 0x00 0x0a 0x00 0x02 0x63 0x10 0x29 0x01 0x00 0x00 0x05 0x01 0x02 0x31 0x04 0x29 0x01 0x00 0x00 0x0a 0x00 0x04 0xff 0x98 0x81 0x00>;
				lcd-kit,inversion-column-cmds = <0x29 0x01 0x00 0x00 0x05 0x01 0x04 0xff 0x98 0x81 0x01 0x29 0x01 0x00 0x00 0x0a 0x00 0x02 0x31 0x00 0x29 0x01 0x00 0x00 0x0a 0x00 0x02 0x50 0xc9 0x29 0x01 0x00 0x00 0x0a 0x00 0x02 0x51 0xc5 0x29 0x01 0x00 0x00 0x0a 0x00 0x02 0x62 0x20 0x29 0x01 0x00 0x00 0x0a 0x00 0x02 0x63 0x10 0x29 0x01 0x00 0x00 0x0a 0x00 0x04 0xff 0x98 0x81 0x00>;
				lcd-kit,esd-reg-cmds = <0x06 0x01 0x00 0x00 0x0a 0x00 0x01 0x54 0x06 0x01 0x00 0x00 0x0a 0x00 0x03 0x09 0x00 0x00>;
				lcd-kit,esd-reg-cmds-state = "dsi_lp_mode";
				lcd-kit,esd-value = <0x2c 0x80 0x03 0x06>;
				lcd-kit,check-reg-cmds = <0x06 0x01 0x00 0x00 0x0a 0x00 0x01 0x0a>;
				lcd-kit,check-reg-cmds-state = "dsi_lp_mode";
				lcd-kit,check-reg-value = <0x9c>;
				lcd-kit,barcode-2d-cmds;
				lcd-kit,project-id-cmds;
				lcd-kit,project-id-cmds-state = "dsi_lp_mode";
				lcd-kit,panel-bl-maxnit-command = <0x06 0x01 0x00 0x00 0x0a 0x00 0x01 0xdb>;
				lcd-kit,panel-bl-maxnit-command-state = "dsi_lp_mode";
				lcd-kit,panel-lcm-type = <0x02>;
				lcd-kit,panel-ldi-dsi-mode = <0x01>;
				lcd-kit,panel-dsi-switch-mode = <0x00>;
				lcd-kit,panel-dsi-switch-mode-en = <0x00>;
				lcd-kit,panel-ldi-trans-seq = <0x00>;
				lcd-kit,panel-ldi-data-padding = <0x00>;
				lcd-kit,panel-ldi-packet-size = <0x100>;
				lcd-kit,panel-ldi-ps = <0x02>;
				lcd-kit,panel-vfp-lp = <0x00>;
				lcd-kit,panel-fbk-div = <0x01>;
				lcd-kit,panel-orientation = <0x01>;
				lcd-kit,panel-bpp = <0x02>;
				lcd-kit,panel-bgr-fmt = <0x00>;
				lcd-kit,panel-cmd-type = <0x08>;
				lcd-kit,panel-pxl-clk = <0x00>;
				lcd-kit,panel-pxl-clk-div = <0x00>;
				lcd-kit,panel-data-rate = <0x2a0>;
				lcd-kit,mipi-lane-nums = <0x03>;
				lcd-kit,h-back-porch = <0x48>;
				lcd-kit,h-front-porch = <0x48>;
				lcd-kit,h-pulse-width = <0x28>;
				lcd-kit,project-id-support = <0x00>;
				lcd-kit,default-project-id = "Y1639J1700";
				lcd-kit,v-back-porch = <0x14>;
				lcd-kit,v-front-porch = <0x0c>;
				lcd-kit,v-pulse-width = <0x04>;
				lcd-kit,mipi-clk-post-adjust = <0x00>;
				lcd-kit,mipi-lp11-flag = <0x00>;
				lcd-kit,esd-support = <0x01>;
				lcd-kit,esd-recovery-bl-support = <0x01>;
				lcd-kit,tp-color-support = <0x00>;
				lcd-kit,lcd-vsp = <0x02 0x96 0x53ec60>;
				lcd-kit,lcd-vsn = <0x02 0x97 0x53ec60>;
				lcd-kit,lcd-reset = <0x02 0x2d 0x00>;
				lcd-kit,power-on-stage = <0x03 0x01 0x00 0x04 0x01 0x05 0x0b 0x01 0x00 0x05 0x01 0x01 0x05 0x02 0x05 0x05 0x01 0x0c 0x07 0x01 0x00 0x06 0x01 0x00 0x08 0x01 0x00>;
				lcd-kit,lp-on-stage = <0x00 0x00 0x00>;
				lcd-kit,hs-on-stage = <0x00 0x00 0x00>;
				lcd-kit,hs-off-stage = <0x00 0x00 0x00>;
				lcd-kit,lp-off-stage = <0x00 0x00 0x00>;
				lcd-kit,power-off-stage = <0x07 0x00 0x00 0x06 0x00 0x00 0x08 0x00 0x00 0x05 0x00 0x0a 0x04 0x00 0x00 0x03 0x00 0x06>;
				lcd-kit,pt-support = <0x01>;
				lcd-kit,panel-density = <0x140>;
				lcd-kit,ssc-disable = <0x00>;
				lcd-kit,ssc-range = <0x03>;
				lcd-kit,inversion-support = <0x01>;
				lcd-kit,check-reg-support = <0x01>;
				lcd-kit,panel-bl-min = <0x30>;
				lcd-kit,panel-bl-max = <0xfff>;
				lcd-kit,panel-bl-max-nit = <0x1c2>;
				lcd-kit,mipi-non-continue-enable = <0x01>;
				lcd-kit,panel-getblmaxnit-type = <0x01>;
				lcd-kit,panel-bl-ic-ctrl-type = <0x08>;
				lcd-kit,panel-bias-ic-ctrl-type = <0x03>;
				lcd-kit,oem-info-support = <0x00>;
				lcd-kit,oem-barcode-2d-support = <0x00>;
				lcd-kit,oem-barcode-2d-num-offset = <0x00>;
				lcd-kit,panel-on-always-reset = <0x01>;
				lcd-kit,panel-gpio-offset = <0x149>;
				phandle = <0x3f>;
			};
		};
	};

	fragment@22 {
		target = <0xffffffff>;

		__overlay__ {

			lcd_kit_dura_mdt_ili9881c_5p45 {
				compatible = "mdt_ili9881c_5p45_720p_video";
				lcd-kit,panel-name = "MDT_ILI9881C 5.45' VIDEO TFT 720 x 1440";
				lcd-kit,panel-type = <0x01>;
				lcd-kit,panel-xres = <0x2d0>;
				lcd-kit,panel-yres = <0x5a0>;
				lcd-kit,panel-width = <0x3e>;
				lcd-kit,panel-height = <0x7c>;
				lcd-kit,panel-on-cmds = <0x29 0x01 0x00 0x00 0x0a 0x00 0x04 0xff 0x98 0x81 0x03 0x29 0x01 0x00 0x00 0x0a 0x00 0x02 0x01 0x00 0x29 0x01 0x00 0x00 0x0a 0x00 0x02 0x02 0x00 0x29 0x01 0x00 0x00 0x0a 0x00 0x02 0x03 0x56 0x29 0x01 0x00 0x00 0x0a 0x00 0x02 0x04 0x53 0x29 0x01 0x00 0x00 0x0a 0x00 0x02 0x05 0x53 0x29 0x01 0x00 0x00 0x0a 0x00 0x02 0x06 0x06 0x29 0x01 0x00 0x00 0x0a 0x00 0x02 0x07 0x00 0x29 0x01 0x00 0x00 0x0a 0x00 0x02 0x08 0x00 0x29 0x01 0x00 0x00 0x0a 0x00 0x02 0x09 0x00 0x29 0x01 0x00 0x00 0x0a 0x00 0x02 0x0a 0x00 0x29 0x01 0x00 0x00 0x0a 0x00 0x02 0x0b 0x00 0x29 0x01 0x00 0x00 0x0a 0x00 0x02 0x0c 0x00 0x29 0x01 0x00 0x00 0x0a 0x00 0x02 0x0d 0x00 0x29 0x01 0x00 0x00 0x0a 0x00 0x02 0x0e 0x00 0x29 0x01 0x00 0x00 0x0a 0x00 0x02 0x0f 0x08 0x29 0x01 0x00 0x00 0x0a 0x00 0x02 0x10 0x08 0x29 0x01 0x00 0x00 0x0a 0x00 0x02 0x11 0x00 0x29 0x01 0x00 0x00 0x0a 0x00 0x02 0x12 0x00 0x29 0x01 0x00 0x00 0x0a 0x00 0x02 0x13 0x00 0x29 0x01 0x00 0x00 0x0a 0x00 0x02 0x14 0x00 0x29 0x01 0x00 0x00 0x0a 0x00 0x02 0x15 0x08 0x29 0x01 0x00 0x00 0x0a 0x00 0x02 0x16 0x08 0x29 0x01 0x00 0x00 0x0a 0x00 0x02 0x17 0x00 0x29 0x01 0x00 0x00 0x0a 0x00 0x02 0x18 0x08 0x29 0x01 0x00 0x00 0x0a 0x00 0x02 0x19 0x00 0x29 0x01 0x00 0x00 0x0a 0x00 0x02 0x1a 0x00 0x29 0x01 0x00 0x00 0x0a 0x00 0x02 0x1b 0x00 0x29 0x01 0x00 0x00 0x0a 0x00 0x02 0x1c 0x00 0x29 0x01 0x00 0x00 0x0a 0x00 0x02 0x1d 0x00 0x29 0x01 0x00 0x00 0x0a 0x00 0x02 0x1e 0xc0 0x29 0x01 0x00 0x00 0x0a 0x00 0x02 0x1f 0xc0 0x29 0x01 0x00 0x00 0x0a 0x00 0x02 0x20 0x02 0x29 0x01 0x00 0x00 0x0a 0x00 0x02 0x21 0x05 0x29 0x01 0x00 0x00 0x0a 0x00 0x02 0x22 0x02 0x29 0x01 0x00 0x00 0x0a 0x00 0x02 0x23 0x05 0x29 0x01 0x00 0x00 0x0a 0x00 0x02 0x24 0x86 0x29 0x01 0x00 0x00 0x0a 0x00 0x02 0x25 0x86 0x29 0x01 0x00 0x00 0x0a 0x00 0x02 0x26 0x86 0x29 0x01 0x00 0x00 0x0a 0x00 0x02 0x27 0x86 0x29 0x01 0x00 0x00 0x0a 0x00 0x02 0x28 0x3b 0x29 0x01 0x00 0x00 0x0a 0x00 0x02 0x29 0x03 0x29 0x01 0x00 0x00 0x0a 0x00 0x02 0x2a 0x00 0x29 0x01 0x00 0x00 0x0a 0x00 0x02 0x2b 0x00 0x29 0x01 0x00 0x00 0x0a 0x00 0x02 0x2c 0x00 0x29 0x01 0x00 0x00 0x0a 0x00 0x02 0x2d 0x00 0x29 0x01 0x00 0x00 0x0a 0x00 0x02 0x2e 0x00 0x29 0x01 0x00 0x00 0x0a 0x00 0x02 0x2f 0x00 0x29 0x01 0x00 0x00 0x0a 0x00 0x02 0x30 0x00 0x29 0x01 0x00 0x00 0x0a 0x00 0x02 0x31 0x00 0x29 0x01 0x00 0x00 0x0a 0x00 0x02 0x32 0x00 0x29 0x01 0x00 0x00 0x0a 0x00 0x02 0x33 0x00 0x29 0x01 0x00 0x00 0x0a 0x00 0x02 0x34 0x03 0x29 0x01 0x00 0x00 0x0a 0x00 0x02 0x35 0x00 0x29 0x01 0x00 0x00 0x0a 0x00 0x02 0x36 0x00 0x29 0x01 0x00 0x00 0x0a 0x00 0x02 0x37 0x00 0x29 0x01 0x00 0x00 0x0a 0x00 0x02 0x38 0x3c 0x29 0x01 0x00 0x00 0x0a 0x00 0x02 0x39 0x00 0x29 0x01 0x00 0x00 0x0a 0x00 0x02 0x3a 0x00 0x29 0x01 0x00 0x00 0x0a 0x00 0x02 0x3b 0x00 0x29 0x01 0x00 0x00 0x0a 0x00 0x02 0x3c 0x00 0x29 0x01 0x00 0x00 0x0a 0x00 0x02 0x3d 0x00 0x29 0x01 0x00 0x00 0x0a 0x00 0x02 0x3e 0x00 0x29 0x01 0x00 0x00 0x0a 0x00 0x02 0x3f 0x00 0x29 0x01 0x00 0x00 0x0a 0x00 0x02 0x40 0x00 0x29 0x01 0x00 0x00 0x0a 0x00 0x02 0x41 0x00 0x29 0x01 0x00 0x00 0x0a 0x00 0x02 0x42 0x00 0x29 0x01 0x00 0x00 0x0a 0x00 0x02 0x43 0x00 0x29 0x01 0x00 0x00 0x0a 0x00 0x02 0x44 0x00 0x29 0x01 0x00 0x00 0x0a 0x00 0x02 0x50 0x01 0x29 0x01 0x00 0x00 0x0a 0x00 0x02 0x51 0x23 0x29 0x01 0x00 0x00 0x0a 0x00 0x02 0x52 0x45 0x29 0x01 0x00 0x00 0x0a 0x00 0x02 0x53 0x67 0x29 0x01 0x00 0x00 0x0a 0x00 0x02 0x54 0x89 0x29 0x01 0x00 0x00 0x0a 0x00 0x02 0x55 0xab 0x29 0x01 0x00 0x00 0x0a 0x00 0x02 0x56 0x01 0x29 0x01 0x00 0x00 0x0a 0x00 0x02 0x57 0x23 0x29 0x01 0x00 0x00 0x0a 0x00 0x02 0x58 0x45 0x29 0x01 0x00 0x00 0x0a 0x00 0x02 0x59 0x67 0x29 0x01 0x00 0x00 0x0a 0x00 0x02 0x5a 0x89 0x29 0x01 0x00 0x00 0x0a 0x00 0x02 0x5b 0xab 0x29 0x01 0x00 0x00 0x0a 0x00 0x02 0x5c 0xcd 0x29 0x01 0x00 0x00 0x0a 0x00 0x02 0x5d 0xef 0x29 0x01 0x00 0x00 0x0a 0x00 0x02 0x5e 0x01 0x29 0x01 0x00 0x00 0x0a 0x00 0x02 0x5f 0x01 0x29 0x01 0x00 0x00 0x0a 0x00 0x02 0x60 0x08 0x29 0x01 0x00 0x00 0x0a 0x00 0x02 0x61 0x00 0x29 0x01 0x00 0x00 0x0a 0x00 0x02 0x62 0x02 0x29 0x01 0x00 0x00 0x0a 0x00 0x02 0x63 0x0f 0x29 0x01 0x00 0x00 0x0a 0x00 0x02 0x64 0x0e 0x29 0x01 0x00 0x00 0x0a 0x00 0x02 0x65 0x0d 0x29 0x01 0x00 0x00 0x0a 0x00 0x02 0x66 0x0c 0x29 0x01 0x00 0x00 0x0a 0x00 0x02 0x67 0x06 0x29 0x01 0x00 0x00 0x0a 0x00 0x02 0x68 0x02 0x29 0x01 0x00 0x00 0x0a 0x00 0x02 0x69 0x02 0x29 0x01 0x00 0x00 0x0a 0x00 0x02 0x6a 0x02 0x29 0x01 0x00 0x00 0x0a 0x00 0x02 0x6b 0x02 0x29 0x01 0x00 0x00 0x0a 0x00 0x02 0x6c 0x02 0x29 0x01 0x00 0x00 0x0a 0x00 0x02 0x6d 0x02 0x29 0x01 0x00 0x00 0x0a 0x00 0x02 0x6e 0x02 0x29 0x01 0x00 0x00 0x0a 0x00 0x02 0x6f 0x02 0x29 0x01 0x00 0x00 0x0a 0x00 0x02 0x70 0x02 0x29 0x01 0x00 0x00 0x0a 0x00 0x02 0x71 0x02 0x29 0x01 0x00 0x00 0x0a 0x00 0x02 0x72 0x00 0x29 0x01 0x00 0x00 0x0a 0x00 0x02 0x73 0x02 0x29 0x01 0x00 0x00 0x0a 0x00 0x02 0x74 0x02 0x29 0x01 0x00 0x00 0x0a 0x00 0x02 0x75 0x01 0x29 0x01 0x00 0x00 0x0a 0x00 0x02 0x76 0x06 0x29 0x01 0x00 0x00 0x0a 0x00 0x02 0x77 0x00 0x29 0x01 0x00 0x00 0x0a 0x00 0x02 0x78 0x02 0x29 0x01 0x00 0x00 0x0a 0x00 0x02 0x79 0x0c 0x29 0x01 0x00 0x00 0x0a 0x00 0x02 0x7a 0x0d 0x29 0x01 0x00 0x00 0x0a 0x00 0x02 0x7b 0x0e 0x29 0x01 0x00 0x00 0x0a 0x00 0x02 0x7c 0x0f 0x29 0x01 0x00 0x00 0x0a 0x00 0x02 0x7d 0x0a 0x29 0x01 0x00 0x00 0x0a 0x00 0x02 0x7e 0x02 0x29 0x01 0x00 0x00 0x0a 0x00 0x02 0x7f 0x02 0x29 0x01 0x00 0x00 0x0a 0x00 0x02 0x80 0x02 0x29 0x01 0x00 0x00 0x0a 0x00 0x02 0x81 0x02 0x29 0x01 0x00 0x00 0x0a 0x00 0x02 0x82 0x02 0x29 0x01 0x00 0x00 0x0a 0x00 0x02 0x83 0x02 0x29 0x01 0x00 0x00 0x0a 0x00 0x02 0x84 0x02 0x29 0x01 0x00 0x00 0x0a 0x00 0x02 0x85 0x02 0x29 0x01 0x00 0x00 0x0a 0x00 0x02 0x86 0x02 0x29 0x01 0x00 0x00 0x0a 0x00 0x02 0x87 0x02 0x29 0x01 0x00 0x00 0x0a 0x00 0x02 0x88 0x00 0x29 0x01 0x00 0x00 0x0a 0x00 0x02 0x89 0x02 0x29 0x01 0x00 0x00 0x0a 0x00 0x02 0x8a 0x02 0x29 0x01 0x00 0x00 0x0a 0x00 0x04 0xff 0x98 0x81 0x04 0x29 0x01 0x00 0x00 0x0a 0x00 0x02 0x00 0x00 0x29 0x01 0x00 0x00 0x0a 0x00 0x02 0x6c 0x15 0x29 0x01 0x00 0x00 0x0a 0x00 0x02 0x6e 0x2a 0x29 0x01 0x00 0x00 0x0a 0x00 0x02 0x6f 0x25 0x29 0x01 0x00 0x00 0x0a 0x00 0x02 0x3a 0xa4 0x29 0x01 0x00 0x00 0x0a 0x00 0x02 0x8d 0x1f 0x29 0x01 0x00 0x00 0x0a 0x00 0x02 0x87 0xba 0x29 0x01 0x00 0x00 0x0a 0x00 0x02 0x26 0x76 0x29 0x01 0x00 0x00 0x0a 0x00 0x02 0xb2 0xd1 0x29 0x01 0x00 0x00 0x0a 0x00 0x02 0x88 0x0b 0x29 0x01 0x00 0x00 0x0a 0x00 0x02 0x33 0x14 0x29 0x01 0x00 0x00 0x0a 0x00 0x02 0x35 0x17 0x29 0x01 0x00 0x00 0x0a 0x00 0x02 0x38 0x01 0x29 0x01 0x00 0x00 0x0a 0x00 0x02 0x39 0x00 0x29 0x01 0x00 0x00 0x0a 0x00 0x02 0x7a 0x0f 0x29 0x01 0x00 0x00 0x0a 0x00 0x02 0xb5 0x02 0x29 0x01 0x00 0x00 0x0a 0x00 0x02 0x31 0x25 0x29 0x01 0x00 0x00 0x0a 0x00 0x02 0x3b 0x98 0x29 0x01 0x00 0x00 0x0a 0x00 0x04 0xff 0x98 0x81 0x01 0x29 0x01 0x00 0x00 0x0a 0x00 0x02 0x22 0x0a 0x29 0x01 0x00 0x00 0x0a 0x00 0x02 0x26 0x0e 0x29 0x01 0x00 0x00 0x0a 0x00 0x02 0x2e 0xf0 0x29 0x01 0x00 0x00 0x0a 0x00 0x02 0x31 0x00 0x29 0x01 0x00 0x00 0x0a 0x00 0x02 0x53 0x4f 0x29 0x01 0x00 0x00 0x0a 0x00 0x02 0x55 0x4f 0x29 0x01 0x00 0x00 0x0a 0x00 0x02 0x50 0xbf 0x29 0x01 0x00 0x00 0x0a 0x00 0x02 0x51 0xba 0x29 0x01 0x00 0x00 0x0a 0x00 0x02 0x60 0x10 0x29 0x01 0x00 0x00 0x0a 0x00 0x02 0x61 0x00 0x29 0x01 0x00 0x00 0x0a 0x00 0x02 0x62 0x20 0x29 0x01 0x00 0x00 0x0a 0x00 0x02 0x63 0x00 0x29 0x01 0x00 0x00 0x0a 0x00 0x02 0x2e 0xf0 0x29 0x01 0x00 0x00 0x0a 0x00 0x02 0xa0 0x00 0x29 0x01 0x00 0x00 0x0a 0x00 0x02 0xa1 0x20 0x29 0x01 0x00 0x00 0x0a 0x00 0x02 0xa2 0x30 0x29 0x01 0x00 0x00 0x0a 0x00 0x02 0xa3 0x16 0x29 0x01 0x00 0x00 0x0a 0x00 0x02 0xa4 0x1c 0x29 0x01 0x00 0x00 0x0a 0x00 0x02 0xa5 0x31 0x29 0x01 0x00 0x00 0x0a 0x00 0x02 0xa6 0x24 0x29 0x01 0x00 0x00 0x0a 0x00 0x02 0xa7 0x24 0x29 0x01 0x00 0x00 0x0a 0x00 0x02 0xa8 0x99 0x29 0x01 0x00 0x00 0x0a 0x00 0x02 0xa9 0x1d 0x29 0x01 0x00 0x00 0x0a 0x00 0x02 0xaa 0x28 0x29 0x01 0x00 0x00 0x0a 0x00 0x02 0xab 0x76 0x29 0x01 0x00 0x00 0x0a 0x00 0x02 0xac 0x19 0x29 0x01 0x00 0x00 0x0a 0x00 0x02 0xad 0x18 0x29 0x01 0x00 0x00 0x0a 0x00 0x02 0xae 0x4d 0x29 0x01 0x00 0x00 0x0a 0x00 0x02 0xaf 0x21 0x29 0x01 0x00 0x00 0x0a 0x00 0x02 0xb0 0x28 0x29 0x01 0x00 0x00 0x0a 0x00 0x02 0xb1 0x4b 0x29 0x01 0x00 0x00 0x0a 0x00 0x02 0xb2 0x5b 0x29 0x01 0x00 0x00 0x0a 0x00 0x02 0xb3 0x3f 0x29 0x01 0x00 0x00 0x0a 0x00 0x02 0xc0 0x00 0x29 0x01 0x00 0x00 0x0a 0x00 0x02 0xc1 0x20 0x29 0x01 0x00 0x00 0x0a 0x00 0x02 0xc2 0x30 0x29 0x01 0x00 0x00 0x0a 0x00 0x02 0xc3 0x16 0x29 0x01 0x00 0x00 0x0a 0x00 0x02 0xc4 0x1b 0x29 0x01 0x00 0x00 0x0a 0x00 0x02 0xc5 0x31 0x29 0x01 0x00 0x00 0x0a 0x00 0x02 0xc6 0x26 0x29 0x01 0x00 0x00 0x0a 0x00 0x02 0xc7 0x25 0x29 0x01 0x00 0x00 0x0a 0x00 0x02 0xc8 0x98 0x29 0x01 0x00 0x00 0x0a 0x00 0x02 0xc9 0x1b 0x29 0x01 0x00 0x00 0x0a 0x00 0x02 0xca 0x27 0x29 0x01 0x00 0x00 0x0a 0x00 0x02 0xcb 0x77 0x29 0x01 0x00 0x00 0x0a 0x00 0x02 0xcc 0x1a 0x29 0x01 0x00 0x00 0x0a 0x00 0x02 0xcd 0x18 0x29 0x01 0x00 0x00 0x0a 0x00 0x02 0xce 0x4d 0x29 0x01 0x00 0x00 0x0a 0x00 0x02 0xcf 0x21 0x29 0x01 0x00 0x00 0x0a 0x00 0x02 0xd0 0x28 0x29 0x01 0x00 0x00 0x0a 0x00 0x02 0xd1 0x4c 0x29 0x01 0x00 0x00 0x0a 0x00 0x02 0xd2 0x5b 0x29 0x01 0x00 0x00 0x0a 0x00 0x02 0xd3 0x3f 0x29 0x01 0x00 0x00 0x0a 0x00 0x04 0xff 0x98 0x81 0x02 0x29 0x01 0x00 0x00 0x0a 0x00 0x02 0x03 0x4d 0x29 0x01 0x00 0x00 0x0a 0x00 0x02 0x04 0x45 0x29 0x01 0x00 0x00 0x0a 0x00 0x02 0x05 0x44 0x29 0x01 0x00 0x00 0x0a 0x00 0x02 0x06 0x00 0x29 0x01 0x00 0x00 0x0a 0x00 0x02 0x07 0x00 0x29 0x01 0x00 0x00 0x0a 0x00 0x04 0xff 0x98 0x81 0x00 0x29 0x01 0x00 0x00 0x0a 0x00 0x03 0x51 0x00 0x00 0x29 0x01 0x00 0x00 0x0a 0x00 0x02 0x53 0x2c 0x29 0x01 0x00 0x00 0x0a 0x00 0x02 0x55 0x00 0x29 0x01 0x00 0x00 0x0a 0x00 0x02 0x35 0x00 0x29 0x01 0x00 0x00 0x40 0x01 0x02 0x11 0x00 0x29 0x01 0x00 0x00 0x14 0x01 0x02 0x29 0x00>;
				lcd-kit,panel-on-cmds-state = "dsi_lp_mode";
				lcd-kit,panel-off-cmds = <0x05 0x01 0x00 0x00 0x14 0x01 0x02 0x28 0x00 0x05 0x01 0x00 0x00 0x3c 0x01 0x02 0x10 0x00>;
				lcd-kit,panel-off-cmds-state = "dsi_lp_mode";
				lcd-kit,backlight-cmds = <0x29 0x01 0x00 0x00 0x00 0x00 0x03 0x51 0x00 0x00>;
				lcd-kit,backlight-cmds-state = "dsi_lp_mode";
				lcd-kit,tp-color-cmds = <0x06 0x01 0x00 0x00 0x0a 0x00 0x01 0xda>;
				lcd-kit,inversion-dot-cmds = <0x29 0x01 0x00 0x00 0x05 0x01 0x04 0xff 0x98 0x81 0x01 0x29 0x01 0x00 0x00 0x0a 0x00 0x02 0x50 0x42 0x29 0x01 0x00 0x00 0x0a 0x00 0x02 0x51 0x42 0x29 0x01 0x00 0x00 0x0a 0x00 0x02 0x62 0x2f 0x29 0x01 0x00 0x00 0x0a 0x00 0x02 0x63 0x10 0x29 0x01 0x00 0x00 0x05 0x01 0x02 0x31 0x04 0x29 0x01 0x00 0x00 0x0a 0x00 0x04 0xff 0x98 0x81 0x00>;
				lcd-kit,inversion-column-cmds = <0x29 0x01 0x00 0x00 0x05 0x01 0x04 0xff 0x98 0x81 0x01 0x29 0x01 0x00 0x00 0x0a 0x00 0x02 0x31 0x00 0x29 0x01 0x00 0x00 0x0a 0x00 0x02 0x50 0xc9 0x29 0x01 0x00 0x00 0x0a 0x00 0x02 0x51 0xc5 0x29 0x01 0x00 0x00 0x0a 0x00 0x02 0x62 0x20 0x29 0x01 0x00 0x00 0x0a 0x00 0x02 0x63 0x10 0x29 0x01 0x00 0x00 0x0a 0x00 0x04 0xff 0x98 0x81 0x00>;
				lcd-kit,esd-reg-cmds = <0x06 0x01 0x00 0x00 0x0a 0x00 0x01 0x54 0x06 0x01 0x00 0x00 0x0a 0x00 0x03 0x09 0x00 0x00>;
				lcd-kit,esd-reg-cmds-state = "dsi_lp_mode";
				lcd-kit,esd-value = <0x2c 0x80 0x03 0x06>;
				lcd-kit,check-reg-cmds = <0x06 0x01 0x00 0x00 0x0a 0x00 0x01 0x0a>;
				lcd-kit,check-reg-cmds-state = "dsi_lp_mode";
				lcd-kit,check-reg-value = <0x9c>;
				lcd-kit,barcode-2d-cmds;
				lcd-kit,project-id-cmds;
				lcd-kit,project-id-cmds-state = "dsi_lp_mode";
				lcd-kit,panel-bl-maxnit-command = <0x06 0x01 0x00 0x00 0x0a 0x00 0x01 0xdb>;
				lcd-kit,panel-bl-maxnit-command-state = "dsi_lp_mode";
				lcd-kit,panel-lcm-type = <0x02>;
				lcd-kit,panel-ldi-dsi-mode = <0x01>;
				lcd-kit,panel-dsi-switch-mode = <0x00>;
				lcd-kit,panel-dsi-switch-mode-en = <0x00>;
				lcd-kit,panel-ldi-trans-seq = <0x00>;
				lcd-kit,panel-ldi-data-padding = <0x00>;
				lcd-kit,panel-ldi-packet-size = <0x100>;
				lcd-kit,panel-ldi-ps = <0x02>;
				lcd-kit,panel-vfp-lp = <0x00>;
				lcd-kit,panel-fbk-div = <0x01>;
				lcd-kit,panel-orientation = <0x01>;
				lcd-kit,panel-bpp = <0x02>;
				lcd-kit,panel-bgr-fmt = <0x00>;
				lcd-kit,panel-cmd-type = <0x08>;
				lcd-kit,panel-pxl-clk = <0x00>;
				lcd-kit,panel-pxl-clk-div = <0x00>;
				lcd-kit,panel-data-rate = <0x2a0>;
				lcd-kit,mipi-lane-nums = <0x03>;
				lcd-kit,h-back-porch = <0x48>;
				lcd-kit,h-front-porch = <0x48>;
				lcd-kit,h-pulse-width = <0x28>;
				lcd-kit,project-id-support = <0x01>;
				lcd-kit,default-project-id = "Y1639J1700";
				lcd-kit,v-back-porch = <0x14>;
				lcd-kit,v-front-porch = <0x0c>;
				lcd-kit,v-pulse-width = <0x04>;
				lcd-kit,mipi-clk-post-adjust = <0x00>;
				lcd-kit,mipi-lp11-flag = <0x00>;
				lcd-kit,esd-support = <0x01>;
				lcd-kit,esd-recovery-bl-support = <0x01>;
				lcd-kit,tp-color-support = <0x00>;
				lcd-kit,lcd-vsp = <0x02 0x96 0x53ec60>;
				lcd-kit,lcd-vsn = <0x02 0x97 0x53ec60>;
				lcd-kit,lcd-reset = <0x02 0x2d 0x00>;
				lcd-kit,power-on-stage = <0x03 0x01 0x05 0x04 0x01 0x05 0x0b 0x01 0x00 0x05 0x01 0x01 0x05 0x02 0x05 0x05 0x01 0x0f 0x07 0x01 0x00 0x06 0x01 0x00 0x08 0x01 0x00>;
				lcd-kit,lp-on-stage = <0x00 0x00 0x00>;
				lcd-kit,hs-on-stage = <0x00 0x00 0x00>;
				lcd-kit,hs-off-stage = <0x00 0x00 0x00>;
				lcd-kit,lp-off-stage = <0x00 0x00 0x00>;
				lcd-kit,power-off-stage = <0x07 0x00 0x00 0x06 0x00 0x00 0x08 0x00 0x00 0x05 0x00 0x0a 0x04 0x00 0x00 0x03 0x00 0x06>;
				lcd-kit,pt-support = <0x01>;
				lcd-kit,panel-density = <0x140>;
				lcd-kit,ssc-disable = <0x00>;
				lcd-kit,ssc-range = <0x03>;
				lcd-kit,inversion-support = <0x00>;
				lcd-kit,check-reg-support = <0x01>;
				lcd-kit,panel-bl-min = <0x30>;
				lcd-kit,panel-bl-max = <0xfff>;
				lcd-kit,panel-bl-max-nit = <0x1c2>;
				lcd-kit,mipi-non-continue-enable = <0x01>;
				lcd-kit,panel-getblmaxnit-type = <0x01>;
				lcd-kit,panel-bl-ic-ctrl-type = <0x08>;
				lcd-kit,panel-bias-ic-ctrl-type = <0x03>;
				lcd-kit,oem-info-support = <0x00>;
				lcd-kit,oem-barcode-2d-support = <0x00>;
				lcd-kit,oem-barcode-2d-num-offset = <0x00>;
				lcd-kit,panel-on-always-reset = <0x01>;
				lcd-kit,panel-gpio-offset = <0x149>;
				phandle = <0x40>;
			};
		};
	};

	fragment@23 {
		target = <0xffffffff>;

		__overlay__ {

			lcd_kit_dura_xl_hx8394f_5p45 {
				compatible = "xl_hx8394f_5p45_720p_video";
				lcd-kit,panel-name = "XL_HX8394F 5.45' VIDEO TFT 720 x 1440";
				lcd-kit,panel-type = <0x01>;
				lcd-kit,panel-xres = <0x2d0>;
				lcd-kit,panel-yres = <0x5a0>;
				lcd-kit,panel-width = <0x3e>;
				lcd-kit,panel-height = <0x7c>;
				lcd-kit,panel-on-cmds = <0x29 0x01 0x00 0x00 0x0a 0x00 0x04 0xb9 0xff 0x83 0x94 0x29 0x01 0x00 0x00 0x0a 0x00 0x07 0xba 0x62 0x03 0x68 0x7b 0xb2 0xc0 0x29 0x01 0x00 0x00 0x0a 0x00 0x0b 0xb1 0x48 0x12 0x72 0x09 0x31 0x24 0x71 0x71 0x50 0x43 0x29 0x01 0x00 0x00 0x0a 0x00 0x07 0xb2 0x00 0x80 0x78 0x06 0x08 0x22 0x29 0x01 0x00 0x00 0x0a 0x00 0x16 0xb4 0x01 0x62 0x64 0x62 0x61 0x62 0x01 0x0c 0x6d 0x33 0x00 0x3f 0x01 0x62 0x64 0x62 0x61 0x62 0x01 0x0c 0x6d 0x29 0x01 0x00 0x00 0x0a 0x00 0x23 0xd3 0x00 0x00 0x04 0x04 0x00 0x00 0x3f 0x3f 0x32 0x10 0x01 0x00 0x01 0x52 0x15 0xa7 0x05 0xa7 0x32 0x10 0x00 0x00 0x00 0x67 0x43 0x06 0x06 0x27 0x0d 0x0d 0x27 0x06 0x40 0x00 0x29 0x01 0x00 0x00 0x0a 0x00 0x3b 0xe0 0x00 0x04 0x0d 0x14 0x18 0x1d 0x21 0x20 0x42 0x55 0x65 0x64 0x6b 0x7b 0x7d 0x7f 0x8c 0x90 0x8d 0x9e 0xaf 0x57 0x56 0x59 0x5d 0x61 0x68 0x7b 0x7f 0x00 0x04 0x0d 0x14 0x18 0x1d 0x21 0x20 0x42 0x55 0x65 0x64 0x6b 0x7b 0x7d 0x7f 0x8c 0x90 0x8d 0x9e 0xaf 0x57 0x56 0x59 0x5d 0x61 0x68 0x7b 0x7f 0x29 0x01 0x00 0x00 0x0a 0x00 0x03 0xb6 0x45 0x45 0x29 0x01 0x00 0x00 0x0a 0x00 0x02 0xbd 0x02 0x29 0x01 0x00 0x00 0x0a 0x00 0x05 0xd3 0x01 0x04 0x00 0x01 0x29 0x01 0x00 0x00 0x0a 0x00 0x02 0xbd 0x00 0x29 0x01 0x00 0x00 0x0a 0x00 0x2d 0xd5 0x19 0x19 0x24 0x25 0x18 0x18 0x18 0x18 0x06 0x07 0x04 0x05 0x02 0x03 0x00 0x01 0x20 0x21 0x18 0x18 0x18 0x18 0x18 0x18 0x18 0x18 0x18 0x18 0x18 0x18 0x18 0x18 0x18 0x18 0x18 0x18 0x18 0x18 0x18 0x18 0x18 0x18 0x18 0x18 0x29 0x01 0x00 0x00 0x0a 0x00 0x2d 0xd6 0x18 0x18 0x21 0x20 0x19 0x19 0x18 0x18 0x01 0x00 0x03 0x02 0x05 0x04 0x07 0x06 0x25 0x24 0x18 0x18 0x18 0x18 0x18 0x18 0x18 0x18 0x18 0x18 0x18 0x18 0x18 0x18 0x18 0x18 0x18 0x18 0x18 0x18 0x18 0x18 0x18 0x18 0x18 0x18 0x29 0x01 0x00 0x00 0x0a 0x00 0x02 0xcc 0x0b 0x29 0x01 0x00 0x00 0x0a 0x00 0x03 0xc0 0x1f 0x31 0x29 0x01 0x00 0x00 0x0a 0x00 0x02 0xd2 0x77 0x29 0x01 0x00 0x00 0x0a 0x00 0x02 0xd4 0x02 0x29 0x01 0x00 0x00 0x0a 0x00 0x02 0xc6 0xed 0x29 0x01 0x00 0x00 0x0a 0x00 0x04 0xc9 0x03 0x00 0x25 0x29 0x01 0x00 0x00 0x0a 0x00 0x02 0x53 0x24 0x29 0x01 0x00 0x00 0x0a 0x00 0x02 0x51 0x00 0x29 0x01 0x00 0x00 0x78 0x01 0x02 0x11 0x00 0x29 0x01 0x00 0x00 0x0a 0x00 0x02 0xc6 0xcd 0x29 0x01 0x00 0x00 0x0a 0x00 0x02 0xbd 0x02 0x29 0x01 0x00 0x00 0x0a 0x00 0x06 0xb1 0x00 0x00 0x00 0x00 0x00 0x29 0x01 0x00 0x00 0x0a 0x00 0x02 0xbd 0x00 0x29 0x01 0x00 0x00 0x14 0x01 0x02 0x29 0x00>;
				lcd-kit,panel-on-cmds-state = "dsi_lp_mode";
				lcd-kit,panel-off-cmds = <0x05 0x01 0x00 0x00 0x20 0x01 0x02 0x28 0x00 0x05 0x01 0x00 0x00 0x20 0x01 0x02 0x10 0x00>;
				lcd-kit,panel-off-cmds-state = "dsi_lp_mode";
				lcd-kit,backlight-cmds = <0x29 0x01 0x00 0x00 0x00 0x00 0x03 0x51 0x00 0x00>;
				lcd-kit,backlight-cmds-state = "dsi_lp_mode";
				lcd-kit,tp-color-cmds = <0x06 0x01 0x00 0x00 0x0a 0x00 0x01 0xda>;
				lcd-kit,inversion-dot-cmds = <0x29 0x01 0x00 0x00 0x05 0x01 0x07 0xb2 0x03 0x80 0x78 0x06 0x08 0x22>;
				lcd-kit,inversion-column-cmds = <0x29 0x01 0x00 0x00 0x05 0x01 0x07 0xb2 0x00 0x80 0x78 0x06 0x08 0x22>;
				lcd-kit,esd-reg-cmds = <0x06 0x01 0x00 0x00 0x0a 0x00 0x01 0x0a>;
				lcd-kit,esd-reg-cmds-state = "dsi_lp_mode";
				lcd-kit,esd-value = <0x1c>;
				lcd-kit,check-reg-cmds = <0x06 0x01 0x00 0x00 0x0a 0x00 0x01 0x0a>;
				lcd-kit,check-reg-cmds-state = "dsi_lp_mode";
				lcd-kit,check-reg-value = <0x1c>;
				lcd-kit,barcode-2d-cmds;
				lcd-kit,project-id-cmds;
				lcd-kit,project-id-cmds-state = "dsi_lp_mode";
				lcd-kit,panel-bl-maxnit-command = <0x06 0x01 0x00 0x00 0x0a 0x00 0x01 0xdb>;
				lcd-kit,panel-bl-maxnit-command-state = "dsi_lp_mode";
				lcd-kit,panel-lcm-type = <0x02>;
				lcd-kit,panel-ldi-dsi-mode = <0x01>;
				lcd-kit,panel-dsi-switch-mode = <0x00>;
				lcd-kit,panel-dsi-switch-mode-en = <0x00>;
				lcd-kit,panel-ldi-trans-seq = <0x00>;
				lcd-kit,panel-ldi-data-padding = <0x00>;
				lcd-kit,panel-ldi-packet-size = <0x100>;
				lcd-kit,panel-ldi-ps = <0x02>;
				lcd-kit,panel-vfp-lp = <0x00>;
				lcd-kit,panel-fbk-div = <0x01>;
				lcd-kit,panel-orientation = <0x01>;
				lcd-kit,panel-bpp = <0x02>;
				lcd-kit,panel-bgr-fmt = <0x00>;
				lcd-kit,panel-cmd-type = <0x08>;
				lcd-kit,panel-pxl-clk = <0x00>;
				lcd-kit,panel-pxl-clk-div = <0x00>;
				lcd-kit,panel-data-rate = <0x2a0>;
				lcd-kit,mipi-lane-nums = <0x03>;
				lcd-kit,h-back-porch = <0x50>;
				lcd-kit,h-front-porch = <0x60>;
				lcd-kit,h-pulse-width = <0x0a>;
				lcd-kit,project-id-support = <0x00>;
				lcd-kit,default-project-id = "Y1639J1700";
				lcd-kit,v-back-porch = <0x0e>;
				lcd-kit,v-front-porch = <0x0f>;
				lcd-kit,v-pulse-width = <0x04>;
				lcd-kit,mipi-clk-post-adjust = <0x00>;
				lcd-kit,mipi-lp11-flag = <0x00>;
				lcd-kit,esd-support = <0x01>;
				lcd-kit,esd-recovery-bl-support = <0x01>;
				lcd-kit,tp-color-support = <0x00>;
				lcd-kit,lcd-vsp = <0x02 0x96 0x53ec60>;
				lcd-kit,lcd-vsn = <0x02 0x97 0x53ec60>;
				lcd-kit,lcd-reset = <0x02 0x2d 0x00>;
				lcd-kit,power-on-stage = <0x03 0x01 0x02 0x04 0x01 0x05 0x0b 0x01 0x00 0x05 0x01 0x05 0x05 0x02 0x05 0x05 0x01 0x32 0x07 0x01 0x00 0x06 0x01 0x00 0x08 0x01 0x00>;
				lcd-kit,lp-on-stage = <0x00 0x00 0x00>;
				lcd-kit,hs-on-stage = <0x00 0x00 0x00>;
				lcd-kit,hs-off-stage = <0x00 0x00 0x00>;
				lcd-kit,lp-off-stage = <0x00 0x00 0x00>;
				lcd-kit,power-off-stage = <0x07 0x00 0x00 0x06 0x00 0x00 0x08 0x00 0x00 0x05 0x00 0x0a 0x04 0x00 0x00 0x03 0x00 0x06>;
				lcd-kit,pt-support = <0x01>;
				lcd-kit,panel-density = <0x140>;
				lcd-kit,ssc-disable = <0x00>;
				lcd-kit,ssc-range = <0x03>;
				lcd-kit,inversion-support = <0x01>;
				lcd-kit,check-reg-support = <0x01>;
				lcd-kit,panel-bl-min = <0x30>;
				lcd-kit,panel-bl-max = <0xfff>;
				lcd-kit,panel-bl-max-nit = <0x1c2>;
				lcd-kit,mipi-non-continue-enable = <0x01>;
				lcd-kit,panel-getblmaxnit-type = <0x01>;
				lcd-kit,panel-bl-ic-ctrl-type = <0x08>;
				lcd-kit,panel-bias-ic-ctrl-type = <0x03>;
				lcd-kit,oem-info-support = <0x00>;
				lcd-kit,oem-barcode-2d-support = <0x00>;
				lcd-kit,oem-barcode-2d-num-offset = <0x00>;
				lcd-kit,panel-on-always-reset = <0x01>;
				lcd-kit,panel-gpio-offset = <0x149>;
				phandle = <0x41>;
			};
		};
	};

	fragment@24 {
		target = <0xffffffff>;

		__overlay__ {

			lcd_kit_dura_xl_ili9881p_5p45 {
				compatible = "xl_ili9881p_5p45_720p_video";
				lcd-kit,panel-name = "XL_ILI9881P 5.45' VIDEO TFT 720 x 1440";
				lcd-kit,panel-type = <0x01>;
				lcd-kit,panel-xres = <0x2d0>;
				lcd-kit,panel-yres = <0x5a0>;
				lcd-kit,panel-width = <0x3e>;
				lcd-kit,panel-height = <0x7c>;
				lcd-kit,panel-on-cmds = <0x29 0x01 0x00 0x00 0x0a 0x00 0x04 0xff 0x98 0x81 0x06 0x29 0x01 0x00 0x00 0x0a 0x00 0x02 0x01 0x03 0x29 0x01 0x00 0x00 0x0a 0x00 0x02 0x2b 0x0a 0x29 0x01 0x00 0x00 0x0a 0x00 0x02 0xc0 0xcf 0x29 0x01 0x00 0x00 0x0a 0x00 0x02 0xc1 0x2a 0x29 0x01 0x00 0x00 0x0a 0x00 0x02 0x04 0xe1 0x29 0x01 0x00 0x00 0x0a 0x00 0x02 0x80 0x00 0x29 0x01 0x00 0x00 0x0a 0x00 0x02 0x81 0x00 0x29 0x01 0x00 0x00 0x0a 0x00 0x02 0x64 0x2f 0x29 0x01 0x00 0x00 0x0a 0x00 0x04 0xff 0x98 0x81 0x05 0x29 0x01 0x00 0x00 0x0a 0x00 0x02 0xb2 0x70 0x29 0x01 0x00 0x00 0x0a 0x00 0x02 0x1b 0x01 0x29 0x01 0x00 0x00 0x0a 0x00 0x02 0xb1 0x70 0x29 0x01 0x00 0x00 0x0a 0x00 0x02 0x78 0x01 0x29 0x01 0x00 0x00 0x0a 0x00 0x02 0xa9 0xc0 0x29 0x01 0x00 0x00 0x0a 0x00 0x02 0x1e 0x11 0x29 0x01 0x00 0x00 0x0a 0x00 0x02 0x4c 0x11 0x29 0x01 0x00 0x00 0x0a 0x00 0x02 0x38 0xa0 0x29 0x01 0x00 0x00 0x0a 0x00 0x02 0x1a 0x50 0x29 0x01 0x00 0x00 0x0a 0x00 0x02 0x54 0x28 0x29 0x01 0x00 0x00 0x0a 0x00 0x02 0x55 0x25 0x29 0x01 0x00 0x00 0x0a 0x00 0x02 0x56 0x38 0x29 0x01 0x00 0x00 0x0a 0x00 0x02 0x57 0x38 0x29 0x01 0x00 0x00 0x0a 0x00 0x02 0x4d 0x22 0x29 0x01 0x00 0x00 0x0a 0x00 0x02 0x26 0x0e 0x29 0x01 0x00 0x00 0x0a 0x00 0x02 0x1b 0x09 0x29 0x01 0x00 0x00 0x0a 0x00 0x04 0xff 0x98 0x81 0x02 0x29 0x01 0x00 0x00 0x0a 0x00 0x02 0x42 0x01 0x29 0x01 0x00 0x00 0x0a 0x00 0x02 0x44 0x01 0x29 0x01 0x00 0x00 0x0a 0x00 0x02 0x01 0x50 0x29 0x01 0x00 0x00 0x0a 0x00 0x02 0x15 0x10 0x29 0x01 0x00 0x00 0x0a 0x00 0x04 0xff 0x98 0x81 0x01 0x29 0x01 0x00 0x00 0x0a 0x00 0x02 0x01 0x00 0x29 0x01 0x00 0x00 0x0a 0x00 0x02 0x02 0x00 0x29 0x01 0x00 0x00 0x0a 0x00 0x02 0x03 0x56 0x29 0x01 0x00 0x00 0x0a 0x00 0x02 0x04 0x13 0x29 0x01 0x00 0x00 0x0a 0x00 0x02 0x05 0x13 0x29 0x01 0x00 0x00 0x0a 0x00 0x02 0x06 0x0a 0x29 0x01 0x00 0x00 0x0a 0x00 0x02 0x07 0x05 0x29 0x01 0x00 0x00 0x0a 0x00 0x02 0x08 0x05 0x29 0x01 0x00 0x00 0x0a 0x00 0x02 0x09 0x1d 0x29 0x01 0x00 0x00 0x0a 0x00 0x02 0x0a 0x01 0x29 0x01 0x00 0x00 0x0a 0x00 0x02 0x0b 0x00 0x29 0x01 0x00 0x00 0x0a 0x00 0x02 0x0c 0x3f 0x29 0x01 0x00 0x00 0x0a 0x00 0x02 0x0d 0x29 0x29 0x01 0x00 0x00 0x0a 0x00 0x02 0x0e 0x29 0x29 0x01 0x00 0x00 0x0a 0x00 0x02 0x0f 0x1d 0x29 0x01 0x00 0x00 0x0a 0x00 0x02 0x10 0x1d 0x29 0x01 0x00 0x00 0x0a 0x00 0x02 0x11 0x00 0x29 0x01 0x00 0x00 0x0a 0x00 0x02 0x12 0x00 0x29 0x01 0x00 0x00 0x0a 0x00 0x02 0x13 0x08 0x29 0x01 0x00 0x00 0x0a 0x00 0x02 0x14 0x08 0x29 0x01 0x00 0x00 0x0a 0x00 0x02 0x15 0x00 0x29 0x01 0x00 0x00 0x0a 0x00 0x02 0x16 0x00 0x29 0x01 0x00 0x00 0x0a 0x00 0x02 0x17 0x00 0x29 0x01 0x00 0x00 0x0a 0x00 0x02 0x18 0x00 0x29 0x01 0x00 0x00 0x0a 0x00 0x02 0x19 0x00 0x29 0x01 0x00 0x00 0x0a 0x00 0x02 0x1a 0x00 0x29 0x01 0x00 0x00 0x0a 0x00 0x02 0x1b 0x00 0x29 0x01 0x00 0x00 0x0a 0x00 0x02 0x1c 0x00 0x29 0x01 0x00 0x00 0x0a 0x00 0x02 0x1d 0x00 0x29 0x01 0x00 0x00 0x0a 0x00 0x02 0x1e 0x40 0x29 0x01 0x00 0x00 0x0a 0x00 0x02 0x1f 0x88 0x29 0x01 0x00 0x00 0x0a 0x00 0x02 0x20 0x08 0x29 0x01 0x00 0x00 0x0a 0x00 0x02 0x21 0x01 0x29 0x01 0x00 0x00 0x0a 0x00 0x02 0x22 0x00 0x29 0x01 0x00 0x00 0x0a 0x00 0x02 0x23 0x00 0x29 0x01 0x00 0x00 0x0a 0x00 0x02 0x24 0x00 0x29 0x01 0x00 0x00 0x0a 0x00 0x02 0x25 0x00 0x29 0x01 0x00 0x00 0x0a 0x00 0x02 0x26 0x00 0x29 0x01 0x00 0x00 0x0a 0x00 0x02 0x27 0x00 0x29 0x01 0x00 0x00 0x0a 0x00 0x02 0x28 0x33 0x29 0x01 0x00 0x00 0x0a 0x00 0x02 0x29 0x03 0x29 0x01 0x00 0x00 0x0a 0x00 0x02 0x2a 0x00 0x29 0x01 0x00 0x00 0x0a 0x00 0x02 0x2b 0x00 0x29 0x01 0x00 0x00 0x0a 0x00 0x02 0x2c 0x00 0x29 0x01 0x00 0x00 0x0a 0x00 0x02 0x2d 0x00 0x29 0x01 0x00 0x00 0x0a 0x00 0x02 0x2e 0x00 0x29 0x01 0x00 0x00 0x0a 0x00 0x02 0x2f 0x00 0x29 0x01 0x00 0x00 0x0a 0x00 0x02 0x30 0x00 0x29 0x01 0x00 0x00 0x0a 0x00 0x02 0x31 0x00 0x29 0x01 0x00 0x00 0x0a 0x00 0x02 0x32 0x00 0x29 0x01 0x00 0x00 0x0a 0x00 0x02 0x33 0x00 0x29 0x01 0x00 0x00 0x0a 0x00 0x02 0x34 0x00 0x29 0x01 0x00 0x00 0x0a 0x00 0x02 0x35 0x00 0x29 0x01 0x00 0x00 0x0a 0x00 0x02 0x36 0x00 0x29 0x01 0x00 0x00 0x0a 0x00 0x02 0x37 0x00 0x29 0x01 0x00 0x00 0x0a 0x00 0x02 0x38 0x00 0x29 0x01 0x00 0x00 0x0a 0x00 0x02 0x39 0x0f 0x29 0x01 0x00 0x00 0x0a 0x00 0x02 0x3a 0x2a 0x29 0x01 0x00 0x00 0x0a 0x00 0x02 0x3b 0x00 0x29 0x01 0x00 0x00 0x0a 0x00 0x02 0x3c 0x00 0x29 0x01 0x00 0x00 0x0a 0x00 0x02 0x3d 0x00 0x29 0x01 0x00 0x00 0x0a 0x00 0x02 0x3e 0x00 0x29 0x01 0x00 0x00 0x0a 0x00 0x02 0x3f 0x00 0x29 0x01 0x00 0x00 0x0a 0x00 0x02 0x40 0x00 0x29 0x01 0x00 0x00 0x0a 0x00 0x02 0x41 0xe0 0x29 0x01 0x00 0x00 0x0a 0x00 0x02 0x42 0x40 0x29 0x01 0x00 0x00 0x0a 0x00 0x02 0x43 0x0f 0x29 0x01 0x00 0x00 0x0a 0x00 0x02 0x44 0x11 0x29 0x01 0x00 0x00 0x0a 0x00 0x02 0x45 0xa8 0x29 0x01 0x00 0x00 0x0a 0x00 0x02 0x46 0x00 0x29 0x01 0x00 0x00 0x0a 0x00 0x02 0x47 0x08 0x29 0x01 0x00 0x00 0x0a 0x00 0x02 0x48 0x00 0x29 0x01 0x00 0x00 0x0a 0x00 0x02 0x49 0x01 0x29 0x01 0x00 0x00 0x0a 0x00 0x02 0x4a 0x00 0x29 0x01 0x00 0x00 0x0a 0x00 0x02 0x4b 0x00 0x29 0x01 0x00 0x00 0x0a 0x00 0x02 0x4c 0xb2 0x29 0x01 0x00 0x00 0x0a 0x00 0x02 0x4d 0x22 0x29 0x01 0x00 0x00 0x0a 0x00 0x02 0x4e 0x01 0x29 0x01 0x00 0x00 0x0a 0x00 0x02 0x4f 0xf7 0x29 0x01 0x00 0x00 0x0a 0x00 0x02 0x50 0x29 0x29 0x01 0x00 0x00 0x0a 0x00 0x02 0x51 0x72 0x29 0x01 0x00 0x00 0x0a 0x00 0x02 0x52 0x25 0x29 0x01 0x00 0x00 0x0a 0x00 0x02 0x53 0xb2 0x29 0x01 0x00 0x00 0x0a 0x00 0x02 0x54 0x22 0x29 0x01 0x00 0x00 0x0a 0x00 0x02 0x55 0x22 0x29 0x01 0x00 0x00 0x0a 0x00 0x02 0x56 0x22 0x29 0x01 0x00 0x00 0x0a 0x00 0x02 0x57 0xa2 0x29 0x01 0x00 0x00 0x0a 0x00 0x02 0x58 0x22 0x29 0x01 0x00 0x00 0x0a 0x00 0x02 0x59 0x01 0x29 0x01 0x00 0x00 0x0a 0x00 0x02 0x5a 0xe6 0x29 0x01 0x00 0x00 0x0a 0x00 0x02 0x5b 0x28 0x29 0x01 0x00 0x00 0x0a 0x00 0x02 0x5c 0x62 0x29 0x01 0x00 0x00 0x0a 0x00 0x02 0x5d 0x24 0x29 0x01 0x00 0x00 0x0a 0x00 0x02 0x5e 0xa2 0x29 0x01 0x00 0x00 0x0a 0x00 0x02 0x5f 0x22 0x29 0x01 0x00 0x00 0x0a 0x00 0x02 0x60 0x22 0x29 0x01 0x00 0x00 0x0a 0x00 0x02 0x61 0x22 0x29 0x01 0x00 0x00 0x0a 0x00 0x02 0x62 0xee 0x29 0x01 0x00 0x00 0x0a 0x00 0x02 0x63 0x02 0x29 0x01 0x00 0x00 0x0a 0x00 0x02 0x64 0x0b 0x29 0x01 0x00 0x00 0x0a 0x00 0x02 0x65 0x02 0x29 0x01 0x00 0x00 0x0a 0x00 0x02 0x66 0x02 0x29 0x01 0x00 0x00 0x0a 0x00 0x02 0x67 0x01 0x29 0x01 0x00 0x00 0x0a 0x00 0x02 0x68 0x00 0x29 0x01 0x00 0x00 0x0a 0x00 0x02 0x69 0x0f 0x29 0x01 0x00 0x00 0x0a 0x00 0x02 0x6a 0x07 0x29 0x01 0x00 0x00 0x0a 0x00 0x02 0x6b 0x55 0x29 0x01 0x00 0x00 0x0a 0x00 0x02 0x6c 0x02 0x29 0x01 0x00 0x00 0x0a 0x00 0x02 0x6d 0x02 0x29 0x01 0x00 0x00 0x0a 0x00 0x02 0x6e 0x5b 0x29 0x01 0x00 0x00 0x0a 0x00 0x02 0x6f 0x59 0x29 0x01 0x00 0x00 0x0a 0x00 0x02 0x70 0x02 0x29 0x01 0x00 0x00 0x0a 0x00 0x02 0x71 0x02 0x29 0x01 0x00 0x00 0x0a 0x00 0x02 0x72 0x57 0x29 0x01 0x00 0x00 0x0a 0x00 0x02 0x73 0x02 0x29 0x01 0x00 0x00 0x0a 0x00 0x02 0x74 0x02 0x29 0x01 0x00 0x00 0x0a 0x00 0x02 0x75 0x02 0x29 0x01 0x00 0x00 0x0a 0x00 0x02 0x76 0x02 0x29 0x01 0x00 0x00 0x0a 0x00 0x02 0x77 0x02 0x29 0x01 0x00 0x00 0x0a 0x00 0x02 0x78 0x02 0x29 0x01 0x00 0x00 0x0a 0x00 0x02 0x79 0x02 0x29 0x01 0x00 0x00 0x0a 0x00 0x02 0x7a 0x0a 0x29 0x01 0x00 0x00 0x0a 0x00 0x02 0x7b 0x02 0x29 0x01 0x00 0x00 0x0a 0x00 0x02 0x7c 0x02 0x29 0x01 0x00 0x00 0x0a 0x00 0x02 0x7d 0x01 0x29 0x01 0x00 0x00 0x0a 0x00 0x02 0x7e 0x00 0x29 0x01 0x00 0x00 0x0a 0x00 0x02 0x7f 0x0e 0x29 0x01 0x00 0x00 0x0a 0x00 0x02 0x80 0x06 0x29 0x01 0x00 0x00 0x0a 0x00 0x02 0x81 0x54 0x29 0x01 0x00 0x00 0x0a 0x00 0x02 0x82 0x02 0x29 0x01 0x00 0x00 0x0a 0x00 0x02 0x83 0x02 0x29 0x01 0x00 0x00 0x0a 0x00 0x02 0x84 0x5a 0x29 0x01 0x00 0x00 0x0a 0x00 0x02 0x85 0x58 0x29 0x01 0x00 0x00 0x0a 0x00 0x02 0x86 0x02 0x29 0x01 0x00 0x00 0x0a 0x00 0x02 0x87 0x02 0x29 0x01 0x00 0x00 0x0a 0x00 0x02 0x88 0x56 0x29 0x01 0x00 0x00 0x0a 0x00 0x02 0x89 0x02 0x29 0x01 0x00 0x00 0x0a 0x00 0x02 0x8a 0x02 0x29 0x01 0x00 0x00 0x0a 0x00 0x02 0x8b 0x02 0x29 0x01 0x00 0x00 0x0a 0x00 0x02 0x8c 0x02 0x29 0x01 0x00 0x00 0x0a 0x00 0x02 0x8d 0x02 0x29 0x01 0x00 0x00 0x0a 0x00 0x02 0x8e 0x02 0x29 0x01 0x00 0x00 0x0a 0x00 0x02 0x8f 0x44 0x29 0x01 0x00 0x00 0x0a 0x00 0x02 0x90 0x44 0x29 0x01 0x00 0x00 0x0a 0x00 0x04 0xff 0x98 0x81 0x02 0x29 0x01 0x00 0x00 0x0a 0x00 0x15 0x57 0x00 0x1d 0x2b 0x14 0x19 0x2b 0x1f 0x20 0x90 0x1e 0x2a 0x7a 0x19 0x17 0x4a 0x20 0x26 0x4a 0x5b 0x2c 0x29 0x01 0x00 0x00 0x0a 0x00 0x15 0x6b 0x00 0x1d 0x2b 0x14 0x19 0x2b 0x1f 0x20 0x90 0x1e 0x2a 0x7a 0x19 0x17 0x4a 0x20 0x26 0x4a 0x5b 0x2c 0x29 0x01 0x00 0x00 0x0a 0x00 0x04 0xff 0x98 0x81 0x03 0x29 0x01 0x00 0x00 0x0a 0x00 0x02 0x80 0x4d 0x29 0x01 0x00 0x00 0x0a 0x00 0x02 0x81 0x45 0x29 0x01 0x00 0x00 0x0a 0x00 0x02 0x82 0x44 0x29 0x01 0x00 0x00 0x0a 0x00 0x02 0x83 0x20 0x29 0x01 0x00 0x00 0x0a 0x00 0x02 0x84 0x00 0x29 0x01 0x00 0x00 0x0a 0x00 0x04 0xff 0x98 0x81 0x00 0x29 0x01 0x00 0x00 0x0a 0x00 0x03 0x51 0x00 0x00 0x29 0x01 0x00 0x00 0x0a 0x00 0x02 0x53 0x2c 0x29 0x01 0x00 0x00 0x0a 0x00 0x02 0x55 0x00 0x29 0x01 0x00 0x00 0x0a 0x00 0x02 0x35 0x00 0x29 0x01 0x00 0x00 0x0a 0x00 0x02 0x36 0x00 0x29 0x01 0x00 0x00 0x78 0x01 0x02 0x11 0x00 0x05 0x01 0x00 0x00 0x32 0x01 0x02 0x29 0x00>;
				lcd-kit,panel-on-cmds-state = "dsi_lp_mode";
				lcd-kit,panel-off-cmds = <0x05 0x01 0x00 0x00 0x28 0x01 0x02 0x28 0x00 0x05 0x01 0x00 0x00 0x3c 0x01 0x02 0x10 0x00>;
				lcd-kit,panel-off-cmds-state = "dsi_lp_mode";
				lcd-kit,backlight-cmds = <0x29 0x01 0x00 0x00 0x00 0x00 0x03 0x51 0x00 0x00>;
				lcd-kit,backlight-cmds-state = "dsi_lp_mode";
				lcd-kit,tp-color-cmds = <0x06 0x01 0x00 0x00 0x0a 0x00 0x01 0xda>;
				lcd-kit,inversion-dot-cmds = <0x29 0x01 0x00 0x00 0x05 0x01 0x04 0xff 0x98 0x81 0x02 0x29 0x01 0x00 0x00 0x0a 0x00 0x02 0x40 0x04 0x29 0x01 0x00 0x00 0x0a 0x00 0x04 0xff 0x98 0x81 0x00>;
				lcd-kit,inversion-column-cmds = <0x29 0x01 0x00 0x00 0x05 0x01 0x04 0xff 0x98 0x81 0x02 0x29 0x01 0x00 0x00 0x0a 0x00 0x02 0x40 0x00 0x29 0x01 0x00 0x00 0x0a 0x00 0x04 0xff 0x98 0x81 0x00>;
				lcd-kit,esd-reg-cmds = <0x06 0x01 0x00 0x00 0x0a 0x00 0x01 0x54 0x06 0x01 0x00 0x00 0x0a 0x00 0x03 0x09 0x00 0x00>;
				lcd-kit,esd-reg-cmds-state = "dsi_lp_mode";
				lcd-kit,esd-value = <0x2c 0x80 0x03 0x06>;
				lcd-kit,check-reg-cmds = <0x06 0x01 0x00 0x00 0x0a 0x00 0x01 0x0a>;
				lcd-kit,check-reg-cmds-state = "dsi_lp_mode";
				lcd-kit,check-reg-value = <0x9c>;
				lcd-kit,barcode-2d-cmds;
				lcd-kit,project-id-cmds;
				lcd-kit,project-id-cmds-state = "dsi_lp_mode";
				lcd-kit,panel-bl-maxnit-command = <0x06 0x01 0x00 0x00 0x0a 0x00 0x01 0xdb>;
				lcd-kit,panel-bl-maxnit-command-state = "dsi_lp_mode";
				lcd-kit,panel-lcm-type = <0x02>;
				lcd-kit,panel-ldi-dsi-mode = <0x01>;
				lcd-kit,panel-dsi-switch-mode = <0x00>;
				lcd-kit,panel-dsi-switch-mode-en = <0x00>;
				lcd-kit,panel-ldi-trans-seq = <0x00>;
				lcd-kit,panel-ldi-data-padding = <0x00>;
				lcd-kit,panel-ldi-packet-size = <0x100>;
				lcd-kit,panel-ldi-ps = <0x02>;
				lcd-kit,panel-vfp-lp = <0x00>;
				lcd-kit,panel-fbk-div = <0x01>;
				lcd-kit,panel-orientation = <0x01>;
				lcd-kit,panel-bpp = <0x02>;
				lcd-kit,panel-bgr-fmt = <0x00>;
				lcd-kit,panel-cmd-type = <0x08>;
				lcd-kit,panel-pxl-clk = <0x00>;
				lcd-kit,panel-pxl-clk-div = <0x00>;
				lcd-kit,panel-data-rate = <0x2a0>;
				lcd-kit,mipi-lane-nums = <0x03>;
				lcd-kit,h-back-porch = <0x46>;
				lcd-kit,h-front-porch = <0x46>;
				lcd-kit,h-pulse-width = <0x18>;
				lcd-kit,project-id-support = <0x00>;
				lcd-kit,default-project-id = "Y1639J1700";
				lcd-kit,v-back-porch = <0x18>;
				lcd-kit,v-front-porch = <0x18>;
				lcd-kit,v-pulse-width = <0x08>;
				lcd-kit,mipi-clk-post-adjust = <0x00>;
				lcd-kit,mipi-lp11-flag = <0x00>;
				lcd-kit,esd-support = <0x01>;
				lcd-kit,esd-recovery-bl-support = <0x01>;
				lcd-kit,tp-color-support = <0x00>;
				lcd-kit,lcd-vsp = <0x02 0x96 0x53ec60>;
				lcd-kit,lcd-vsn = <0x02 0x97 0x53ec60>;
				lcd-kit,lcd-reset = <0x02 0x2d 0x00>;
				lcd-kit,power-on-stage = <0x03 0x01 0x00 0x04 0x01 0x05 0x0b 0x01 0x00 0x05 0x01 0x01 0x05 0x02 0x05 0x05 0x01 0x0c 0x07 0x01 0x00 0x06 0x01 0x00 0x08 0x01 0x00>;
				lcd-kit,lp-on-stage = <0x00 0x00 0x00>;
				lcd-kit,hs-on-stage = <0x00 0x00 0x00>;
				lcd-kit,hs-off-stage = <0x00 0x00 0x00>;
				lcd-kit,lp-off-stage = <0x00 0x00 0x00>;
				lcd-kit,power-off-stage = <0x07 0x00 0x00 0x06 0x00 0x00 0x08 0x00 0x00 0x05 0x00 0x0a 0x04 0x00 0x00 0x03 0x00 0x06>;
				lcd-kit,pt-support = <0x01>;
				lcd-kit,panel-density = <0x140>;
				lcd-kit,ssc-disable = <0x00>;
				lcd-kit,ssc-range = <0x03>;
				lcd-kit,inversion-support = <0x01>;
				lcd-kit,check-reg-support = <0x01>;
				lcd-kit,panel-bl-min = <0x30>;
				lcd-kit,panel-bl-max = <0xfff>;
				lcd-kit,panel-bl-max-nit = <0x1c2>;
				lcd-kit,mipi-non-continue-enable = <0x01>;
				lcd-kit,panel-getblmaxnit-type = <0x01>;
				lcd-kit,panel-bl-ic-ctrl-type = <0x08>;
				lcd-kit,panel-bias-ic-ctrl-type = <0x03>;
				lcd-kit,oem-info-support = <0x00>;
				lcd-kit,oem-barcode-2d-support = <0x00>;
				lcd-kit,oem-barcode-2d-num-offset = <0x00>;
				lcd-kit,panel-on-always-reset = <0x01>;
				lcd-kit,panel-gpio-offset = <0x149>;
				phandle = <0x42>;
			};
		};
	};

	fragment@25 {
		target = <0xffffffff>;

		__overlay__ {
			compatible = "huawei,lcd_panel_type";
			product_id = <0x3ed>;
			detect_type = <0x02>;
			gpio_id = <0xa9 0xb2>;
			support_lcd_type = "LCD_KIT";
			iovcc_ctrl_mode = <0x01>;
		};
	};

	fragment@26 {
		target = <0xffffffff>;

		__overlay__ {

			lcm_rst_out0_gpio {
				phandle = <0x12>;

				pins_cmd_dat {
					pinmux = <0x2d00>;
					slew-rate = <0x01>;
					output-low;
				};
			};

			lcm_rst_out1_gpio {
				phandle = <0x13>;

				pins_cmd_dat {
					pinmux = <0x2d00>;
					slew-rate = <0x01>;
					output-high;
				};
			};
		};
	};

	fragment@27 {
		target = <0xffffffff>;

		__overlay__ {
			pinctrl-names = "lcm_rst_out0_gpio\0lcm_rst_out1_gpio";
			pinctrl-0 = <0x12>;
			pinctrl-1 = <0x13>;
			status = "okay";
		};
	};

	fragment@28 {
		target = <0xffffffff>;

		__overlay__ {

			sm5109@3e {
				compatible = "sm,sm5109";
				reg = <0x3e>;
				sm5109_i2c_bus_id = <0x05>;
				sm5109_support = <0x01>;
			};
		};
	};

	fragment@29 {
		target = <0xffffffff>;

		__overlay__ {

			consys_default {
				phandle = <0x14>;
			};

			gpslna@0 {
				phandle = <0x15>;

				pins_cmd_dat {
					pinmux = <0x5b00>;
					slew-rate = <0x00>;
					bias-disable;
					output-low;
				};
			};

			gpslna@1 {
				phandle = <0x16>;

				pins_cmd_dat {
					pinmux = <0x5b00>;
					slew-rate = <0x01>;
					output-high;
				};
			};

			gpslna@2 {
				phandle = <0x17>;

				pins_cmd_dat {
					pinmux = <0x5b00>;
					slew-rate = <0x01>;
					output-low;
				};
			};
		};
	};

	fragment@30 {
		target = <0xffffffff>;

		__overlay__ {
			pinctrl-names = "default\0gps_lna_state_init\0gps_lna_state_oh\0gps_lna_state_ol";
			pinctrl-0 = <0x14>;
			pinctrl-1 = <0x15>;
			pinctrl-2 = <0x16>;
			pinctrl-3 = <0x17>;
			status = "okay";
		};
	};

	fragment@31 {
		target = <0xffffffff>;

		__overlay__ {
			compatible = "huawei,huawei_scp_info";
			direction_number = <0x01>;
			status = "okay";
		};
	};

	fragment@32 {
		target = <0xffffffff>;

		__overlay__ {
			compatible = "hisi,shell-temp";
			interval = <0x1388>;
			bias = <0x323de>;
			count = <0x07>;
			tsensor_para = "10000\0100000\00";
			ntc_para = "2000\080000\0-20000";
			status = "ok";

			sensors {

				sensor0 {
					type = "msm_therm";
					coef = "868\01001\0-1255\0-75\0441\05634\021564";
				};

				sensor1 {
					type = "pa_therm0";
					coef = "-9134\0246\0-3722\0-49\0-2055\01165\0528";
				};

				sensor2 {
					type = "pmic_xo_therm";
					coef = "3064\02003\0-1505\04557\0-1930\03606\023016";
				};

				sensor3 {
					type = "COOL_THERM";
					coef = "2546\01325\01294\0-283\022\0622\0591";
				};

				sensor4 {
					type = "battery";
					coef = "-19490000\0-8326000\0-2006000\05061000\013771000\021888000\028522000";
				};
			};
		};
	};

	fragment@33 {
		target = <0xffffffff>;

		__overlay__ {
			compatible = "hisi,shell-temp";
			interval = <0x1388>;
			bias = <0x1d45d>;
			count = <0x07>;
			tsensor_para = "10000\0100000\00";
			ntc_para = "2000\080000\0-20000";
			status = "ok";

			sensors {

				sensor0 {
					type = "msm_therm";
					coef = "-18327\0-9672\0-7228\0-7465\0-5568\0-3765\09593";
				};

				sensor1 {
					type = "pa_therm0";
					coef = "-10931\0371\0-3992\0-434\0-1295\0395\07499";
				};

				sensor2 {
					type = "pmic_xo_therm";
					coef = "16425\07838\0704\08406\0485\06907\031231";
				};

				sensor3 {
					type = "COOL_THERM";
					coef = "360\0-770\0-383\0-1926\0-1220\0-2214\0-2643";
				};

				sensor4 {
					type = "battery";
					coef = "-27172000\0-12732000\0-1811000\09335000\023012000\037954000\050219000";
				};
			};
		};
	};

	fragment@34 {
		target = <0xffffffff>;

		__overlay__ {
			compatible = "hisi,shell-temp";
			interval = <0x1388>;
			bias = <0x375af>;
			count = <0x07>;
			tsensor_para = "10000\0100000\00";
			ntc_para = "2000\080000\0-20000";
			status = "ok";

			sensors {

				sensor0 {
					type = "msm_therm";
					coef = "7498\04840\02485\02938\03072\05179\010244";
				};

				sensor1 {
					type = "pa_therm0";
					coef = "2921\0714\00\01344\0-320\01261\07368";
				};

				sensor2 {
					type = "pmic_xo_therm";
					coef = "-4242\0-2814\0-2126\0-2362\0-2662\0-1648\0-4888";
				};

				sensor3 {
					type = "COOL_THERM";
					coef = "516\0742\0257\0-685\0-580\0-519\0-556";
				};

				sensor4 {
					type = "battery";
					coef = "12689000\011794000\010256000\08488000\08378000\07054000\04871000";
				};
			};
		};
	};

	fragment@35 {
		target = <0xffffffff>;

		__overlay__ {
			pinctrl-names = "aud_clk_mosi_off\0aud_clk_mosi_on\0aud_clk_miso_off\0aud_clk_miso_on\0aud_dat_mosi_off\0aud_dat_mosi_on\0aud_dat_miso_off\0aud_dat_miso_on";
			pinctrl-0 = <0x18>;
			pinctrl-1 = <0x19>;
			pinctrl-2 = <0x1a>;
			pinctrl-3 = <0x1b>;
			pinctrl-4 = <0x1c>;
			pinctrl-5 = <0x1d>;
			pinctrl-6 = <0x1e>;
			pinctrl-7 = <0x1f>;
			status = "okay";
		};
	};

	fragment@36 {
		target = <0xffffffff>;

		__overlay__ {

			aud_clk_mosi_off {
				phandle = <0x18>;

				pins_cmd0_dat {
					pinmux = <0x8800>;
				};
			};

			aud_clk_mosi_on {
				phandle = <0x19>;

				pins_cmd0_dat {
					pinmux = <0x8801>;
				};
			};

			aud_clk_miso_off {
				phandle = <0x1a>;

				pins_cmd0_dat {
					pinmux = <0x8c00>;
				};
			};

			aud_clk_miso_on {
				phandle = <0x1b>;

				pins_cmd0_dat {
					pinmux = <0x8c01>;
				};
			};

			aud_dat_mosi_off {
				phandle = <0x1c>;

				pins_cmd1_dat {
					pinmux = <0x8a00>;
					input-enable;
					slew-rate = <0x00>;
					bias-disable;
				};

				pins_cmd2_dat {
					pinmux = <0x8b00>;
					input-enable;
					slew-rate = <0x00>;
					bias-disable;
				};
			};

			aud_dat_mosi_on {
				phandle = <0x1d>;

				pins_cmd1_dat {
					pinmux = <0x8a01>;
				};

				pins_cmd2_dat {
					pinmux = <0x8b01>;
				};
			};

			aud_dat_miso_off {
				phandle = <0x1e>;

				pins_cmd1_dat {
					pinmux = <0x8e00>;
					input-enable;
					slew-rate = <0x00>;
					bias-disable;
				};

				pins_cmd2_dat {
					pinmux = <0x8f00>;
					input-enable;
					slew-rate = <0x00>;
					bias-disable;
				};
			};

			aud_dat_miso_on {
				phandle = <0x1f>;

				pins_cmd1_dat {
					pinmux = <0x8e01>;
				};

				pins_cmd2_dat {
					pinmux = <0x8f01>;
				};
			};
		};
	};

	fragment@37 {
		target = <0xffffffff>;

		__overlay__ {
			simple-pa-gpio-enale = <0xffffffff 0x99 0x00>;
			use_two_in_one_speaker = <0x00>;
		};
	};

	fragment@38 {
		target = <0xffffffff>;

		__overlay__ {
			audio_param_path = "odm/etc/audio/audio_param_aw87328";
			audio_param_ce_path = "odm/etc/audio/audio_param_ce_aw87328";
		};
	};

	fragment@39 {
		target = <0xffffffff>;

		__overlay__ {
			accdet-mic-vol = <0x06>;
			headset-mode-setting = <0x500 0x500 0x01 0x1f0 0x800 0x800 0x20 0x44>;
			accdet-plugout-debounce = <0x01>;
			accdet-mic-mode = <0x01>;
			headset-eint-level-pol = <0x08>;
			headset-three-key-threshold = <0x00 0x50 0xdc 0x190>;
			headset-three-key-threshold-CDD = <0x00 0x79 0xc0 0x258>;
			headset-four-key-threshold = <0x00 0x3a 0x79 0xc0 0x190>;
			pinctrl-names = "default\0state_eint_as_int";
			pinctrl-0 = <0x20>;
			pinctrl-1 = <0x21>;
			status = "okay";
		};
	};

	fragment@40 {
		target = <0xffffffff>;

		__overlay__ {

			accdetdefault {
				phandle = <0x20>;
			};

			accdeteint@0 {
				phandle = <0x21>;

				pins_cmd_dat {
					pinmux = <0x900>;
					slew-rate = <0x00>;
					bias-disable;
				};
			};
		};
	};

	fragment@41 {
		target = <0xffffffff>;

		__overlay__ {
			status = "disabled";
		};
	};

	fragment@42 {
		target = <0xffffffff>;

		__overlay__ {
			compatible = "huawei,huawei_fm_info";
			status = "okay";
			fm,fm_elna_pins = <0xffffffff 0x07 0x00>;
		};
	};

	fragment@43 {
		target = <0xffffffff>;

		__overlay__ {
			regulator-min-microvolt = <0x2dc6c0>;
			regulator-max-microvolt = <0x2dc6c0>;
			regulator-default-on = <0x02>;
			regulator-always-on;
			regulator-boot-on;
		};
	};

	fragment@44 {
		target = <0xffffffff>;

		__overlay__ {
			#address-cells = <0x01>;
			#size-cells = <0x00>;
			clock-frequency = <0x61a80>;
			mediatek,use-open-drain;

			camera_main@10 {
				compatible = "mediatek,camera_main";
				reg = <0x10>;
				status = "okay";
				phandle = <0x43>;
			};

			camera_main_eeprom@50 {
				compatible = "mediatek,camera_main_eeprom";
				reg = <0x50>;
				status = "okay";
				phandle = <0x44>;
			};

			camera_main_af@0c {
				compatible = "mediatek,camera_main_af";
				reg = <0x0c>;
				status = "okay";
				phandle = <0x45>;
			};
		};
	};

	fragment@45 {
		target = <0xffffffff>;

		__overlay__ {
			#address-cells = <0x01>;
			#size-cells = <0x00>;
			clock-frequency = <0x61a80>;
			mediatek,use-open-drain;

			camera_sub@36 {
				compatible = "mediatek,camera_sub";
				reg = <0x36>;
				status = "okay";
				phandle = <0x46>;
			};

			camera_sub_eeprom@52 {
				compatible = "mediatek,camera_sub_eeprom";
				reg = <0x52>;
				status = "okay";
				phandle = <0x47>;
			};

			camera_main_two@17 {
				compatible = "mediatek,camera_main_two";
				reg = <0x17>;
				status = "okay";
				phandle = <0x48>;
			};

			camera_main_two_eeprom@50 {
				compatible = "mediatek,camera_main_two_eeprom";
				reg = <0x50>;
				status = "okay";
				phandle = <0x49>;
			};

			camera_sub_two@22 {
				compatible = "mediatek,camera_sub_two";
				reg = <0x22>;
				status = "okay";
				phandle = <0x4a>;
			};

			camera_sub_two_eeprom@55 {
				compatible = "mediatek,camera_sub_two_eeprom";
				reg = <0x55>;
				status = "okay";
				phandle = <0x4b>;
			};
		};
	};

	fragment@46 {
		target = <0xffffffff>;

		__overlay__ {

			flashlight@63 {
				compatible = "mediatek,flashlights_aw36514_i2c";
				reg = <0x63>;
				status = "okay";
			};
		};
	};

	fragment@47 {
		target = <0xffffffff>;

		__overlay__ {

			camera_pins_cam0_mclk_on {
				phandle = <0x2b>;

				pins_cmd_dat {
					pinmux = <0x6301>;
				};
			};

			camera_pins_cam0_mclk_off {
				phandle = <0x2c>;

				pins_cmd_dat {
					pinmux = <0x6300>;
				};
			};

			camera_pins_cam1_mclk_on {
				phandle = <0x2d>;

				pins_cmd_dat {
					pinmux = <0x6301>;
				};
			};

			camera_pins_cam1_mclk_off {
				phandle = <0x2e>;

				pins_cmd_dat {
					pinmux = <0x6300>;
				};
			};

			cam0@0 {
				phandle = <0x23>;

				pins_cmd_dat {
					pinmux = <0x6500>;
					slew-rate = <0x01>;
					output-low;
				};
			};

			cam0@1 {
				phandle = <0x24>;

				pins_cmd_dat {
					pinmux = <0x6500>;
					slew-rate = <0x01>;
					output-high;
				};
			};

			cam0@2 {
				phandle = <0x25>;

				pins_cmd_dat {
					pinmux = <0x6100>;
					slew-rate = <0x01>;
					output-low;
				};
			};

			cam0@3 {
				phandle = <0x26>;

				pins_cmd_dat {
					pinmux = <0x6100>;
					slew-rate = <0x01>;
					output-high;
				};
			};

			cam1@0 {
				phandle = <0x27>;

				pins_cmd_dat {
					pinmux = <0x6600>;
					slew-rate = <0x01>;
					output-low;
				};
			};

			cam1@1 {
				phandle = <0x28>;

				pins_cmd_dat {
					pinmux = <0x6600>;
					slew-rate = <0x01>;
					output-high;
				};
			};

			cam1@2 {
				phandle = <0x29>;

				pins_cmd_dat {
					pinmux = <0x6200>;
					slew-rate = <0x01>;
					output-low;
				};
			};

			cam1@3 {
				phandle = <0x2a>;

				pins_cmd_dat {
					pinmux = <0x6200>;
					slew-rate = <0x01>;
					output-high;
				};
			};

			camdefault {
				phandle = <0x22>;

				pins_cmd_dat {
					pinmux = <0x6b00 0x6d00>;
					slew-rate = <0x00>;
					bias-disable;
				};
			};
		};
	};

	fragment@48 {
		target = <0xffffffff>;

		__overlay__ {
			pinctrl-names = "default\0cam0_rst0\0cam0_rst1\0cam0_pnd0\0cam0_pnd1\0cam1_rst0\0cam1_rst1\0cam1_pnd0\0cam1_pnd1\0cam0_mclk_on\0cam0_mclk_off\0cam1_mclk_on\0cam1_mclk_off";
			pinctrl-0 = <0x22>;
			pinctrl-1 = <0x23>;
			pinctrl-2 = <0x24>;
			pinctrl-3 = <0x25>;
			pinctrl-4 = <0x26>;
			pinctrl-5 = <0x27>;
			pinctrl-6 = <0x28>;
			pinctrl-7 = <0x29>;
			pinctrl-8 = <0x2a>;
			pinctrl-9 = <0x2b>;
			pinctrl-10 = <0x2c>;
			pinctrl-11 = <0x2d>;
			pinctrl-12 = <0x2e>;
			cam0_vcama-supply = <0xffffffff>;
			cam0_vcamd-supply = <0xffffffff>;
			cam0_vcamio-supply = <0xffffffff>;
			cam0_vcamaf-supply = <0xffffffff>;
			cam1_vcama-supply = <0xffffffff>;
			cam1_vcamd-supply = <0xffffffff>;
			cam1_vcamio-supply = <0xffffffff>;
			cam0_enable_sensor = "hi846_truly gc8034_sunwin gc8034_txd ov8856_hlt s5k4h7_txd";
			cam1_enable_sensor = "s5k5e9yx_sunrise hi556_seasons gc5035_lce gc5025h_sunwin";
			status = "okay";
		};
	};

	fragment@49 {
		target = <0xffffffff>;

		__overlay__ {

			default {
				phandle = <0x2f>;

				pins_cmd_dat {
					pinmux = <0x9800>;
					slew-rate = <0x01>;
					output-high;
				};
			};

			hwen_high {
				phandle = <0x30>;

				pins_cmd_dat {
					pinmux = <0x9800>;
					slew-rate = <0x01>;
					output-high;
				};
			};

			hwen_low {
				phandle = <0x31>;

				pins_cmd_dat {
					pinmux = <0x9800>;
					slew-rate = <0x01>;
					output-low;
				};
			};

			strobe_high {
				phandle = <0x32>;

				pins_cmd_dat {
					pinmux = <0x9a00>;
					slew-rate = <0x01>;
					output-high;
				};
			};

			strobe_low {
				phandle = <0x33>;

				pins_cmd_dat {
					pinmux = <0x9a00>;
					slew-rate = <0x01>;
					output-low;
				};
			};
		};
	};

	fragment@50 {
		target = <0xffffffff>;

		__overlay__ {
			pinctrl-names = "default\0hwen_high\0hwen_low\0strobe_high\0strobe_low";
			pinctrl-0 = <0x2f>;
			pinctrl-1 = <0x30>;
			pinctrl-2 = <0x31>;
			pinctrl-3 = <0x32>;
			pinctrl-4 = <0x33>;
			status = "okay";
		};
	};

	fragment@51 {
		target = <0xffffffff>;

		__overlay__ {
			product-name = "DuraHmsCam";
		};
	};

	fragment@52 {
		target = <0xffffffff>;

		__overlay__ {
			mtk,boardid = <0x04 0x05 0x03 0x02>;
			mtk,board_name = "DUA_LX9_VB";
			mtk,product_name = "DUA-LX9";
			hardware_version = "HL1DUAM";
		};
	};

	fragment@53 {
		target = <0xffffffff>;

		__overlay__ {
			status = "disable";
		};
	};

	fragment@54 {
		target = <0xffffffff>;

		__overlay__ {

			adc_channel@ {
				compatible = "mediatek,adc_channel";
				mediatek,temperature0 = <0x00>;
				mediatek,temperature1 = <0x01>;
				mediatek,adc_fdd_rf_params_dynamic_custom_ch = <0x02>;
				status = "okay";
			};
		};
	};

	fragment@55 {
		target = <0xffffffff>;

		__overlay__ {
			mediatek,clkbuf-quantity = <0x07>;
			mediatek,clkbuf-config = <0x02 0x01 0x01 0x02 0x00 0x00 0x00>;
			mediatek,clkbuf-driving-current = <0x01 0x01 0x01 0x01 0x01 0x01 0x01>;
			status = "okay";
		};
	};

	fragment@56 {
		target = <0xffffffff>;

		__overlay__ {
			#address-cells = <0x01>;
			#size-cells = <0x00>;
			clock-frequency = <0x61a80>;
			mediatek,use-open-drain;

			cap_touch@5d {
				compatible = "mediatek,cap_touch";
				reg = <0x5d>;
				status = "okay";
				phandle = <0x4c>;
			};
		};
	};

	fragment@57 {
		target = <0xffffffff>;

		__overlay__ {
			#address-cells = <0x01>;
			#size-cells = <0x00>;
			clock-frequency = <0x61a80>;
			mediatek,use-open-drain;
		};
	};

	fragment@58 {
		target = <0xffffffff>;

		__overlay__ {
			#address-cells = <0x01>;
			#size-cells = <0x00>;
			clock-frequency = <0x61a80>;
			mediatek,use-open-drain;
		};
	};

	fragment@59 {
		target = <0xffffffff>;

		__overlay__ {
			#address-cells = <0x01>;
			#size-cells = <0x00>;
			clock-frequency = <0x61a80>;
			mediatek,use-open-drain;

			speaker_amp@34 {
				compatible = "mediatek,speaker_amp";
				reg = <0x34>;
				status = "okay";
				phandle = <0x4d>;
			};

			slave_charger@4b {
				compatible = "mediatek,slave_charger";
				reg = <0x4b>;
				status = "okay";
				phandle = <0x4e>;
			};

			nfc@08 {
				compatible = "mediatek,nfc";
				reg = <0x08>;
				status = "okay";
				phandle = <0x4f>;
			};

			ext_buck_lp4@57 {
				compatible = "mediatek,ext_buck_lp4";
				reg = <0x57>;
				status = "okay";
				phandle = <0x50>;
			};

			ext_buck_lp4x@50 {
				compatible = "mediatek,ext_buck_lp4x";
				reg = <0x50>;
				status = "okay";
				phandle = <0x51>;
			};
		};
	};

	fragment@60 {
		target = <0xffffffff>;

		__overlay__ {
			#address-cells = <0x01>;
			#size-cells = <0x00>;
			clock-frequency = <0x61a80>;
			mediatek,use-open-drain;
		};
	};

	fragment@61 {
		target = <0xffffffff>;

		__overlay__ {
			#address-cells = <0x01>;
			#size-cells = <0x00>;
			clock-frequency = <0x33e140>;
			mediatek,use-push-pull;

			subpmic_pmu@34 {
				compatible = "mediatek,subpmic_pmu";
				reg = <0x34>;
				status = "okay";
				phandle = <0x52>;
			};

			usb_type_c@4e {
				compatible = "mediatek,usb_type_c";
				reg = <0x4e>;
				status = "okay";
				phandle = <0x53>;
			};
		};
	};

	fragment@62 {
		target = <0xffffffff>;

		__overlay__ {
			#address-cells = <0x01>;
			#size-cells = <0x00>;
			clock-frequency = <0x61a80>;
			mediatek,use-open-drain;

			ext_buck_vgpu@55 {
				compatible = "mediatek,ext_buck_vgpu";
				reg = <0x55>;
				status = "okay";
				phandle = <0x54>;
			};
		};
	};

	fragment@63 {
		target = <0xffffffff>;

		__overlay__ {
			#address-cells = <0x01>;
			#size-cells = <0x00>;
			clock-frequency = <0x61a80>;
			mediatek,use-open-drain;
		};
	};

	fragment@64 {
		target = <0xffffffff>;

		__overlay__ {
			#address-cells = <0x01>;
			#size-cells = <0x00>;
			clock-frequency = <0x61a80>;
			mediatek,use-open-drain;
		};
	};

	fragment@65 {
		target = <0xffffffff>;

		__overlay__ {
			#address-cells = <0x01>;
			#size-cells = <0x00>;
			clock-frequency = <0x61a80>;
			mediatek,use-open-drain;
		};
	};

	fragment@66 {
		target = <0xffffffff>;

		__overlay__ {
			GPIO_SIM2_SIO = <0xffffffff 0x23 0x00>;
			GPIO_SIM2_SRST = <0xffffffff 0x24 0x00>;
			GPIO_SIM2_SCLK = <0xffffffff 0x25 0x00>;
			GPIO_SIM1_SCLK = <0xffffffff 0x26 0x00>;
			GPIO_SIM1_SRST = <0xffffffff 0x27 0x00>;
			GPIO_SIM1_SIO = <0xffffffff 0x28 0x00>;
			GPIO_SIM2_HOT_PLUG = <0xffffffff 0x2e 0x00>;
			GPIO_SIM1_HOT_PLUG = <0xffffffff 0x2f 0x00>;
			GPIO_FDD_BAND_SUPPORT_DETECT_4TH_PIN = <0xffffffff 0xa3 0x00>;
			GPIO_FDD_BAND_SUPPORT_DETECT_3RD_PIN = <0xffffffff 0xa4 0x00>;
			GPIO_FDD_BAND_SUPPORT_DETECT_2ND_PIN = <0xffffffff 0xa5 0x00>;
			GPIO_FDD_BAND_SUPPORT_DETECT_1ST_PIN = <0xffffffff 0xa6 0x00>;
			GPIO_FDD_BAND_SUPPORT_DETECT_5TH_PIN = <0xffffffff 0xa7 0x00>;
		};
	};

	fragment@67 {
		target = <0xffffffff>;

		__overlay__ {
			gpio_init_default = <0x00 0x00 0x00 0x00 0x01 0x01 0x01 0x01 0x00 0x00 0x00 0x01 0x01 0x01 0x02 0x00 0x00 0x00 0x01 0x01 0x01 0x03 0x00 0x00 0x00 0x01 0x01 0x01 0x04 0x05 0x00 0x00 0x01 0x01 0x00 0x05 0x00 0x00 0x00 0x01 0x01 0x00 0x06 0x00 0x00 0x00 0x01 0x00 0x00 0x07 0x00 0x00 0x00 0x01 0x01 0x00 0x08 0x07 0x00 0x00 0x01 0x01 0x00 0x09 0x00 0x00 0x00 0x01 0x01 0x00 0x0a 0x00 0x00 0x00 0x01 0x00 0x00 0x0b 0x00 0x00 0x00 0x01 0x01 0x00 0x0c 0x00 0x00 0x00 0x01 0x01 0x00 0x0d 0x03 0x00 0x00 0x01 0x00 0x00 0x0e 0x03 0x01 0x00 0x00 0x00 0x00 0x0f 0x03 0x01 0x00 0x00 0x00 0x00 0x10 0x03 0x01 0x00 0x00 0x00 0x00 0x11 0x06 0x00 0x00 0x01 0x00 0x00 0x12 0x06 0x01 0x00 0x00 0x00 0x00 0x13 0x06 0x01 0x00 0x00 0x00 0x00 0x14 0x06 0x01 0x00 0x00 0x00 0x00 0x15 0x03 0x00 0x00 0x01 0x01 0x00 0x16 0x03 0x00 0x00 0x01 0x00 0x00 0x17 0x00 0x00 0x00 0x01 0x01 0x00 0x18 0x03 0x00 0x00 0x01 0x00 0x00 0x19 0x01 0x00 0x00 0x01 0x00 0x00 0x1a 0x01 0x01 0x00 0x00 0x00 0x00 0x1b 0x01 0x01 0x00 0x00 0x00 0x00 0x1c 0x01 0x01 0x00 0x00 0x00 0x00 0x1d 0x01 0x01 0x00 0x00 0x00 0x01 0x1e 0x01 0x00 0x00 0x01 0x01 0x01 0x1f 0x01 0x00 0x00 0x01 0x01 0x01 0x20 0x01 0x00 0x00 0x01 0x01 0x01 0x21 0x01 0x00 0x00 0x01 0x01 0x01 0x22 0x01 0x00 0x00 0x01 0x01 0x01 0x23 0x01 0x00 0x00 0x01 0x01 0x00 0x24 0x01 0x01 0x00 0x00 0x00 0x00 0x25 0x01 0x01 0x00 0x00 0x00 0x00 0x26 0x01 0x01 0x00 0x00 0x00 0x00 0x27 0x01 0x01 0x00 0x00 0x00 0x00 0x28 0x01 0x00 0x00 0x01 0x01 0x00 0x29 0x01 0x00 0x00 0x01 0x01 0x00 0x2a 0x00 0x00 0x00 0x01 0x00 0x00 0x2b 0x01 0x01 0x00 0x00 0x00 0x00 0x2c 0x01 0x00 0x00 0x01 0x00 0x00 0x2d 0x01 0x01 0x01 0x00 0x00 0x00 0x2e 0x01 0x00 0x00 0x01 0x01 0x00 0x2f 0x01 0x00 0x00 0x01 0x01 0x00 0x30 0x01 0x00 0x00 0x01 0x01 0x01 0x31 0x01 0x00 0x00 0x01 0x01 0x01 0x32 0x01 0x00 0x00 0x01 0x01 0x01 0x33 0x01 0x00 0x00 0x01 0x01 0x01 0x34 0x01 0x01 0x00 0x01 0x00 0x00 0x35 0x01 0x01 0x00 0x01 0x00 0x00 0x36 0x01 0x01 0x00 0x01 0x00 0x00 0x37 0x01 0x01 0x00 0x01 0x00 0x00 0x38 0x01 0x01 0x00 0x01 0x00 0x00 0x39 0x01 0x01 0x00 0x01 0x00 0x00 0x3a 0x00 0x00 0x00 0x01 0x00 0x00 0x3b 0x01 0x00 0x00 0x01 0x00 0x00 0x3c 0x01 0x00 0x00 0x01 0x00 0x00 0x3d 0x01 0x00 0x00 0x01 0x00 0x00 0x3e 0x01 0x00 0x00 0x01 0x00 0x00 0x3f 0x01 0x00 0x00 0x01 0x00 0x00 0x40 0x01 0x00 0x00 0x01 0x00 0x00 0x41 0x01 0x00 0x00 0x01 0x00 0x00 0x42 0x01 0x00 0x00 0x01 0x00 0x00 0x43 0x01 0x00 0x00 0x01 0x00 0x00 0x44 0x01 0x00 0x00 0x01 0x00 0x00 0x45 0x01 0x01 0x00 0x01 0x00 0x00 0x46 0x01 0x01 0x00 0x01 0x00 0x00 0x47 0x01 0x01 0x00 0x01 0x00 0x00 0x48 0x01 0x01 0x00 0x01 0x00 0x00 0x49 0x01 0x01 0x00 0x01 0x00 0x00 0x4a 0x01 0x01 0x00 0x01 0x00 0x00 0x4b 0x01 0x01 0x00 0x01 0x00 0x00 0x4c 0x01 0x01 0x00 0x01 0x00 0x00 0x4d 0x01 0x01 0x00 0x01 0x00 0x00 0x4e 0x01 0x01 0x00 0x01 0x00 0x00 0x4f 0x01 0x00 0x00 0x01 0x00 0x00 0x50 0x01 0x00 0x00 0x01 0x00 0x00 0x51 0x01 0x00 0x00 0x01 0x01 0x01 0x52 0x01 0x00 0x00 0x01 0x01 0x01 0x53 0x01 0x00 0x00 0x01 0x01 0x01 0x54 0x01 0x00 0x00 0x01 0x01 0x01 0x55 0x01 0x01 0x00 0x01 0x00 0x00 0x56 0x01 0x01 0x00 0x01 0x00 0x00 0x57 0x00 0x01 0x00 0x00 0x00 0x00 0x58 0x00 0x01 0x00 0x01 0x00 0x00 0x59 0x01 0x00 0x00 0x01 0x00 0x00 0x5a 0x02 0x01 0x00 0x00 0x00 0x00 0x5b 0x00 0x01 0x00 0x01 0x00 0x00 0x5c 0x01 0x01 0x00 0x00 0x00 0x00 0x5d 0x01 0x00 0x00 0x01 0x01 0x00 0x5e 0x01 0x00 0x00 0x01 0x01 0x00 0x5f 0x01 0x00 0x00 0x01 0x01 0x00 0x60 0x01 0x01 0x00 0x00 0x00 0x00 0x61 0x00 0x01 0x00 0x00 0x00 0x00 0x62 0x00 0x01 0x00 0x00 0x00 0x00 0x63 0x01 0x01 0x00 0x00 0x00 0x00 0x64 0x01 0x01 0x00 0x00 0x00 0x00 0x65 0x00 0x01 0x00 0x00 0x00 0x00 0x66 0x00 0x01 0x00 0x00 0x00 0x00 0x67 0x01 0x00 0x00 0x01 0x01 0x01 0x68 0x01 0x00 0x00 0x01 0x01 0x01 0x69 0x01 0x00 0x00 0x01 0x01 0x01 0x6a 0x01 0x00 0x00 0x01 0x01 0x01 0x6b 0x02 0x01 0x00 0x00 0x00 0x00 0x6c 0x01 0x01 0x00 0x00 0x00 0x00 0x6d 0x02 0x00 0x00 0x01 0x01 0x00 0x6e 0x00 0x00 0x00 0x01 0x00 0x00 0x6f 0x00 0x00 0x00 0x01 0x00 0x00 0x70 0x00 0x00 0x00 0x01 0x00 0x00 0x71 0x00 0x00 0x00 0x01 0x00 0x00 0x72 0x00 0x00 0x00 0x01 0x00 0x00 0x73 0x00 0x00 0x00 0x01 0x00 0x00 0x74 0x00 0x00 0x00 0x01 0x00 0x00 0x75 0x00 0x00 0x00 0x01 0x00 0x00 0x76 0x00 0x00 0x00 0x01 0x00 0x00 0x77 0x00 0x00 0x00 0x01 0x00 0x00 0x78 0x00 0x00 0x00 0x01 0x00 0x00 0x79 0x00 0x00 0x00 0x01 0x00 0x00 0x7a 0x01 0x00 0x00 0x01 0x01 0x01 0x7b 0x01 0x00 0x00 0x01 0x01 0x01 0x7c 0x01 0x01 0x00 0x00 0x00 0x01 0x7d 0x01 0x00 0x00 0x01 0x01 0x01 0x7e 0x01 0x00 0x00 0x01 0x01 0x01 0x7f 0x01 0x00 0x00 0x01 0x01 0x01 0x80 0x01 0x00 0x00 0x01 0x01 0x01 0x81 0x01 0x00 0x00 0x01 0x01 0x01 0x82 0x01 0x00 0x00 0x01 0x01 0x01 0x83 0x01 0x00 0x00 0x01 0x00 0x01 0x84 0x01 0x00 0x00 0x01 0x01 0x01 0x85 0x01 0x01 0x01 0x00 0x00 0x01 0x86 0x01 0x00 0x00 0x01 0x00 0x01 0x87 0x01 0x01 0x00 0x00 0x00 0x00 0x88 0x01 0x01 0x00 0x00 0x00 0x00 0x89 0x01 0x01 0x00 0x00 0x00 0x00 0x8a 0x01 0x01 0x00 0x00 0x00 0x00 0x8b 0x01 0x01 0x00 0x00 0x00 0x00 0x8c 0x01 0x00 0x00 0x01 0x00 0x00 0x8d 0x01 0x00 0x00 0x01 0x00 0x00 0x8e 0x01 0x00 0x00 0x01 0x00 0x00 0x8f 0x01 0x00 0x00 0x01 0x00 0x00 0x90 0x01 0x00 0x00 0x01 0x00 0x00 0x91 0x01 0x01 0x01 0x00 0x00 0x00 0x92 0x01 0x00 0x00 0x01 0x00 0x00 0x93 0x01 0x01 0x00 0x00 0x00 0x00 0x94 0x01 0x01 0x00 0x00 0x00 0x00 0x95 0x01 0x01 0x00 0x00 0x00 0x00 0x96 0x00 0x01 0x00 0x00 0x00 0x00 0x97 0x00 0x01 0x00 0x00 0x00 0x00 0x98 0x05 0x00 0x00 0x01 0x01 0x00 0x99 0x00 0x01 0x00 0x00 0x00 0x00 0x9a 0x00 0x01 0x01 0x00 0x00 0x00 0x9b 0x07 0x01 0x00 0x00 0x00 0x00 0x9c 0x07 0x00 0x00 0x01 0x00 0x00 0x9d 0x07 0x00 0x00 0x01 0x00 0x00 0x9e 0x07 0x00 0x00 0x01 0x00 0x00 0x9f 0x00 0x01 0x00 0x00 0x00 0x00 0xa0 0x00 0x01 0x00 0x00 0x00 0x00 0xa1 0x01 0x00 0x00 0x01 0x01 0x01 0xa2 0x01 0x00 0x00 0x01 0x01 0x01 0xa3 0x00 0x00 0x00 0x01 0x00 0x00 0xa4 0x00 0x00 0x00 0x01 0x00 0x00 0xa5 0x00 0x00 0x00 0x01 0x00 0x00 0xa6 0x00 0x00 0x00 0x01 0x00 0x00 0xa7 0x00 0x00 0x00 0x01 0x00 0x00 0xa8 0x00 0x00 0x00 0x01 0x00 0x00 0xa9 0x00 0x01 0x00 0x00 0x00 0x00 0xaa 0x00 0x01 0x00 0x00 0x00 0x00 0xab 0x00 0x00 0x00 0x01 0x00 0x00 0xac 0x00 0x01 0x01 0x00 0x00 0x00 0xad 0x00 0x01 0x01 0x00 0x00 0x00 0xae 0x00 0x01 0x00 0x00 0x00 0x00 0xaf 0x00 0x01 0x00 0x00 0x00 0x00 0xb0 0x00 0x01 0x00 0x00 0x00 0x00 0xb1 0x00 0x01 0x00 0x00 0x00 0x00 0xb2 0x00 0x01 0x00 0x00 0x00 0x00 0xb3 0x00 0x00 0x00 0x01 0x00 0x00>;
		};
	};

	fragment@68 {
		target = <0xffffffff>;

		__overlay__ {
			interrupt-parent = <0xffffffff>;
			interrupts = <0x00 0x02 0x00 0x00>;
			status = "okay";
		};
	};

	fragment@69 {
		target = <0xffffffff>;

		__overlay__ {
			interrupt-parent = <0xffffffff>;
			interrupts = <0x01 0x02 0x01 0x00>;
			status = "okay";
		};
	};

	fragment@70 {
		target = <0xffffffff>;

		__overlay__ {
			interrupt-parent = <0xffffffff>;
			interrupts = <0x07 0x08 0x07 0x00>;
			status = "okay";
		};
	};

	fragment@71 {
		target = <0xffffffff>;

		__overlay__ {
			interrupt-parent = <0xffffffff>;
			interrupts = <0x09 0x08 0x09 0x00>;
			deb-gpios = <0xffffffff 0x09 0x00>;
			debounce = <0x3e800>;
			status = "okay";
		};
	};

	fragment@72 {
		target = <0xffffffff>;

		__overlay__ {
			interrupt-parent = <0xffffffff>;
			interrupts = <0x0a 0x04 0x0a 0x00>;
			status = "okay";
		};
	};

	fragment@73 {
		target = <0xffffffff>;

		__overlay__ {
			interrupt-parent = <0xffffffff>;
			interrupts = <0x0b 0x02 0x0b 0x00>;
			status = "okay";
		};
	};

	fragment@74 {
		target = <0xffffffff>;

		__overlay__ {
			interrupt-parent = <0xffffffff>;
			interrupts = <0x17 0x08 0x17 0x00>;
			status = "okay";
		};
	};

	fragment@75 {
		target = <0xffffffff>;

		__overlay__ {
			interrupt-parent = <0xffffffff>;
			interrupts = <0x2c 0x01 0x2c 0x01>;
			status = "okay";
		};
	};

	fragment@76 {
		target = <0xffffffff>;

		__overlay__ {
			interrupt-parent = <0xffffffff>;
			interrupts = <0x90 0x04 0x90 0x01>;
			status = "okay";
		};
	};

	fragment@77 {
		target = <0xffffffff>;

		__overlay__ {
			interrupt-parent = <0xffffffff>;
			interrupts = <0x93 0x08 0x29 0x01>;
			deb-gpios = <0xffffffff 0x29 0x00>;
			debounce = <0x7d00>;
			status = "okay";
		};
	};

	fragment@78 {
		target = <0xffffffff>;

		__overlay__ {
			compatible = "mediatek,md1_sim1_hot_plug_eint-eint";
			interrupts = <0x00 0x08>;
			debounce = <0x00 0x2710>;
			dedicated = <0x00 0x00>;
			src_pin = <0x00 0x01>;
			sockettype = <0x00 0x00>;
			status = "okay";
		};
	};

	fragment@79 {
		target = <0xffffffff>;

		__overlay__ {
			compatible = "mediatek,md1_sim2_hot_plug_eint-eint";
			interrupts = <0x01 0x08>;
			debounce = <0x01 0x2710>;
			dedicated = <0x01 0x00>;
			src_pin = <0x01 0x02>;
			sockettype = <0x01 0x00>;
			status = "okay";
		};
	};

	fragment@80 {
		target = <0xffffffff>;

		__overlay__ {
			regulator-name = "vcama";
			regulator-default-on = <0x01>;
			status = "okay";
		};
	};

	fragment@81 {
		target = <0xffffffff>;

		__overlay__ {
			regulator-name = "vsim1";
			regulator-default-on = <0x01>;
			status = "okay";
		};
	};

	fragment@82 {
		target = <0xffffffff>;

		__overlay__ {
			regulator-name = "vsim2";
			regulator-default-on = <0x01>;
			status = "okay";
		};
	};

	fragment@83 {
		target = <0xffffffff>;

		__overlay__ {
			regulator-name = "vcamd";
			regulator-default-on = <0x01>;
			status = "okay";
		};
	};

	fragment@84 {
		target = <0xffffffff>;

		__overlay__ {
			regulator-name = "vcamio";
			regulator-default-on = <0x01>;
			status = "okay";
		};
	};

	fragment@85 {
		target = <0xffffffff>;

		__overlay__ {
			regulator-name = "vldo28";
			regulator-default-on = <0x01>;
			status = "okay";
		};
	};

	fragment@86 {
		target = <0xffffffff>;

		__overlay__ {
			status = "okay";
		};
	};

	fragment@87 {
		target = <0xffffffff>;

		__overlay__ {
			vtouch-supply = <0xffffffff>;
			status = "okay";
		};
	};

	fragment@88 {
		target = <0xffffffff>;

		__overlay__ {
			mediatek,kpd-key-debounce = <0x400>;
			mediatek,kpd-sw-pwrkey = <0x74>;
			mediatek,kpd-hw-pwrkey = <0x08>;
			mediatek,kpd-sw-rstkey = <0x73>;
			mediatek,kpd-hw-rstkey = <0x11>;
			mediatek,kpd-use-extend-type = <0x00>;
			mediatek,kpd-hw-map-num = <0x48>;
			mediatek,kpd-hw-init-map = <0x00 0x72 0x00 0x00 0x00 0x00 0x00 0x00 0x00 0x00 0x00 0x00 0x00 0x00 0x00 0x00 0x00 0x00 0x00 0x00 0x00 0x00 0x00 0x00 0x00 0x00 0x00 0x00 0x00 0x00 0x00 0x00 0x00 0x00 0x00 0x00 0x00 0x00 0x00 0x00 0x00 0x00 0x00 0x00 0x00 0x00 0x00 0x00 0x00 0x00 0x00 0x00 0x00 0x00 0x00 0x00 0x00 0x00 0x00 0x00 0x00 0x00 0x00 0x00 0x00 0x00 0x00 0x00 0x00 0x00 0x00 0x00>;
			mediatek,kpd-pwrkey-eint-gpio = <0x00>;
			mediatek,kpd-pwkey-gpio-din = <0x00>;
			mediatek,kpd-hw-dl-key0 = <0x11>;
			mediatek,kpd-hw-dl-key2 = <0x08>;
			mediatek,kpd-hw-recovery-key = <0x11>;
			mediatek,kpd-hw-factory-key = <0x01>;
			status = "okay";
		};
	};

	fragment@89 {
		target = <0xffffffff>;

		__overlay__ {
			clock-frequency = <0x61a80>;
		};
	};

	__symbols__ {
		ant_pins_all_default = "/fragment@2/__overlay__/ant_pins_all_default";
		ant_pins_id0_default = "/fragment@2/__overlay__/ant_pins_id0_default";
		ant_pins_id0_bias_up = "/fragment@2/__overlay__/ant_pins_id0_bias_up";
		ant_pins_id0_bias_down = "/fragment@2/__overlay__/ant_pins_id0_bias_down";
		ant_pins_id1_default = "/fragment@2/__overlay__/ant_pins_id1_default";
		ant_pins_id1_bias_up = "/fragment@2/__overlay__/ant_pins_id1_bias_up";
		ant_pins_id1_bias_down = "/fragment@2/__overlay__/ant_pins_id1_bias_down";
		ant_pins_id2_default = "/fragment@2/__overlay__/ant_pins_id2_default";
		ant_pins_id2_bias_up = "/fragment@2/__overlay__/ant_pins_id2_bias_up";
		ant_pins_id2_bias_down = "/fragment@2/__overlay__/ant_pins_id2_bias_down";
		ant_cable_det_default = "/fragment@4/__overlay__/ant_cable_det_default";
		ant_cable_det_idle = "/fragment@4/__overlay__/ant_cable_det_idle";
		led0 = "/fragment@5/__overlay__/led@0";
		led1 = "/fragment@5/__overlay__/led@1";
		led2 = "/fragment@5/__overlay__/led@2";
		led3 = "/fragment@5/__overlay__/led@3";
		led4 = "/fragment@5/__overlay__/led@4";
		led5 = "/fragment@5/__overlay__/led@5";
		led6 = "/fragment@5/__overlay__/led@6";
		vibrator0 = "/fragment@5/__overlay__/vibrator@0";
		ctp_pins_eint_as_int = "/fragment@7/__overlay__/eint@0";
		ctp_pins_eint_output0 = "/fragment@7/__overlay__/eintoutput0";
		ctp_pins_eint_output1 = "/fragment@7/__overlay__/eintoutput1";
		ctp_pins_rst_output0 = "/fragment@7/__overlay__/rstoutput0";
		ctp_pins_rst_output1 = "/fragment@7/__overlay__/rstoutput1";
		fts = "/fragment@8/__overlay__/touchscreen@38";
		dsi_dura_auo_otm1901a_5p2_1080p_video_default = "/fragment@19/__overlay__/lcd_kit_dura_auo_otm1901a_5p2_1080p_video_default";
		dsi_dura_boe_gc9702p_5p45 = "/fragment@20/__overlay__/lcd_kit_dura_boe_gc9702p_5p45";
		dsi_dura_boe_ili9881c_5p45 = "/fragment@21/__overlay__/lcd_kit_dura_boe_ili9881c_5p45";
		dsi_dura_mdt_ili9881c_5p45 = "/fragment@22/__overlay__/lcd_kit_dura_mdt_ili9881c_5p45";
		dsi_dura_xl_hx8394f_5p45 = "/fragment@23/__overlay__/lcd_kit_dura_xl_hx8394f_5p45";
		dsi_dura_xl_ili9881p_5p45 = "/fragment@24/__overlay__/lcd_kit_dura_xl_ili9881p_5p45";
		mtkfb_pins_lcm_reset0 = "/fragment@26/__overlay__/lcm_rst_out0_gpio";
		mtkfb_pins_lcm_reset1 = "/fragment@26/__overlay__/lcm_rst_out1_gpio";
		consys_pins_default = "/fragment@29/__overlay__/consys_default";
		gpslna_pins_init = "/fragment@29/__overlay__/gpslna@0";
		gpslna_pins_oh = "/fragment@29/__overlay__/gpslna@1";
		gpslna_pins_ol = "/fragment@29/__overlay__/gpslna@2";
		aud_clk_mosi_off = "/fragment@36/__overlay__/aud_clk_mosi_off";
		aud_clk_mosi_on = "/fragment@36/__overlay__/aud_clk_mosi_on";
		aud_clk_miso_off = "/fragment@36/__overlay__/aud_clk_miso_off";
		aud_clk_miso_on = "/fragment@36/__overlay__/aud_clk_miso_on";
		aud_dat_mosi_off = "/fragment@36/__overlay__/aud_dat_mosi_off";
		aud_dat_mosi_on = "/fragment@36/__overlay__/aud_dat_mosi_on";
		aud_dat_miso_off = "/fragment@36/__overlay__/aud_dat_miso_off";
		aud_dat_miso_on = "/fragment@36/__overlay__/aud_dat_miso_on";
		accdet_pins_default = "/fragment@40/__overlay__/accdetdefault";
		accdet_pins_eint_as_int = "/fragment@40/__overlay__/accdeteint@0";
		camera_main_mtk = "/fragment@44/__overlay__/camera_main@10";
		camera_main_eeprom_mtk = "/fragment@44/__overlay__/camera_main_eeprom@50";
		camera_main_af_mtk = "/fragment@44/__overlay__/camera_main_af@0c";
		camera_sub_mtk = "/fragment@45/__overlay__/camera_sub@36";
		camera_sub_eeprom_mtk = "/fragment@45/__overlay__/camera_sub_eeprom@52";
		camera_main_two_mtk = "/fragment@45/__overlay__/camera_main_two@17";
		camera_main_two_eeprom_mtk = "/fragment@45/__overlay__/camera_main_two_eeprom@50";
		camera_sub_two_mtk = "/fragment@45/__overlay__/camera_sub_two@22";
		camera_sub_two_eeprom_mtk = "/fragment@45/__overlay__/camera_sub_two_eeprom@55";
		camera_pins_cam0_mclk_on = "/fragment@47/__overlay__/camera_pins_cam0_mclk_on";
		camera_pins_cam0_mclk_off = "/fragment@47/__overlay__/camera_pins_cam0_mclk_off";
		camera_pins_cam1_mclk_on = "/fragment@47/__overlay__/camera_pins_cam1_mclk_on";
		camera_pins_cam1_mclk_off = "/fragment@47/__overlay__/camera_pins_cam1_mclk_off";
		camera_pins_cam0_rst0 = "/fragment@47/__overlay__/cam0@0";
		camera_pins_cam0_rst1 = "/fragment@47/__overlay__/cam0@1";
		camera_pins_cam0_pnd0 = "/fragment@47/__overlay__/cam0@2";
		camera_pins_cam0_pnd1 = "/fragment@47/__overlay__/cam0@3";
		camera_pins_cam1_rst0 = "/fragment@47/__overlay__/cam1@0";
		camera_pins_cam1_rst1 = "/fragment@47/__overlay__/cam1@1";
		camera_pins_cam1_pnd0 = "/fragment@47/__overlay__/cam1@2";
		camera_pins_cam1_pnd1 = "/fragment@47/__overlay__/cam1@3";
		camera_pins_default = "/fragment@47/__overlay__/camdefault";
		flashlights_aw36514_pins_default = "/fragment@49/__overlay__/default";
		flashlights_aw36514_pins_hwen_high = "/fragment@49/__overlay__/hwen_high";
		flashlights_aw36514_pins_hwen_low = "/fragment@49/__overlay__/hwen_low";
		flashlights_aw36514_pins_strobe_high = "/fragment@49/__overlay__/strobe_high";
		flashlights_aw36514_pins_strobe_low = "/fragment@49/__overlay__/strobe_low";
		cap_touch_mtk = "/fragment@56/__overlay__/cap_touch@5d";
		speaker_amp_mtk = "/fragment@59/__overlay__/speaker_amp@34";
		slave_charger_mtk = "/fragment@59/__overlay__/slave_charger@4b";
		nfc_mtk = "/fragment@59/__overlay__/nfc@08";
		ext_buck_lp4_mtk = "/fragment@59/__overlay__/ext_buck_lp4@57";
		ext_buck_lp4x_mtk = "/fragment@59/__overlay__/ext_buck_lp4x@50";
		subpmic_pmu_mtk = "/fragment@61/__overlay__/subpmic_pmu@34";
		usb_type_c_mtk = "/fragment@61/__overlay__/usb_type_c@4e";
		ext_buck_vgpu_mtk = "/fragment@62/__overlay__/ext_buck_vgpu@55";
	};

	__fixups__ {
		dev_detect = "/fragment@0:target:0";
		antenna_boardid_detect = "/fragment@1:target:0\0/fragment@53:target:0";
		pio = "/fragment@2:target:0\0/fragment@4:target:0\0/fragment@7:target:0\0/fragment@8/__overlay__:interrupt-parent:0\0/fragment@15/__overlay__:interrupt-parent:0\0/fragment@26:target:0\0/fragment@29:target:0\0/fragment@36:target:0\0/fragment@37/__overlay__:simple-pa-gpio-enale:0\0/fragment@40:target:0\0/fragment@42/__overlay__:fm,fm_elna_pins:0\0/fragment@47:target:0\0/fragment@49:target:0\0/fragment@66/__overlay__:GPIO_SIM2_SIO:0\0/fragment@66/__overlay__:GPIO_SIM2_SRST:0\0/fragment@66/__overlay__:GPIO_SIM2_SCLK:0\0/fragment@66/__overlay__:GPIO_SIM1_SCLK:0\0/fragment@66/__overlay__:GPIO_SIM1_SRST:0\0/fragment@66/__overlay__:GPIO_SIM1_SIO:0\0/fragment@66/__overlay__:GPIO_SIM2_HOT_PLUG:0\0/fragment@66/__overlay__:GPIO_SIM1_HOT_PLUG:0\0/fragment@66/__overlay__:GPIO_FDD_BAND_SUPPORT_DETECT_4TH_PIN:0\0/fragment@66/__overlay__:GPIO_FDD_BAND_SUPPORT_DETECT_3RD_PIN:0\0/fragment@66/__overlay__:GPIO_FDD_BAND_SUPPORT_DETECT_2ND_PIN:0\0/fragment@66/__overlay__:GPIO_FDD_BAND_SUPPORT_DETECT_1ST_PIN:0\0/fragment@66/__overlay__:GPIO_FDD_BAND_SUPPORT_DETECT_5TH_PIN:0\0/fragment@68/__overlay__:interrupt-parent:0\0/fragment@69/__overlay__:interrupt-parent:0\0/fragment@70/__overlay__:interrupt-parent:0\0/fragment@71/__overlay__:interrupt-parent:0\0/fragment@71/__overlay__:deb-gpios:0\0/fragment@72/__overlay__:interrupt-parent:0\0/fragment@73/__overlay__:interrupt-parent:0\0/fragment@74/__overlay__:interrupt-parent:0\0/fragment@75/__overlay__:interrupt-parent:0\0/fragment@76/__overlay__:interrupt-parent:0\0/fragment@77/__overlay__:interrupt-parent:0\0/fragment@77/__overlay__:deb-gpios:0";
		antenna_cable_detect = "/fragment@3:target:0";
		odm = "/fragment@5:target:0";
		mt6370_pmu = "/fragment@6:target:0\0/fragment@14:target:0";
		ts_kit = "/fragment@8:target:0";
		i2c5 = "/fragment@9:target:0\0/fragment@28:target:0\0/fragment@61:target:0\0/fragment@89:target:0";
		charger = "/fragment@10:target:0";
		huawei_charger = "/fragment@11:target:0";
		huawei_battery = "/fragment@12:target:0";
		lk_charger = "/fragment@13:target:0";
		otg_iddig = "/fragment@15:target:0\0/fragment@77:target:0";
		bat_gm30 = "/fragment@16:target:0";
		usb_phy_tuning = "/fragment@17:target:0";
		huawei_wifi_info = "/fragment@18:target:0";
		huawei_lcd_config = "/fragment@19:target:0\0/fragment@20:target:0\0/fragment@21:target:0\0/fragment@22:target:0\0/fragment@23:target:0\0/fragment@24:target:0";
		huawei_lcd_panel = "/fragment@25:target:0";
		mtkfb = "/fragment@27:target:0";
		consys = "/fragment@30:target:0";
		huawei_scp_info = "/fragment@31:target:0";
		hisi_shell = "/fragment@32:target:0";
		shell_front = "/fragment@33:target:0";
		shell_back = "/fragment@34:target:0";
		audgpio = "/fragment@35:target:0";
		mt_soc_codec_name = "/fragment@37:target:0";
		audio_hw_config = "/fragment@38:target:0";
		accdet = "/fragment@39:target:0\0/fragment@71:target:0";
		smartpakit = "/fragment@41:target:0";
		huawei_fm_info = "/fragment@42:target:0";
		mt_pmic_vldo28_ldo_reg = "/fragment@43:target:0\0/fragment@48/__overlay__:cam0_vcamaf-supply:0\0/fragment@85:target:0\0/fragment@87/__overlay__:vtouch-supply:0";
		i2c2 = "/fragment@44:target:0\0/fragment@58:target:0";
		i2c4 = "/fragment@45:target:0\0/fragment@60:target:0";
		i2c6 = "/fragment@46:target:0\0/fragment@62:target:0";
		kd_camera_hw1 = "/fragment@48:target:0\0/fragment@86:target:0";
		mt_pmic_vcama_ldo_reg = "/fragment@48/__overlay__:cam0_vcama-supply:0\0/fragment@48/__overlay__:cam1_vcama-supply:0\0/fragment@80:target:0";
		mt_pmic_vcamd_ldo_reg = "/fragment@48/__overlay__:cam0_vcamd-supply:0\0/fragment@48/__overlay__:cam1_vcamd-supply:0\0/fragment@83:target:0";
		mt_pmic_vcamio_ldo_reg = "/fragment@48/__overlay__:cam0_vcamio-supply:0\0/fragment@48/__overlay__:cam1_vcamio-supply:0\0/fragment@84:target:0";
		flashlights_aw36514 = "/fragment@50:target:0";
		product_name_camera = "/fragment@51:target:0";
		rootparam = "/fragment@52:target:0";
		auxadc = "/fragment@54:target:0";
		pmic_clock_buffer_ctrl = "/fragment@55:target:0";
		i2c0 = "/fragment@56:target:0";
		i2c1 = "/fragment@57:target:0";
		i2c3 = "/fragment@59:target:0";
		i2c7 = "/fragment@63:target:0";
		i2c8 = "/fragment@64:target:0";
		i2c9 = "/fragment@65:target:0";
		gpio_usage_mapping = "/fragment@66:target:0";
		gpio = "/fragment@67:target:0";
		touch = "/fragment@68:target:0\0/fragment@87:target:0";
		msdc1_ins = "/fragment@69:target:0";
		smart_pa = "/fragment@70:target:0";
		irq_nfc = "/fragment@72:target:0";
		subpmic_pmu_eint = "/fragment@73:target:0";
		rt9465_slave_chr = "/fragment@74:target:0";
		dsi_te = "/fragment@75:target:0";
		main_pmic = "/fragment@76:target:0";
		md1_sim1_hot_plug_eint = "/fragment@78:target:0";
		md1_sim2_hot_plug_eint = "/fragment@79:target:0";
		mt_pmic_vsim1_ldo_reg = "/fragment@81:target:0";
		mt_pmic_vsim2_ldo_reg = "/fragment@82:target:0";
		keypad = "/fragment@88:target:0";
	};

	__local_fixups__ {

		fragment@1 {

			__overlay__ {
				pinctrl-0 = <0x00>;
				pinctrl-1 = <0x00>;
				pinctrl-2 = <0x00>;
				pinctrl-3 = <0x00>;
				pinctrl-4 = <0x00>;
				pinctrl-5 = <0x00>;
				pinctrl-6 = <0x00>;
				pinctrl-7 = <0x00>;
				pinctrl-8 = <0x00>;
				pinctrl-9 = <0x00>;
			};
		};

		fragment@3 {

			__overlay__ {
				pinctrl-0 = <0x00>;
				pinctrl-1 = <0x00>;
			};
		};

		fragment@8 {

			__overlay__ {

				touchscreen@38 {
					pinctrl-0 = <0x00>;
					pinctrl-1 = <0x00>;
					pinctrl-2 = <0x00>;
					pinctrl-3 = <0x00>;
					pinctrl-4 = <0x00>;
				};

				mstar_ts@26 {
					pinctrl-0 = <0x00>;
					pinctrl-1 = <0x00>;
					pinctrl-2 = <0x00>;
					pinctrl-3 = <0x00>;
					pinctrl-4 = <0x00>;
				};
			};
		};

		fragment@27 {

			__overlay__ {
				pinctrl-0 = <0x00>;
				pinctrl-1 = <0x00>;
			};
		};

		fragment@30 {

			__overlay__ {
				pinctrl-0 = <0x00>;
				pinctrl-1 = <0x00>;
				pinctrl-2 = <0x00>;
				pinctrl-3 = <0x00>;
			};
		};

		fragment@35 {

			__overlay__ {
				pinctrl-0 = <0x00>;
				pinctrl-1 = <0x00>;
				pinctrl-2 = <0x00>;
				pinctrl-3 = <0x00>;
				pinctrl-4 = <0x00>;
				pinctrl-5 = <0x00>;
				pinctrl-6 = <0x00>;
				pinctrl-7 = <0x00>;
			};
		};

		fragment@39 {

			__overlay__ {
				pinctrl-0 = <0x00>;
				pinctrl-1 = <0x00>;
			};
		};

		fragment@48 {

			__overlay__ {
				pinctrl-0 = <0x00>;
				pinctrl-1 = <0x00>;
				pinctrl-2 = <0x00>;
				pinctrl-3 = <0x00>;
				pinctrl-4 = <0x00>;
				pinctrl-5 = <0x00>;
				pinctrl-6 = <0x00>;
				pinctrl-7 = <0x00>;
				pinctrl-8 = <0x00>;
				pinctrl-9 = <0x00>;
				pinctrl-10 = <0x00>;
				pinctrl-11 = <0x00>;
				pinctrl-12 = <0x00>;
			};
		};

		fragment@50 {

			__overlay__ {
				pinctrl-0 = <0x00>;
				pinctrl-1 = <0x00>;
				pinctrl-2 = <0x00>;
				pinctrl-3 = <0x00>;
				pinctrl-4 = <0x00>;
			};
		};
	};
};
