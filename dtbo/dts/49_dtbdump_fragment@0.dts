/dts-v1/;

/ {

	fragment@0 {
		target = <0xffffffff>;

		__overlay__ {
			compatible = "huawei,dev_detect";
			touch_panel = <0x00>;
			compass = <0x00>;
			g_sensor = <0x00>;
			camera_main = <0x00>;
			camera_slave = <0x00>;
			keypad = <0x00>;
			aps = <0x00>;
			gyroscope = <0x00>;
			nfc = <0x00>;
			dc_dc = <0x00>;
			speaker = <0x00>;
			ofn = <0x00>;
			tps = <0x00>;
			l_sensor = <0x00>;
			charge = <0x00>;
			battery = <0x00>;
			nct = <0x00>;
			mhl = <0x00>;
			audience = <0x00>;
			irda = <0x00>;
			hand_sensor = <0x00>;
			usb_switch = <0x00>;
			pmu_dcdc = <0x00>;
			camera_pmu = <0x00>;
			fm = <0x00>;
			wifi = <0x00>;
			bt = <0x00>;
			gps = <0x00>;
			gpu = <0x00>;
			cpu_chip = <0x00>;
			antenna_ctl = <0x00>;
			airpress = <0x00>;
			handpress = <0x00>;
			vibrator_lra = <0x00>;
			laser = <0x00>;
			camera_pmic = <0x00>;
			typec = <0x00>;
			anc_max14744 = <0x00>;
			charge_loadswitch = <0x00>;
			max77813 = <0x00>;
			coul = <0x00>;
			dtv = <0x00>;
			ap_color = <0x00>;
			status = "ok";
		};
	};

	fragment@1 {
		target = <0xffffffff>;

		__overlay__ {
			pinctrl-names = "default\0state_id0_default\0state_id0_bias_up\0state_id0_bias_down\0state_id1_default\0state_id1_bias_up\0state_id1_bias_down\0state_id2_default\0state_id2_bias_up\0state_id2_bias_down";
			pinctrl-0 = <0x01>;
			pinctrl-1 = <0x02>;
			pinctrl-2 = <0x03>;
			pinctrl-3 = <0x04>;
			pinctrl-4 = <0x05>;
			pinctrl-5 = <0x06>;
			pinctrl-6 = <0x07>;
			pinctrl-7 = <0x08>;
			pinctrl-8 = <0x09>;
			pinctrl-9 = <0x0a>;
			status = "ok";
		};
	};

	fragment@2 {
		target = <0xffffffff>;

		__overlay__ {

			ant_pins_all_default {
				phandle = <0x01>;
			};

			ant_pins_id0_default {
				phandle = <0x02>;

				pins_cmd_dat {
					pinmux = <0xb000>;
					slew-rate = <0x00>;
					bias-disable;
				};
			};

			ant_pins_id0_bias_up {
				phandle = <0x03>;

				pins_cmd_dat {
					pinmux = <0xb000>;
					slew-rate = <0x00>;
					bias-pull-up;
				};
			};

			ant_pins_id0_bias_down {
				phandle = <0x04>;

				pins_cmd_dat {
					pinmux = <0xb000>;
					slew-rate = <0x00>;
					bias-pull-down;
				};
			};

			ant_pins_id1_default {
				phandle = <0x05>;

				pins_cmd_dat {
					pinmux = <0xaf00>;
					slew-rate = <0x00>;
					bias-disable;
				};
			};

			ant_pins_id1_bias_up {
				phandle = <0x06>;

				pins_cmd_dat {
					pinmux = <0xaf00>;
					slew-rate = <0x00>;
					bias-pull-up;
				};
			};

			ant_pins_id1_bias_down {
				phandle = <0x07>;

				pins_cmd_dat {
					pinmux = <0xaf00>;
					slew-rate = <0x00>;
					bias-pull-down;
				};
			};

			ant_pins_id2_default {
				phandle = <0x08>;

				pins_cmd_dat {
					pinmux = <0xac00>;
					slew-rate = <0x00>;
					bias-disable;
				};
			};

			ant_pins_id2_bias_up {
				phandle = <0x09>;

				pins_cmd_dat {
					pinmux = <0xac00>;
					slew-rate = <0x00>;
					bias-pull-up;
				};
			};

			ant_pins_id2_bias_down {
				phandle = <0x0a>;

				pins_cmd_dat {
					pinmux = <0xac00>;
					slew-rate = <0x00>;
					bias-pull-down;
				};
			};
		};
	};

	fragment@3 {
		target = <0xffffffff>;

		__overlay__ {
			pinctrl-names = "default\0idle";
			pinctrl-0 = <0x0b>;
			pinctrl-1 = <0x0c>;
			gpio_count = <0x01>;
			debounce-interval = <0x0f>;
		};
	};

	fragment@4 {
		target = <0xffffffff>;

		__overlay__ {

			ant_cable_det_default {
				phandle = <0x0b>;

				pins_cmd_dat {
					pinmux = <0x200>;
					slew-rate = <0x00>;
					bias-disable;
				};
			};

			ant_cable_det_idle {
				phandle = <0x0c>;

				pins_cmd_dat {
					pinmux = <0x200>;
					slew-rate = <0x00>;
					bias-disable;
				};
			};
		};
	};

	fragment@5 {
		target = <0xffffffff>;

		__overlay__ {

			led@0 {
				compatible = "mediatek,red";
				max_brightness = <0x02>;
				led_mode = <0x00>;
				data = <0x01>;
				pwm_config = <0x00 0x00 0x00 0x00 0x00>;
				phandle = <0x4e>;
			};

			led@1 {
				compatible = "mediatek,green";
				max_brightness = <0x02>;
				led_mode = <0x00>;
				data = <0x01>;
				pwm_config = <0x00 0x00 0x00 0x00 0x00>;
				phandle = <0x4f>;
			};

			led@2 {
				compatible = "mediatek,blue";
				max_brightness = <0x02>;
				led_mode = <0x00>;
				data = <0x01>;
				pwm_config = <0x00 0x00 0x00 0x00 0x00>;
				phandle = <0x50>;
			};

			led@3 {
				compatible = "mediatek,jogball-backlight";
				led_mode = <0x00>;
				data = <0x01>;
				pwm_config = <0x00 0x00 0x00 0x00 0x00>;
				phandle = <0x51>;
			};

			led@4 {
				compatible = "mediatek,keyboard-backlight";
				led_mode = <0x00>;
				data = <0x01>;
				pwm_config = <0x00 0x00 0x00 0x00 0x00>;
				phandle = <0x52>;
			};

			led@5 {
				compatible = "mediatek,button-backlight";
				led_mode = <0x00>;
				data = <0x01>;
				pwm_config = <0x00 0x00 0x00 0x00 0x00>;
				phandle = <0x53>;
			};

			led@6 {
				compatible = "mediatek,lcd-backlight";
				led_mode = <0x05>;
				data = <0x01>;
				pwm_config = <0x03 0x00 0x00 0x00 0x00>;
				phandle = <0x54>;
			};

			vibrator@0 {
				compatible = "mediatek,vibrator";
				vib_timer = <0x19>;
				vib_limit = <0x09>;
				vib_vol = <0x0b>;
				vib_vol_cal = <0x0a>;
				phandle = <0x55>;
			};
		};
	};

	fragment@6 {
		target = <0xffffffff>;

		__overlay__ {

			bled {
				mt,max_bled_brightness = <0x555>;
			};

			dsv {
				db_vbst_del;
				db_delay_del;
			};
		};
	};

	fragment@7 {
		target = <0xffffffff>;

		__overlay__ {

			eint0default {
				phandle = <0x56>;
			};

			eint@0 {
				phandle = <0x11>;

				pins_cmd_dat {
					pinmux = <0x00>;
					slew-rate = <0x00>;
					bias-disable;
				};
			};

			eintoutput0 {
				phandle = <0x12>;

				pins_cmd_dat {
					pinmux = <0x00>;
					slew-rate = <0x01>;
					output-low;
				};
			};

			eintoutput1 {
				phandle = <0x13>;

				pins_cmd_dat {
					pinmux = <0x00>;
					slew-rate = <0x01>;
					output-high;
				};
			};

			rstoutput0 {
				phandle = <0x0f>;

				pins_cmd_dat {
					pinmux = <0xae00>;
					slew-rate = <0x01>;
					output-low;
				};
			};

			rstoutput1 {
				phandle = <0x0d>;

				pins_cmd_dat {
					pinmux = <0xae00>;
					slew-rate = <0x01>;
					output-high;
				};
			};

			csoutput0 {
				phandle = <0x10>;

				pins_cmd_dat {
					pinmux = <0x1a01>;
					slew-rate = <0x01>;
					output-low;
				};
			};

			csoutput1 {
				phandle = <0x0e>;

				pins_cmd_dat {
					pinmux = <0x1a01>;
					slew-rate = <0x01>;
					output-high;
				};
			};

			spistatus {
				phandle = <0x57>;

				pins_cmd_dat {
					pinmux = <0x1c01 0x1a01 0x1b01 0x1901>;
					drive-strength = <0x03>;
				};
			};
		};
	};

	fragment@8 {
		target = <0xffffffff>;

		__overlay__ {
			status = "okay";
			compatible = "huawei,ts_kit";
			bus_type = "spi";
			product = "pkn";
			bus_id = <0x01>;
			has_virtualkey = <0x00>;
			debounce = <0x06 0x00>;
			aft_enable = <0x00>;
			drv_stop_width = <0x00>;
			lcd_width = <0x00>;
			lcd_height = <0x00>;
			need_i2c_hwlock = <0x00>;
			register_charger_notifier = <0x00>;
			hide_plain_id = <0x01>;
			interrupt-parent = <0xffffffff>;
			interrupts = <0x00 0x02 0x00 0x00>;
			cs_gpio = <0xffffffff 0x1a 0x00>;
			pl022,com-mode = <0x01>;
			pl022,interface = <0x00>;
			pl022,rx-level-trig = <0x03>;
			pl022,tx-level-trig = <0x03>;
			pl022,ctrl-len = <0x07>;
			pl022,wait-state = <0x00>;
			pl022,duplex = <0x00>;
			pl022,slave-tx-disable = <0x00>;
			spi-max-frequency = <0x989680>;
			spi-mode = <0x00>;
			cs_reset_low_delay = <0x0a>;
			cs_reset_high_delay = <0xc8>;
			mtk_spi_mlsb_config = <0x01>;
			mtk_rx_mlsb = <0x01>;
			mtk_tx_mlsb = <0x01>;
			mtk_cs_pol = <0x00>;
			mtk_sample_sel = <0x00>;
			mtk_cs_setuptime = <0x1c>;
			recovery_update_fw = <0x01>;

			node1 {
				compatible = "chipone";
				reg = <0x00>;
				use-pinctrl = <0x01>;
				pinctrl-names = "default\0idle\0state_eint_as_int\0state_eint_output0\0state_eint_output1\0state_rst_output0\0state_rst_output1\0state_cs_output0\0state_cs_output1";
				pinctrl-0 = <0x0d 0x0e>;
				pinctrl-1 = <0x0f 0x10>;
				pinctrl-2 = <0x11>;
				pinctrl-3 = <0x12>;
				pinctrl-4 = <0x13>;
				pinctrl-5 = <0x0f>;
				pinctrl-6 = <0x0d>;
				pinctrl-7 = <0x10>;
				pinctrl-8 = <0x0e>;
				hide_fw_name = <0x01>;
				use-huawei-charger-detect = <0x01>;
				charger_supported = <0x01>;
				tp_test_type = "Normalize_type:judge_last_result";
				x_max = <0x2d0>;
				y_max = <0x640>;
				x_max_mt = <0x2d0>;
				y_max_mt = <0x640>;
				max_fingers = <0x0a>;
				parade,is_parade_solution = <0x00>;
				parade,direct_proc_cmd = <0x00>;
				is_i2c_one_byte = <0x00>;
				rawdata_newformatflag = <0x00>;
				is_ic_rawdata_proc_printf = <0x01>;
				roi_supported = <0x01>;
				gesture_supported = <0x01>;
				touch_switch_flag = <0x00>;
				get_brightness_info_flag = <0x00>;
				need_wd_check_status = <0x01>;
				check_status_watchdog_timeout = <0x7d0>;
				default_project_id = "GPKNAC260";

				GPKNAC260 {
					producer = "260";
					compatible = "GPKNAC260";
					boot-hw-reset-timing = [01 01 32];
					resume-hw-reset-timing = [01 01 14];
					ic_type = <0x991110>;
					is_incell = <0x01>;
					algo_id = <0x01>;
					irq_config = <0x03>;
					spi-mode = <0x00>;
					spi-max-frequency = <0x7a1200>;
					test-reset-pin = <0x01>;
					test-int-pin = <0x01>;
					test-rawdata = <0x01>;
					rawdata-test-frames = <0x01>;
					rawdata-test-min = <0x5dc>;
					rawdata-test-max = <0xb2c>;
					test-noise = <0x01>;
					noise-test-frames = <0x32>;
					noise-test-max = <0x46>;
					test-open = <0x01>;
					open-test-min = <0xbb8>;
					test-short = <0x01>;
					short-test-min = <0x1f4>;
					test-compensate-cap = <0x01>;
					compensate-cap-test-min = <0x0a>;
					compensate-cap-test-max = <0x6e>;
					dump-factory-test-data-to-console;
					dump-factory-test-data-to-buffer;
					dump-factory-test-data-to-file;
					print-factory-test-data-only-fail;
					factory-test-data-directory = "/data/vendor/log/tpdata/";
				};
			};

			node2 {
				compatible = "fts";
				reg = <0x00>;
				irq_config = <0x03>;
				spi-mode = <0x00>;
				spi-max-frequency = <0x7a1200>;
				projectid_len = <0x0a>;
				ic_type = <0x07>;
				is_in_cell = <0x01>;
				power_self_ctrl = <0x00>;
				pinctrl-names = "default\0idle\0state_eint_as_int\0state_eint_output0\0state_eint_output1\0state_rst_output0\0state_rst_output1\0state_cs_output0\0state_cs_output1";
				pinctrl-0 = <0x0d 0x0e>;
				pinctrl-1 = <0x0f 0x10>;
				pinctrl-2 = <0x11>;
				pinctrl-3 = <0x12>;
				pinctrl-4 = <0x13>;
				pinctrl-5 = <0x0f>;
				pinctrl-6 = <0x0d>;
				pinctrl-7 = <0x10>;
				pinctrl-8 = <0x0e>;
				x_max = <0x2d0>;
				y_max = <0x640>;
				x_max_mt = <0x2d0>;
				y_max_mt = <0x640>;
				flip_x = <0x01>;
				flip_y = <0x01>;
				parade,is_parade_solution = <0x00>;
				parade,direct_proc_cmd = <0x00>;
				parade,sleep_in_mode = <0x00>;
				roi_supported = <0x01>;
				roi_control_addr = <0x9b>;
				need_wd_check_status = <0x00>;
				touch_switch_flag = <0x00>;
				hide_fw_name = <0x01>;
				glove_supported = <0x00>;
				holster_supported = <0x00>;
				pen_support = <0x00>;
				support_3d_func = <0x00>;
				charger_supported = <0x00>;
				check_bulcked = <0x00>;
				support_aft = <0x00>;
				use_lcdkit_power_notify = <0x01>;
				fp_tp_report_touch_minor_event = <0x00>;
				algo_id = <0x01>;
				check_status_watchdog_timeout = <0x00>;
				get_brightness_info_flag = <0x00>;
				has_virtualkey = <0x00>;
				lcd_full = <0x00>;
				provide_panel_id_support = <0x01>;
				chip_id = <0x87>;
				hard_reset_delay = <0xc8>;
				erase_min_delay = <0x546>;
				calc_crc_delay = <0x12c>;
				reboot_delay = <0x12c>;
				erase_query_delay = <0x32>;
				write_flash_query_times = <0x1e>;
				read_ecc_query_times = <0x64>;
				erase_flash_query_times = <0x64>;
				upgrade_loop_times = <0x05>;
				rawdata_newformatflag = <0x00>;
				fts,fw_only_depend_on_lcd = <0x00>;
				fts,need_distinguish_lcd = <0x00>;
				only_open_once_captest_threshold = <0x00>;
				read_debug_reg_and_differ = <0x00>;
				is_ic_rawdata_proc_printf = <0x01>;
				gesture_supported = <0x01>;
				tp_test_type = "Normalize_type:judge_last_result";

				GPKN9W340 {
					producer = "340";
					ic_type = <0x07>;
					compatible = "fts-GPKN9W340";
					row_column_delta_test = <0x00>;
					lcd_noise_data_test = <0x00>;
					threshold,point_by_point_judge = <0x01>;
					row_column_delta_test_point_by_point = <0x01>;
					open_test_cb_point_by_point = <0x01>;
					short_test_point_by_point = <0x01>;
					cb_test_point_by_point = <0x01>;
					threshold,in_csv_file = <0x01>;
					threshold,raw_data_min = <0x2082>;
					threshold,raw_data_max = <0x4382>;
					threshold,scap_raw_data_min = <0x2082>;
					threshold,scap_raw_data_max = <0x4382>;
					threshold,cb_test_min = <0x01>;
					threshold,cb_test_max = <0xca>;
					threshold,short_circuit_min = <0x3ea>;
					threshold,lcd_noise_max = <0x66>;
				};
			};
		};
	};

	fragment@9 {
		target = <0xffffffff>;

		__overlay__ {

			sgm7220@47 {
				compatible = "sgm,sgm7220";
				reg = <0x47>;
				status = "okay";
				sgm7220,irq_gpio = <0xffffffff 0x16 0x00>;
				phandle = <0x58>;
			};

			wusb3801x@60 {
				compatible = "mediatek,wusb3801x";
				reg = <0x60>;
				status = "okay";
				wusb3801,irq-gpio = <0xffffffff 0x16 0x00>;
				wusb3801,init-mode = <0x24>;
				wusb3801,host-current = <0x01>;
				wusb3801,drp-toggle-time = <0x28>;
				phandle = <0x59>;
			};
		};
	};

	fragment@10 {
		target = <0xffffffff>;

		__overlay__ {

			sy6974@6B {
				compatible = "mediatek,sy6974";
				reg = <0x6b>;
				status = "okay";
				phandle = <0x5a>;
			};

			sgm41511h@6B {
				compatible = "mediatek,sgm41511";
				status = "okay";
				reg = <0x6b>;
				gpio_int = <0xffffffff 0x0b 0x00>;
				gpio_cd = <0xffffffff 0x9a 0x00>;
			};
		};
	};

	fragment@11 {
		target = <0xffffffff>;

		__overlay__ {
			ac_charger_current = <0x290bd0>;
			ac_charger_input_current = <0x231860>;
			non_std_ac_charger_current = <0x124f80>;
			dpm_enable;
			dynamic_cv_en;
			enable_slowly_insert_redo_bc12;
			battery_cv = <0x4398b0>;
			iterm = <0x249f0>;
			jeita_temp_t2_to_t3_cv = <0x42d560>;
			jeita_temp_t1_to_t2_cv = <0x42d560>;
			jeita_temp_t0_to_t1_cv = <0x42d560>;
			jeita_temp_t3_to_t4_cur = <0x15e578>;
			jeita_temp_t2_to_t3_cur = <0x2bcaf0>;
			jeita_temp_t1_to_t2_cur = <0x12c4b0>;
			jeita_temp_t0_to_t1_cur = <0x64190>;
			vdpm_buf_limit = <0x64>;
			vdpm_para = "-32767\04000\04200\050\04000\04200\04400\050\04200\032767\04600\050";
			charge_full_design = <0x4c4b40>;
		};
	};

	fragment@12 {
		target = <0xffffffff>;

		__overlay__ {
			compatible = "huawei,charger";
			status = "okay";
		};
	};

	fragment@13 {
		target = <0xffffffff>;

		__overlay__ {
			compatible = "huawei,battery";
			voltage_max_design = <0x432380>;
			status = "okay";
		};
	};

	fragment@14 {
		target = <0xffffffff>;

		__overlay__ {
			ac_charger_current = <0x100590>;
			ac_charger_input_current = <0x100590>;
			non_std_ac_charger_current = <0x100590>;
			is_power_path;
			r_charger_1 = <0x12c>;
		};
	};

	fragment@15 {
		target = <0xffffffff>;

		__overlay__ {

			charger {
				status = "disabled";
			};
		};
	};

	fragment@16 {
		target = <0xffffffff>;

		__overlay__ {
			interrupt-parent = <0xffffffff>;
			interrupts = <0x0b 0x08 0x0b 0x00>;
			g_otg_typecc_no_id_pin;
			status = "okay";
		};
	};

	fragment@17 {
		target = <0xffffffff>;

		__overlay__ {
			bat_para = "feimaotui\0220000\0240000\0xinwangda\0590000\0690000\0desay\0250000\0350000";
			batt_id_channel = <0x04>;
			min_fcc = <0x200b20>;
			max_fcc = <0x4c4b40>;
			rbat_pull_up_r = <0x4204>;
			vbus_r_charger_1 = <0x12c>;
			dlpt_optimization;
			batt_temperature_table_num = <0x15>;
			batt_temperature_table = <0xffffffe2 0x1cc8c 0xffffffe7 0x16242 0xffffffec 0x112e2 0xfffffff1 0xd71e 0xfffffff6 0xa9b0 0xfffffffb 0x86e2 0x00 0x6bf8 0x05 0x56fe 0x0a 0x468c 0x0f 0x3994 0x14 0x2f4e 0x19 0x2710 0x1e 0x2075 0x23 0x1b1d 0x28 0x16c4 0x2d 0x1334 0x32 0x1045 0x37 0xdd7 0x3c 0xbd3 0x41 0xa23 0x46 0x8b9>;
			battery0_profile_t0_num = <0x64>;
			battery0_profile_t0 = <0x00 0xac94 0x37a 0x1f8 0xac0f 0x37a 0x3f0 0xab9e 0x379 0x5e9 0xab2d 0x366 0x7e1 0xaac5 0x366 0x9d9 0xaa55 0x369 0xbd1 0xa9ef 0x37a 0xdca 0xa986 0x37a 0xfc2 0xa914 0x37a 0x11ba 0xa8a3 0x37d 0x13b2 0xa82f 0x381 0x15ab 0xa7b7 0x37a 0x17a3 0xa746 0x37d 0x199b 0xa6cd 0x380 0x1b93 0xa64f 0x37e 0x1d8c 0xa5da 0x384 0x1f84 0xa55e 0x384 0x217c 0xa4e8 0x384 0x2374 0xa471 0x384 0x256d 0xa3fb 0x38f 0x2765 0xa384 0x392 0x295d 0xa309 0x38e 0x2b55 0xa294 0x38e 0x2d4e 0xa21c 0x38e 0x2f46 0xa1ae 0x38e 0x313e 0xa140 0x38e 0x3336 0xa0c7 0x38e 0x352f 0xa05c 0x396 0x3727 0x9fec 0x398 0x391f 0x9f84 0x3a9 0x3b17 0x9f14 0x3ac 0x3d10 0x9eb5 0x3be 0x3f08 0x9e4f 0x3b7 0x4100 0x9de8 0x3c0 0x42f8 0x9d8b 0x3d4 0x44f0 0x9d24 0x3d4 0x46e9 0x9cc8 0x3df 0x48e1 0x9c6c 0x3f3 0x4ad9 0x9c18 0x3fe 0x4cd1 0x9bb3 0x415 0x4eca 0x9b5e 0x433 0x50c2 0x9af3 0x41a 0x52ba 0x9a71 0x406 0x54b2 0x99d7 0x3b4 0x56ab 0x9947 0x38b 0x58a3 0x98dc 0x384 0x5a9b 0x9883 0x381 0x5c93 0x9834 0x373 0x5e8c 0x97ec 0x362 0x6084 0x97ad 0x369 0x627c 0x9775 0x37a 0x6474 0x9737 0x37a 0x666d 0x96f9 0x37a 0x6865 0x96c1 0x37a 0x6a5d 0x968e 0x380 0x6c55 0x965a 0x37e 0x6e4e 0x9627 0x380 0x7046 0x95f3 0x384 0x723e 0x95c0 0x384 0x7436 0x959b 0x392 0x762f 0x956d 0x389 0x7827 0x9549 0x393 0x7a1f 0x9522 0x398 0x7c17 0x94f9 0x398 0x7e10 0x94d8 0x3b2 0x8008 0x94b0 0x3b6 0x8200 0x9490 0x3b6 0x83f8 0x9472 0x3d2 0x85f0 0x943f 0x3c0 0x87e9 0x940c 0x3b6 0x89e1 0x93b9 0x383 0x8bd9 0x9368 0x368 0x8dd1 0x9321 0x384 0x8fca 0x92ef 0x384 0x91c2 0x92c4 0x386 0x93ba 0x9291 0x38c 0x95b2 0x9260 0x384 0x97ab 0x9234 0x384 0x99a3 0x9203 0x387 0x9b9b 0x91da 0x391 0x9d93 0x91ae 0x398 0x9f8c 0x9173 0x394 0xa184 0x912f 0x392 0xa37c 0x90f1 0x394 0xa574 0x90af 0x392 0xa76d 0x905e 0x38a 0xa965 0x9015 0x36b 0xab5d 0x8ff1 0x361 0xad55 0x8fe8 0x382 0xaf4e 0x8fdc 0x39e 0xb146 0x8fce 0x3cd 0xb33e 0x8fb7 0x40f 0xb536 0x8f7d 0x43f 0xb72f 0x8ea1 0x3e3 0xb927 0x8d1a 0x3c5 0xbb1f 0x8b07 0x3e8 0xbd17 0x883b 0x429 0xbf10 0x8423 0x49a 0xc108 0x7c8a 0x8e6 0xc300 0x7b52 0x9a6>;
			battery0_profile_t1_num = <0x64>;
			battery0_profile_t1 = <0x00 0xac9e 0x528 0x1f8 0xac2d 0x527 0x3f0 0xabc6 0x509 0x5e9 0xab60 0x500 0x7e1 0xab02 0x502 0x9d9 0xaa9a 0x510 0xbd1 0xaa2a 0x4f6 0xdca 0xa9c9 0x4f8 0xfc2 0xa958 0x4fd 0x11ba 0xa8ea 0x4f9 0x13b2 0xa87d 0x4f7 0x15ab 0xa805 0x4e9 0x17a3 0xa790 0x4fd 0x199b 0xa718 0x50a 0x1b93 0xa6a3 0x501 0x1d8c 0xa626 0x4fb 0x1f84 0xa5a9 0x4fb 0x217c 0xa52e 0x4fb 0x2374 0xa4b8 0x500 0x256d 0xa441 0x500 0x2765 0xa3c5 0x4fa 0x295d 0xa350 0x4e9 0x2b55 0xa2d8 0x4e2 0x2d4e 0xa264 0x4e2 0x2f46 0xa1f3 0x4e2 0x313e 0xa178 0x4e2 0x3336 0xa10c 0x4f2 0x352f 0xa09d 0x4fe 0x3727 0xa02c 0x500 0x391f 0x9fc4 0x509 0x3b17 0x9f5d 0x50a 0x3d10 0x9eec 0x514 0x3f08 0x9e8f 0x532 0x4100 0x9e28 0x53c 0x42f8 0x9dc1 0x551 0x44f0 0x9d62 0x55b 0x46e9 0x9cfc 0x567 0x48e1 0x9ca0 0x57b 0x4ad9 0x9c41 0x58c 0x4cd1 0x9bdf 0x590 0x4eca 0x9b85 0x59e 0x50c2 0x9b11 0x58b 0x52ba 0x9a90 0x559 0x54b2 0x99fc 0x50d 0x56ab 0x9969 0x4c6 0x58a3 0x98f7 0x4a6 0x5a9b 0x98a0 0x49e 0x5c93 0x9848 0x489 0x5e8c 0x97fb 0x47e 0x6084 0x97b8 0x483 0x627c 0x977a 0x483 0x6474 0x973c 0x47e 0x666d 0x9704 0x484 0x6865 0x96cb 0x488 0x6a5d 0x969a 0x488 0x6c55 0x966a 0x488 0x6e4e 0x9637 0x481 0x7046 0x9603 0x494 0x723e 0x95d7 0x4a4 0x7436 0x95ae 0x49e 0x762f 0x9585 0x4b5 0x7827 0x955c 0x4b1 0x7a1f 0x9533 0x4b0 0x7c17 0x9509 0x4b0 0x7e10 0x94ea 0x4b0 0x8008 0x94cb 0x4cd 0x8200 0x94ac 0x4c4 0x83f8 0x948d 0x4d7 0x85f0 0x945a 0x4bb 0x87e9 0x943b 0x4cb 0x89e1 0x941b 0x4b0 0x8bd9 0x93f1 0x4b0 0x8dd1 0x93bf 0x4b0 0x8fca 0x9394 0x4ae 0x91c2 0x9360 0x4a4 0x93ba 0x932d 0x49c 0x95b2 0x92fc 0x499 0x97ab 0x92d0 0x48c 0x99a3 0x92a3 0x48c 0x9b9b 0x9284 0x4aa 0x9d93 0x925d 0x4ac 0x9f8c 0x9225 0x4a6 0xa184 0x91e2 0x4a1 0xa37c 0x919f 0x49c 0xa574 0x9167 0x4a1 0xa76d 0x9128 0x4ac 0xa965 0x90ce 0x498 0xab5d 0x908d 0x488 0xad55 0x9077 0x495 0xaf4e 0x906d 0x4aa 0xb146 0x9063 0x4c6 0xb33e 0x9051 0x4ec 0xb536 0x9035 0x50d 0xb72f 0x8fe6 0x52c 0xb927 0x8eda 0x500 0xbb1f 0x8d1b 0x507 0xbd17 0x8ab9 0x52e 0xbf10 0x8780 0x59a 0xc108 0x824e 0x658 0xc300 0x7530 0x2468>;
			battery0_profile_t2_num = <0x64>;
			battery0_profile_t2 = <0x00 0xacbc 0x7d0 0x1f8 0xac55 0x7d0 0x3f0 0xabee 0x7c5 0x5e9 0xab89 0x7b2 0x7e1 0xab34 0x7b1 0x9d9 0xaacd 0x7a7 0xbd1 0xaa68 0x7a1 0xdca 0xaa08 0x7b0 0xfc2 0xa996 0x7a6 0x11ba 0xa928 0x7a1 0x13b2 0xa8be 0x7a8 0x15ab 0xa84a 0x7a5 0x17a3 0xa7ce 0x794 0x199b 0xa753 0x780 0x1b93 0xa6db 0x788 0x1d8c 0xa666 0x790 0x1f84 0xa5ea 0x781 0x217c 0xa56f 0x771 0x2374 0xa4f3 0x76c 0x256d 0xa478 0x76c 0x2765 0xa402 0x772 0x295d 0xa38b 0x776 0x2b55 0xa30f 0x770 0x2d4e 0xa29a 0x76c 0x2f46 0xa222 0x76c 0x313e 0xa1ae 0x77b 0x3336 0xa13d 0x78f 0x352f 0xa0cc 0x794 0x3727 0xa05a 0x794 0x391f 0x9ff2 0x7a5 0x3b17 0x9f82 0x7a8 0x3d10 0x9f1a 0x7a8 0x3f08 0x9eaa 0x7c4 0x4100 0x9e42 0x7c6 0x42f8 0x9ddb 0x7da 0x44f0 0x9d6a 0x7d0 0x46e9 0x9d03 0x7da 0x48e1 0x9c9c 0x7d8 0x4ad9 0x9c2c 0x7c7 0x4cd1 0x9bc1 0x7c9 0x4eca 0x9b3c 0x797 0x50c2 0x9abd 0x767 0x52ba 0x9a32 0x71b 0x54b2 0x99b9 0x6ed 0x56ab 0x994a 0x6ce 0x58a3 0x98e6 0x6b5 0x5a9b 0x988a 0x6a4 0x5c93 0x9838 0x697 0x5e8c 0x97f2 0x698 0x6084 0x97a9 0x68a 0x627c 0x976b 0x690 0x6474 0x972d 0x695 0x666d 0x96f4 0x69f 0x6865 0x96bc 0x6a4 0x6a5d 0x9684 0x6aa 0x6c55 0x9650 0x6ae 0x6e4e 0x961d 0x6ae 0x7046 0x95e9 0x6b5 0x723e 0x95bd 0x6b8 0x7436 0x9593 0x6bf 0x762f 0x9563 0x6d1 0x7827 0x9537 0x6de 0x7a1f 0x9516 0x6e0 0x7c17 0x94e6 0x6e0 0x7e10 0x94c4 0x6e9 0x8008 0x94a5 0x6ea 0x8200 0x9486 0x706 0x83f8 0x945e 0x708 0x85f0 0x943f 0x708 0x87e9 0x9420 0x712 0x89e1 0x9401 0x713 0x8bd9 0x93e1 0x724 0x8dd1 0x93b9 0x709 0x8fca 0x9398 0x70e 0x91c2 0x9366 0x6f7 0x93ba 0x933d 0x706 0x95b2 0x9314 0x700 0x97ab 0x92ea 0x708 0x99a3 0x92c1 0x708 0x9b9b 0x9298 0x70e 0x9d93 0x926c 0x71c 0x9f8c 0x9231 0x720 0xa184 0x91ed 0x726 0xa37c 0x91b3 0x736 0xa574 0x9177 0x757 0xa76d 0x912a 0x767 0xa965 0x90d8 0x76c 0xab5d 0x90a0 0x781 0xad55 0x9087 0x7a5 0xaf4e 0x9072 0x7c4 0xb146 0x905e 0x801 0xb33e 0x9043 0x854 0xb536 0x901d 0x8c8 0xb72f 0x8fb5 0x93f 0xb927 0x8e8e 0x97d 0xbb1f 0x8ca4 0x9fa 0xbd17 0x8a07 0xb0b 0xbf10 0x8653 0xcfc 0xc108 0x7fde 0x12e5 0xc300 0x72f6 0xeaa6>;
			battery0_profile_t3_num = <0x64>;
			battery0_profile_t3 = <0x00 0xacda 0xec4 0x1f8 0xac55 0xec4 0x3f0 0xabe4 0xec3 0x5e9 0xab7d 0xead 0x7e1 0xab16 0xe85 0x9d9 0xaaaf 0xe69 0xbd1 0xaa49 0xe5d 0xdca 0xa9e2 0xe48 0xfc2 0xa978 0xe33 0x11ba 0xa907 0xe1c 0x13b2 0xa896 0xdfd 0x15ab 0xa822 0xdde 0x17a3 0xa7aa 0xdc7 0x199b 0xa735 0xdbc 0x1b93 0xa6bd 0xda2 0x1d8c 0xa648 0xd7b 0x1f84 0xa5c8 0xd67 0x217c 0xa54c 0xd52 0x2374 0xa4d5 0xd3e 0x256d 0xa45f 0xd34 0x2765 0xa3e8 0xd2e 0x295d 0xa36d 0xd1e 0x2b55 0xa2f1 0xd10 0x2d4e 0xa27c 0xcf1 0x2f46 0xa20b 0xcf9 0x313e 0xa193 0xcf3 0x3336 0xa11f 0xcf6 0x352f 0xa0ae 0xce8 0x3727 0xa03c 0xcdc 0x391f 0x9fcb 0xce2 0x3b17 0x9f5a 0xce4 0x3d10 0x9ee9 0xce4 0x3f08 0x9e78 0xcd1 0x4100 0x9e06 0xcc6 0x42f8 0x9d95 0xcd0 0x44f0 0x9d1a 0xcbb 0x46e9 0x9c9e 0xc9c 0x48e1 0x9c23 0xc73 0x4ad9 0x9ba7 0xc4b 0x4cd1 0x9b2d 0xc2c 0x4eca 0x9abc 0xc0b 0x50c2 0x9a49 0xbe2 0x52ba 0x99d2 0xbb9 0x54b2 0x996b 0xb95 0x56ab 0x990a 0xb86 0x58a3 0x98b4 0xb80 0x5a9b 0x985e 0xb79 0x5c93 0x9813 0xb7f 0x5e8c 0x97c4 0xb7a 0x6084 0x9781 0xb82 0x627c 0x973e 0xb81 0x6474 0x96fb 0xb86 0x666d 0x96c2 0xb8b 0x6865 0x968f 0xb95 0x6a5d 0x9650 0xb9a 0x6c55 0x961a 0xbb2 0x6e4e 0x95eb 0xbbc 0x7046 0x95b7 0xbbf 0x723e 0x958b 0xbd7 0x7436 0x9561 0xbee 0x762f 0x9531 0xc03 0x7827 0x9505 0xc10 0x7a1f 0x94e4 0xc22 0x7c17 0x94b4 0xc26 0x7e10 0x9492 0xc37 0x8008 0x9473 0xc4c 0x8200 0x9454 0xc6a 0x83f8 0x942c 0xc6c 0x85f0 0x940d 0xc80 0x87e9 0x93ee 0xc8a 0x89e1 0x93cf 0xcb3 0x8bd9 0x93ba 0xcd1 0x8dd1 0x939a 0xcdb 0x8fca 0x9374 0xcea 0x91c2 0x935d 0xd1b 0x93ba 0x933d 0xd38 0x95b2 0x9314 0xd55 0x97ab 0x92ed 0xd92 0x99a3 0x92c9 0xdd0 0x9b9b 0x9295 0xe08 0x9d93 0x925e 0xe3b 0x9f8c 0x921d 0xe83 0xa184 0x91d9 0xed3 0xa37c 0x9197 0xf37 0xa574 0x914f 0xfa9 0xa76d 0x90fe 0x1023 0xa965 0x90b5 0x10bd 0xab5d 0x9082 0x117c 0xad55 0x9059 0x1265 0xaf4e 0x9035 0x1390 0xb146 0x9012 0x14fe 0xb33e 0x8fdf 0x16d3 0xb536 0x8f80 0x191f 0xb72f 0x8eba 0x1be0 0xb927 0x8d58 0x1f92 0xbb1f 0x8b46 0x2586 0xbd17 0x8858 0x30ba 0xbf10 0x83fd 0x48e5 0xc108 0x7b34 0xfb70 0xc300 0x77ec 0xf4c4>;
			battery0_profile_t4_num = <0x64>;
			battery0_profile_t4 = <0x00 0xacee 0x1d4c 0x1f8 0xac36 0x1d4e 0x3f0 0xaba7 0x1d95 0x5e9 0xab2c 0x1dd1 0x7e1 0xaaaf 0x1dea 0x9d9 0xaa2b 0x1dd5 0xbd1 0xa9b1 0x1db8 0xdca 0xa93e 0x1d7a 0xfc2 0xa8c2 0x1d61 0x11ba 0xa847 0x1d3f 0x13b2 0xa7ce 0x1d24 0x15ab 0xa75a 0x1cec 0x17a3 0xa6db 0x1cd0 0x199b 0xa65c 0x1ca3 0x1b93 0xa5e6 0x1c73 0x1d8c 0xa565 0x1c53 0x1f84 0xa4e9 0x1c39 0x217c 0xa472 0x1c0b 0x2374 0xa3f7 0x1bd8 0x256d 0xa37b 0x1ba9 0x2765 0xa306 0x1b7c 0x295d 0xa28e 0x1b59 0x2b55 0xa219 0x1b3a 0x2d4e 0xa1a1 0x1b14 0x2f46 0xa124 0x1ae3 0x313e 0xa0a8 0x1ab7 0x3336 0xa034 0x1a9e 0x352f 0x9fbb 0x1a71 0x3727 0x9f51 0x1a4e 0x391f 0x9ed8 0x1a27 0x3b17 0x9e5c 0x1a10 0x3d10 0x9de1 0x19e8 0x3f08 0x9d65 0x19dc 0x4100 0x9cea 0x19aa 0x42f8 0x9c6f 0x199e 0x44f0 0x9bfe 0x1959 0x46e9 0x9b8c 0x1943 0x48e1 0x9b1b 0x191b 0x4ad9 0x9aad 0x18ff 0x4cd1 0x9a4f 0x18f4 0x4eca 0x99e8 0x18e6 0x50c2 0x9985 0x18cc 0x52ba 0x9930 0x18c7 0x54b2 0x98d7 0x18d7 0x56ab 0x9881 0x18e2 0x58a3 0x9828 0x18d5 0x5a9b 0x97da 0x18e6 0x5c93 0x9792 0x18f0 0x5e8c 0x974e 0x18ff 0x6084 0x970b 0x1918 0x627c 0x96c8 0x193c 0x6474 0x968b 0x1965 0x666d 0x964d 0x197e 0x6865 0x9615 0x1999 0x6a5d 0x95db 0x19c2 0x6c55 0x95a4 0x19e5 0x6e4e 0x9571 0x1a0b 0x7046 0x953d 0x1a34 0x723e 0x950a 0x1a5d 0x7436 0x94e5 0x1a95 0x762f 0x94b7 0x1ad3 0x7827 0x9494 0x1af0 0x7a1f 0x9475 0x1b27 0x7c17 0x9456 0x1b5c 0x7e10 0x942e 0x1b86 0x8008 0x940e 0x1bc2 0x8200 0x93f9 0x1c1c 0x83f8 0x93da 0x1c83 0x85f0 0x93c6 0x1ce0 0x87e9 0x93b1 0x1d64 0x89e1 0x9392 0x1dc2 0x8bd9 0x9373 0x1e37 0x8dd1 0x9354 0x1ec7 0x8fca 0x9335 0x1f54 0x91c2 0x9314 0x1fdc 0x93ba 0x92ed 0x20a7 0x95b2 0x92cc 0x2186 0x97ab 0x92a0 0x225f 0x99a3 0x9270 0x2346 0x9b9b 0x9240 0x2452 0x9d93 0x9202 0x2561 0x9f8c 0x91c4 0x269a 0xa184 0x9187 0x280d 0xa37c 0x9149 0x29a8 0xa574 0x910b 0x2b72 0xa76d 0x90cd 0x2d65 0xa965 0x9095 0x2fb2 0xab5d 0x9062 0x3231 0xad55 0x902e 0x3507 0xaf4e 0x8ffb 0x382e 0xb146 0x8fba 0x3b6c 0xb33e 0x8f64 0x3ec9 0xb536 0x8eeb 0x42bc 0xb72f 0x8e22 0x4831 0xb927 0x8cf3 0x51b4 0xbb1f 0x8b21 0x57fb 0xbd17 0x816f 0x4a77 0xbf10 0x7dd3 0x4637 0xc108 0x7bc0 0xfc8a 0xc300 0x7bc0 0xfc8a>;
			battery1_profile_t0_num = <0x64>;
			battery1_profile_t0 = <0x00 0xaa50 0x352 0x204 0xa9d8 0x392 0x407 0xa967 0x3af 0x60b 0xa8f1 0x3a8 0x80e 0xa879 0x39d 0xa12 0xa803 0x3a4 0xc15 0xa792 0x3b6 0xe19 0xa71a 0x3b6 0x101c 0xa6a2 0x3b6 0x1220 0xa629 0x3b6 0x1424 0xa5b1 0x3b6 0x1627 0xa539 0x3b6 0x182b 0xa4ba 0x3dd 0x1a2e 0xa435 0x41e 0x1c32 0xa3be 0x3b6 0x1e35 0xa353 0x3b6 0x2039 0xa2de 0x3b6 0x223c 0xa26a 0x3c2 0x2440 0xa1fb 0x3cf 0x2644 0xa189 0x3cf 0x2847 0xa111 0x3cf 0x2a4b 0xa0a2 0x3cf 0x2c4e 0xa032 0x3cf 0x2e52 0x9fc8 0x3cf 0x3055 0x9f61 0x3db 0x3259 0x9efa 0x3e8 0x345c 0x9e91 0x3e3 0x3660 0x9e23 0x3d1 0x3864 0x9dc6 0x3e6 0x3a67 0x9d67 0x3fb 0x3c6b 0x9d09 0x401 0x3e6e 0x9caa 0x401 0x4072 0x9c4f 0x40a 0x4275 0x9bf7 0x415 0x4479 0x9b9a 0x403 0x467c 0x9b44 0x418 0x4880 0x9af6 0x441 0x4a84 0x9aa2 0x45c 0x4c87 0x9a47 0x472 0x4e8b 0x99d3 0x463 0x508e 0x993c 0x417 0x5292 0x989e 0x3b6 0x5495 0x9837 0x3b6 0x5699 0x97e8 0x3b6 0x589c 0x97a1 0x3c6 0x5aa0 0x975d 0x3c2 0x5ca4 0x971c 0x3b6 0x5ea7 0x96e0 0x3b6 0x60ab 0x96a3 0x3b4 0x62ae 0x9667 0x39e 0x64b2 0x9633 0x39d 0x66b5 0x9606 0x3ae 0x68b9 0x95d6 0x3b6 0x6abc 0x95a6 0x3b6 0x6cc0 0x9579 0x3b6 0x6ec4 0x9547 0x3b4 0x70c7 0x951c 0x39e 0x72cb 0x94fa 0x3b1 0x74ce 0x94d7 0x3c7 0x76d2 0x94b5 0x3cf 0x78d5 0x9492 0x3cf 0x7ad9 0x9470 0x3d5 0x7cdc 0x944e 0x3e8 0x7ee0 0x942b 0x3e8 0x80e4 0x9411 0x3fd 0x82e7 0x93f1 0x412 0x84eb 0x93be 0x3ff 0x86ee 0x9372 0x3ca 0x88f2 0x931e 0x3a4 0x8af5 0x92e3 0x3b6 0x8cf9 0x92af 0x3b6 0x8efc 0x9284 0x3b6 0x9100 0x9259 0x3c8 0x9304 0x9228 0x3c1 0x9507 0x91f9 0x3c0 0x970b 0x91ce 0x3c8 0x990e 0x91a5 0x3bd 0x9b12 0x9182 0x3e8 0x9d15 0x9146 0x3e8 0x9f19 0x9103 0x3d6 0xa11c 0x90be 0x3cf 0xa320 0x907a 0x3cf 0xa524 0x9030 0x3c1 0xa727 0x8fe3 0x39a 0xa92b 0x8fc0 0x384 0xab2e 0x8fb7 0x3af 0xad32 0x8faf 0x3da 0xaf35 0x8fa1 0x413 0xb139 0x8f8b 0x453 0xb33c 0x8f51 0x477 0xb540 0x8eac 0x456 0xb744 0x8d30 0x401 0xb947 0x8b13 0x42c 0xbb4b 0x8847 0x47c 0xbd4e 0x842a 0x52a 0xbf52 0x7d25 0xe3d 0xc155 0x7640 0x1695 0xc359 0x73bf 0x104b 0xc55c 0x7123 0x992 0xc760 0x7102 0x992>;
			battery1_profile_t1_num = <0x64>;
			battery1_profile_t1 = <0x00 0xaaa0 0x47e 0x204 0xaa39 0x493 0x407 0xa9cb 0x485 0x60b 0xa95b 0x47e 0x80e 0xa8eb 0x489 0xa12 0xa879 0x497 0xc15 0xa802 0x497 0xe19 0xa792 0x497 0x101c 0xa711 0x481 0x1220 0xa697 0x47e 0x1424 0xa61f 0x48d 0x1627 0xa5a7 0x497 0x182b 0xa528 0x4be 0x1a2e 0xa4a3 0x4ff 0x1c32 0xa42c 0x497 0x1e35 0xa3c8 0x497 0x2039 0xa356 0x497 0x223c 0xa2de 0x497 0x2440 0xa269 0x49f 0x2644 0xa1f7 0x4b0 0x2847 0xa17f 0x4b0 0x2a4b 0xa110 0x4b0 0x2c4e 0xa0a0 0x4b0 0x2e52 0xa036 0x4c0 0x3055 0x9fca 0x4c9 0x3259 0x9f5e 0x4c9 0x345c 0x9ef7 0x4ce 0x3660 0x9e90 0x4e2 0x3864 0x9e2b 0x4e2 0x3a67 0x9dc4 0x4f5 0x3c6b 0x9d63 0x50b 0x3e6e 0x9d04 0x520 0x4072 0x9ca6 0x536 0x4275 0x9c49 0x54b 0x4479 0x9bf4 0x561 0x467c 0x9b9e 0x576 0x4880 0x9b48 0x59f 0x4a84 0x9af2 0x5ba 0x4c87 0x9a92 0x5c3 0x4e8b 0x9a23 0x5b1 0x508e 0x99a2 0x570 0x5292 0x990a 0x4f5 0x5495 0x9889 0x4b5 0x5699 0x9820 0x488 0x589c 0x97cd 0x47e 0x5aa0 0x9785 0x471 0x5ca4 0x9740 0x465 0x5ea7 0x9700 0x46b 0x60ab 0x96cb 0x47c 0x62ae 0x968f 0x466 0x64b2 0x965b 0x479 0x66b5 0x9628 0x47e 0x68b9 0x95f9 0x47e 0x6abc 0x95cb 0x47e 0x6cc0 0x959a 0x47e 0x6ec4 0x956f 0x47e 0x70c7 0x9544 0x47e 0x72cb 0x9522 0x492 0x74ce 0x94ff 0x4a8 0x76d2 0x94dd 0x4b0 0x78d5 0x94ba 0x4b0 0x7ad9 0x9498 0x4b0 0x7cdc 0x9476 0x4b0 0x7ee0 0x9453 0x4b0 0x80e4 0x9439 0x4c5 0x82e7 0x941f 0x4c9 0x84eb 0x9400 0x4c9 0x86ee 0x93de 0x4c9 0x88f2 0x93b9 0x4bc 0x8af5 0x938f 0x497 0x8cf9 0x936d 0x497 0x8efc 0x933a 0x482 0x9100 0x930d 0x47e 0x9304 0x92dc 0x470 0x9507 0x92ad 0x465 0x970b 0x9285 0x465 0x990e 0x9263 0x465 0x9b12 0x9240 0x465 0x9d15 0x9215 0x47a 0x9f19 0x91d5 0x46c 0xa11c 0x9196 0x473 0xa320 0x915a 0x47e 0xa524 0x9119 0x47e 0xa727 0x90ca 0x47b 0xa92b 0x9075 0x465 0xab2e 0x9052 0x465 0xad32 0x9045 0x477 0xaf35 0x9037 0x47e 0xb139 0x902a 0x494 0xb33c 0x9018 0x4bf 0xb540 0x8fe9 0x4ea 0xb744 0x8f76 0x513 0xb947 0x8dea 0x4d3 0xbb4b 0x8bce 0x4ed 0xbd4e 0x88ec 0x544 0xbf52 0x848d 0x61f 0xc155 0x7e50 0xd24 0xc359 0x77e8 0x1ab3 0xc55c 0x769b 0x17d6 0xc760 0x751c 0x13ec>;
			battery1_profile_t2_num = <0x64>;
			battery1_profile_t2 = <0x00 0xaaaa 0x578 0x204 0xaa3a 0x6fb 0x407 0xa9cb 0x73a 0x60b 0xa95b 0x73a 0x80e 0xa8eb 0x745 0xa12 0xa879 0x74c 0xc15 0xa800 0x73a 0xe19 0xa788 0x73a 0x101c 0xa710 0x73a 0x1220 0xa697 0x73a 0x1424 0xa61f 0x73a 0x1627 0xa5a7 0x745 0x182b 0xa528 0x799 0x1a2e 0xa4a3 0x80e 0x1c32 0xa42c 0x753 0x1e35 0xa3c1 0x73f 0x2039 0xa34c 0x73a 0x223c 0xa2d8 0x746 0x2440 0xa265 0x753 0x2644 0xa1ef 0x758 0x2847 0xa17f 0x76b 0x2a4b 0xa106 0x755 0x2c4e 0xa09e 0x77a 0x2e52 0xa030 0x785 0x3055 0x9fc0 0x785 0x3259 0x9f54 0x78e 0x345c 0x9eef 0x7a8 0x3660 0x9e8f 0x7d0 0x3864 0x9e22 0x7d0 0x3a67 0x9dc1 0x7f6 0x3c6b 0x9d5d 0x802 0x3e6e 0x9cf6 0x802 0x4072 0x9c92 0x80b 0x4275 0x9c33 0x81b 0x4479 0x9bd6 0x81e 0x467c 0x9b80 0x849 0x4880 0x9b22 0x84d 0x4a84 0x9abd 0x83d 0x4c87 0x9a4c 0x81b 0x4e8b 0x99d0 0x7de 0x508e 0x9951 0x78d 0x5292 0x98da 0x74d 0x5495 0x986a 0x70d 0x5699 0x980a 0x6f4 0x589c 0x97b2 0x6ce 0x5aa0 0x9767 0x6bd 0x5ca4 0x9726 0x6c6 0x5ea7 0x96e7 0x6ca 0x60ab 0x96a4 0x6a6 0x62ae 0x9671 0x6bc 0x64b2 0x963d 0x6bd 0x66b5 0x960a 0x6bd 0x68b9 0x95d6 0x6bd 0x6abc 0x95a6 0x6c7 0x6cc0 0x957c 0x6d6 0x6ec4 0x9551 0x6d6 0x70c7 0x9526 0x6d6 0x72cb 0x9504 0x6ff 0x74ce 0x94da 0x6f7 0x76d2 0x94b5 0x6ef 0x78d5 0x9492 0x6f9 0x7ad9 0x9470 0x708 0x7cdc 0x944f 0x70b 0x7ee0 0x9435 0x720 0x80e4 0x9413 0x70c 0x82e7 0x93f7 0x719 0x84eb 0x93de 0x721 0x86ee 0x93c4 0x721 0x88f2 0x93ad 0x721 0x8af5 0x939a 0x721 0x8cf9 0x9381 0x721 0x8efc 0x935e 0x721 0x9100 0x933c 0x70f 0x9304 0x930e 0x6fa 0x9507 0x92df 0x6ef 0x970b 0x92b7 0x6f6 0x990e 0x9293 0x70b 0x9b12 0x9268 0x721 0x9d15 0x9235 0x736 0x9f19 0x91f3 0x73a 0xa11c 0x91ae 0x73a 0xa320 0x916e 0x74f 0xa524 0x912a 0x773 0xa727 0x90d4 0x785 0xa92b 0x907f 0x785 0xab2e 0x905c 0x7b0 0xad32 0x9048 0x7db 0xaf35 0x9037 0x814 0xb139 0x9021 0x854 0xb33c 0x9004 0x8ab 0xb540 0x8fd0 0x928 0xb744 0x8f43 0x993 0xb947 0x8d9e 0x9ff 0xbb4b 0x8b4b 0xb0e 0xbd4e 0x8810 0xd51 0xbf52 0x82cc 0x13e1 0xc155 0x7cb3 0x1b34 0xc359 0x7879 0x1c44 0xc55c 0x76a1 0x17d6 0xc760 0x745e 0x11f8>;
			battery1_profile_t3_num = <0x64>;
			battery1_profile_t3 = <0x00 0xaaaa 0x47e 0x204 0xaa32 0xba0 0x407 0xa9c1 0xccb 0x60b 0xa94b 0xcbd 0x80e 0xa8d7 0xcb2 0xa12 0xa865 0xcb2 0xc15 0xa7ec 0xcb2 0xe19 0xa774 0xcb2 0x101c 0xa6fc 0xc9c 0x1220 0xa67c 0xc87 0x1424 0xa607 0xc80 0x1627 0xa593 0xc80 0x182b 0xa511 0xcf5 0x1a2e 0xa485 0xdb0 0x1c32 0xa40e 0xc4e 0x1e35 0xa3aa 0xc4e 0x2039 0xa338 0xc4e 0x223c 0xa2c4 0xc4e 0x2440 0xa251 0xc4e 0x2644 0xa1db 0xc4e 0x2847 0xa16b 0xc4e 0x2a4b 0xa0fc 0xc4e 0x2c4e 0xa08c 0xc4e 0x2e52 0xa01c 0xc4e 0x3055 0x9fb1 0xc5a 0x3259 0x9f47 0xc70 0x345c 0x9ed9 0xc85 0x3660 0x9e71 0xc99 0x3864 0x9e04 0xc99 0x3a67 0x9d9c 0xc99 0x3c6b 0x9d35 0xca9 0x3e6e 0x9cce 0xcb2 0x4072 0x9c66 0xca9 0x4275 0x9bff 0xc94 0x4479 0x9b98 0xc80 0x467c 0x9b31 0xc80 0x4880 0x9ac2 0xc59 0x4a84 0x9a52 0xc2e 0x4c87 0x99e3 0xbf6 0x4e8b 0x9973 0xbbf 0x508e 0x9903 0xb8e 0x5292 0x9895 0xb52 0x5495 0x9837 0xb3d 0x5699 0x97e0 0xb13 0x589c 0x9791 0xb09 0x5aa0 0x9744 0xafc 0x5ca4 0x96fa 0xaf0 0x5ea7 0x96b8 0xaf0 0x60ab 0x967c 0xaf2 0x62ae 0x9649 0xb08 0x64b2 0x9615 0xb1d 0x66b5 0x95db 0xb11 0x68b9 0x95a9 0xb24 0x6abc 0x957b 0xb31 0x6cc0 0x954a 0xb28 0x6ec4 0x951f 0xb3b 0x70c7 0x94f4 0xb3b 0x72cb 0x94d2 0xb4f 0x74ce 0x94af 0xb65 0x76d2 0x948d 0xb7a 0x78d5 0x946a 0xb90 0x7ad9 0x9448 0xb9f 0x7cdc 0x9426 0xb9f 0x7ee0 0x9403 0xb9f 0x80e4 0x93f1 0xbb4 0x82e7 0x93d9 0xbb8 0x84eb 0x93c5 0xbc6 0x86ee 0x93b4 0xbf9 0x88f2 0x93a0 0xc35 0x8af5 0x9388 0xc3e 0x8cf9 0x9376 0xc7f 0x8efc 0x935d 0xcaa 0x9100 0x933c 0xcd5 0x9304 0x931a 0xd0e 0x9507 0x92f3 0xd4e 0x970b 0x92c8 0xd96 0x990e 0x929c 0xde8 0x9b12 0x9268 0xe29 0x9d15 0x922c 0xe94 0x9f19 0x91e9 0xeff 0xa11c 0x91a4 0xf79 0xa320 0x9160 0xff9 0xa524 0x9114 0x1078 0xa727 0x90b6 0x1100 0xa92b 0x9061 0x11ac 0xab2e 0x9035 0x1282 0xad32 0x9011 0x137d 0xaf35 0x8ff5 0x14c6 0xb139 0x8fd7 0x165f 0xb33c 0x8fac 0x1855 0xb540 0x8f62 0x1ae3 0xb744 0x8ed6 0x1e6c 0xb947 0x8d42 0x231f 0xbb4b 0x8ae9 0x2c4c 0xbd4e 0x87f8 0x3876 0xbf52 0x8583 0x3c70 0xc155 0x83b9 0x3800 0xc359 0x815f 0x3254 0xc55c 0x7d3c 0x27a6 0xc760 0x7d3c 0x27a6>;
			battery1_profile_t4_num = <0x64>;
			battery1_profile_t4 = <0x00 0xaa82 0x7d0 0x204 0xa9f9 0x1898 0x407 0xa96f 0x1b6a 0x60b 0xa8eb 0x1b63 0x80e 0xa86a 0x1b4d 0xa12 0xa7ed 0x1b38 0xc15 0xa773 0x1b1a 0xe19 0xa6f2 0x1adb 0x101c 0xa67a 0x1ac5 0x1220 0xa5fa 0x1a8b 0x1424 0xa57f 0x1a4b 0x1627 0xa507 0x1a2c 0x182b 0xa485 0x1b0e 0x1a2e 0xa3fa 0x1c7f 0x1c32 0xa38c 0x19fa 0x1e35 0xa321 0x19e6 0x2039 0xa2b2 0x19d2 0x223c 0xa23e 0x19bc 0x2440 0xa1c9 0x19a7 0x2644 0xa157 0x198c 0x2847 0xa0df 0x1963 0x2a4b 0xa070 0x194d 0x2c4e 0xa000 0x194b 0x2e52 0x9f96 0x195b 0x3055 0x9f2a 0x1958 0x3259 0x9ebb 0x1942 0x345c 0x9e49 0x192d 0x3660 0x9dd1 0x1917 0x3864 0x9d5a 0x1902 0x3a67 0x9cea 0x18ed 0x3c6b 0x9c7a 0x18c8 0x3e6e 0x9c0b 0x18a9 0x4072 0x9b9b 0x188b 0x4275 0x9b2b 0x185b 0x4479 0x9abc 0x181d 0x467c 0x9a55 0x1808 0x4880 0x99ee 0x1806 0x4a84 0x9987 0x17e6 0x4c87 0x9920 0x17bb 0x4e8b 0x98bc 0x17a2 0x508e 0x9860 0x179c 0x5292 0x980a 0x1789 0x5495 0x97b4 0x1789 0x5699 0x9766 0x1789 0x589c 0x9719 0x1789 0x5aa0 0x96d1 0x1789 0x5ca4 0x9690 0x1792 0x5ea7 0x9654 0x17a8 0x60ab 0x9617 0x17bd 0x62ae 0x95db 0x17d3 0x64b2 0x95a7 0x17fd 0x66b5 0x9574 0x1817 0x68b9 0x9545 0x182c 0x6abc 0x951a 0x184c 0x6cc0 0x94f0 0x1870 0x6ec4 0x94c5 0x1885 0x70c7 0x949a 0x189b 0x72cb 0x9478 0x18b0 0x74ce 0x945c 0x18e7 0x76d2 0x9442 0x1928 0x78d5 0x942c 0x1972 0x7ad9 0x9419 0x19c8 0x7cdc 0x9400 0x1a20 0x7ee0 0x93ef 0x1a8c 0x80e4 0x93d5 0x1b0c 0x82e7 0x93c2 0x1baf 0x84eb 0x93ac 0x1c69 0x86ee 0x9392 0x1d34 0x88f2 0x9378 0x1e11 0x8af5 0x935e 0x1f01 0x8cf9 0x9345 0x2002 0x8efc 0x9322 0x20ef 0x9100 0x9300 0x21dc 0x9304 0x92de 0x22e4 0x9507 0x92b7 0x23fb 0x970b 0x9289 0x250b 0x990e 0x9256 0x2614 0x9b12 0x9222 0x2741 0x9d15 0x91ef 0x2883 0x9f19 0x91ad 0x29c5 0xa11c 0x916e 0x2b32 0xa320 0x912a 0x2cd2 0xa524 0x90dd 0x2e97 0xa727 0x9091 0x3073 0xa92b 0x904c 0x3261 0xab2e 0x9019 0x347a 0xad32 0x8fec 0x365d 0xaf35 0x8fcd 0x3827 0xb139 0x8faa 0x39ca 0xb33c 0x8f7d 0x3b63 0xb540 0x8f3c 0x3d69 0xb744 0x8eb8 0x40b8 0xb947 0x8d58 0x472e 0xbb4b 0x8c1c 0x4ade 0xbd4e 0x8b27 0x4a8f 0xbf52 0x8a0b 0x47f1 0xc155 0x8800 0x42d7 0xc359 0x86d8 0x3fc5 0xc55c 0x86d8 0x3fc5 0xc760 0x86d8 0x3fc5>;
			battery2_profile_t0_num = <0x64>;
			battery2_profile_t0 = <0x00 0xaa32 0x33e 0x202 0xa9ba 0x33a 0x403 0xa942 0x339 0x605 0xa8ca 0x339 0x807 0xa853 0x344 0xa08 0xa7db 0x352 0xc0a 0xa762 0x34f 0xe0b 0xa6e1 0x339 0x100d 0xa669 0x34e 0x120f 0xa5ea 0x352 0x1410 0xa570 0x352 0x1612 0xa4f8 0x352 0x1814 0xa47d 0x34b 0x1a15 0xa3fe 0x33c 0x1c17 0xa388 0x351 0x1e19 0xa311 0x352 0x201a 0xa299 0x352 0x221c 0xa221 0x352 0x241d 0xa1ad 0x35c 0x261f 0xa13e 0x36b 0x2821 0xa0ce 0x36e 0x2a22 0xa05f 0x383 0x2c24 0x9ff0 0x384 0x2e26 0x9f81 0x373 0x3027 0x9f17 0x378 0x3229 0x9eb0 0x384 0x342b 0x9e49 0x384 0x362c 0x9de2 0x384 0x382e 0x9d7c 0x384 0x3a2f 0x9d1d 0x398 0x3c31 0x9cbf 0x39d 0x3e33 0x9c61 0x39d 0x4034 0x9c06 0x3a6 0x4236 0x9bb1 0x3b6 0x4438 0x9b5b 0x3b6 0x4639 0x9b05 0x3b6 0x483b 0x9ab8 0x3de 0x4a3d 0x9a64 0x3f8 0x4c3e 0x9a0a 0x40e 0x4e40 0x9995 0x3fe 0x5041 0x9900 0x3b9 0x5243 0x9864 0x36b 0x5445 0x97fd 0x36b 0x5646 0x97ae 0x36b 0x5848 0x9767 0x36b 0x5a4a 0x9728 0x36b 0x5c4b 0x96ec 0x36b 0x5e4d 0x96b0 0x366 0x604f 0x9675 0x352 0x6250 0x9641 0x352 0x6452 0x960e 0x352 0x6653 0x95e1 0x362 0x6855 0x95b1 0x35f 0x6a57 0x9581 0x35a 0x6c58 0x9556 0x36b 0x6e5a 0x952c 0x36c 0x705c 0x950a 0x382 0x725d 0x94e0 0x371 0x745f 0x94bb 0x36b 0x7661 0x9499 0x377 0x7862 0x9477 0x384 0x7a64 0x9456 0x389 0x7c65 0x943c 0x39c 0x7e67 0x941a 0x387 0x8069 0x93ff 0x397 0x826a 0x93e0 0x3ac 0x846c 0x93a6 0x39f 0x866e 0x9356 0x374 0x886f 0x9308 0x356 0x8a71 0x92d5 0x36b 0x8c73 0x92aa 0x381 0x8e74 0x9278 0x372 0x9076 0x924b 0x36b 0x9277 0x9220 0x36b 0x9479 0x91f8 0x372 0x967b 0x91d4 0x384 0x987c 0x91a9 0x384 0x9a7e 0x9176 0x384 0x9c80 0x913b 0x384 0x9e81 0x90fa 0x376 0xa083 0x90ba 0x376 0xa285 0x9078 0x384 0xa486 0x902b 0x379 0xa688 0x8fde 0x339 0xa889 0x8fd5 0x364 0xaa8b 0x8fc6 0x36b 0xac8d 0x8fba 0x396 0xae8e 0x8fa9 0x3d6 0xb090 0x8f7f 0x408 0xb292 0x8f0c 0x409 0xb493 0x8dd8 0x39e 0xb695 0x8bf9 0x3c8 0xb897 0x8985 0x404 0xba98 0x862d 0x46f 0xbc9a 0x80e5 0x64d 0xbe9b 0x7a4d 0xb6d 0xc09d 0x74e7 0x12e7 0xc29f 0x7310 0xe38 0xc4a0 0x706c 0x7e9 0xc6a2 0x706c 0x7e9>;
			battery2_profile_t1_num = <0x64>;
			battery2_profile_t1 = <0x00 0xaaa0 0x41a 0x202 0xaa28 0x405 0x403 0xa9b7 0x401 0x605 0xa948 0x40f 0x807 0xa8d5 0x40f 0xa08 0xa85d 0x408 0xc0a 0xa7e5 0x41a 0xe0b 0xa76d 0x41a 0x100d 0xa6ed 0x405 0x120f 0xa673 0x413 0x1410 0xa5f6 0x40c 0x1612 0xa57a 0x401 0x1814 0xa502 0x408 0x1a15 0xa48a 0x41a 0x1c17 0xa414 0x41a 0x1e19 0xa394 0x405 0x201a 0xa322 0x423 0x221c 0xa2ad 0x426 0x241d 0xa235 0x41a 0x261f 0xa1bd 0x41a 0x2821 0xa146 0x41d 0x2a22 0xa0d7 0x432 0x2c24 0xa068 0x433 0x2e26 0x9ff9 0x433 0x3027 0x9f8f 0x440 0x3229 0x9f28 0x456 0x342b 0x9ec1 0x465 0x362c 0x9e5a 0x465 0x382e 0x9df4 0x465 0x3a2f 0x9d8d 0x479 0x3c31 0x9d2d 0x47e 0x3e33 0x9ccf 0x48b 0x4034 0x9c74 0x4a0 0x4236 0x9c1c 0x4b6 0x4438 0x9bc0 0x4cd 0x4639 0x9b73 0x4f8 0x483b 0x9b1e 0x50f 0x4a3d 0x9ac8 0x524 0x4c3e 0x9a6e 0x53a 0x4e40 0x9a04 0x534 0x5041 0x9984 0x4f8 0x5243 0x98ee 0x492 0x5445 0x9865 0x452 0x5646 0x97fb 0x425 0x5848 0x97a7 0x41a 0x5a4a 0x975f 0x41a 0x5c4b 0x971e 0x411 0x5e4d 0x96e2 0x401 0x604f 0x96a6 0x401 0x6250 0x966a 0x401 0x6452 0x963e 0x414 0x6653 0x960c 0x40a 0x6855 0x95d9 0x401 0x6a57 0x95a9 0x401 0x6c58 0x957e 0x401 0x6e5a 0x9554 0x402 0x705c 0x9532 0x418 0x725d 0x9508 0x41a 0x745f 0x94e9 0x429 0x7661 0x94c6 0x427 0x7862 0x94a2 0x42b 0x7a64 0x9487 0x447 0x7c65 0x9465 0x434 0x7e67 0x944b 0x449 0x8069 0x9431 0x44c 0x826a 0x9418 0x46b 0x846c 0x93f9 0x467 0x866e 0x93d7 0x44c 0x886f 0x93b4 0x448 0x8a71 0x9389 0x433 0x8c73 0x935e 0x41d 0x8e74 0x9333 0x408 0x9076 0x9309 0x410 0x9277 0x92de 0x41a 0x9479 0x92b3 0x413 0x967b 0x928a 0x401 0x987c 0x9268 0x401 0x9a7e 0x9245 0x417 0x9c80 0x9215 0x41a 0x9e81 0x91d6 0x40c 0xa083 0x9191 0x401 0xa285 0x9153 0x408 0xa486 0x9119 0x41a 0xa688 0x90c4 0x41a 0xa889 0x9077 0x405 0xaa8b 0x905c 0x401 0xac8d 0x9050 0x41e 0xae8e 0x9043 0x433 0xb090 0x9030 0x441 0xb292 0x9012 0x46f 0xb493 0x8fde 0x4b0 0xb695 0x8edf 0x470 0xb897 0x8d26 0x488 0xba98 0x8ad0 0x4cf 0xbc9a 0x87a1 0x543 0xbe9b 0x82a9 0x728 0xc09d 0x7b55 0xc87 0xc29f 0x75eb 0x14b8 0xc4a0 0x7450 0x115c 0xc6a2 0x7206 0xbb8>;
			battery2_profile_t2_num = <0x64>;
			battery2_profile_t2 = <0x00 0xaab4 0x5dc 0x202 0xaa3c 0x5dc 0x403 0xa9cb 0x5dc 0x605 0xa956 0x5dc 0x807 0xa8e3 0x5e7 0xa08 0xa871 0x5ee 0xc0a 0xa7f8 0x5dc 0xe0b 0xa777 0x5dc 0x100d 0xa6ff 0x5dc 0x120f 0xa680 0x5dc 0x1410 0xa606 0x5dc 0x1612 0xa58a 0x5dc 0x1814 0xa50c 0x5dc 0x1a15 0xa493 0x5d9 0x1c17 0xa415 0x5c4 0x1e19 0xa3a5 0x5ec 0x201a 0xa32f 0x5f5 0x221c 0xa2b7 0x5f5 0x241d 0xa23f 0x5f5 0x261f 0xa1c7 0x5f5 0x2821 0xa150 0x5f8 0x2a22 0xa0e1 0x60d 0x2c24 0xa072 0x60e 0x2e26 0xa003 0x61f 0x3027 0x9f99 0x634 0x3229 0x9f2e 0x636 0x342b 0x9ec4 0x639 0x362c 0x9e63 0x672 0x382e 0x9df4 0x672 0x3a2f 0x9d8d 0x686 0x3c31 0x9d26 0x68b 0x3e33 0x9cbf 0x68b 0x4034 0x9c60 0x69e 0x4236 0x9c0b 0x6c3 0x4438 0x9bb5 0x6d8 0x4639 0x9b5f 0x6ee 0x483b 0x9b0a 0x717 0x4a3d 0x9aae 0x721 0x4c3e 0x9a50 0x72e 0x4e40 0x99df 0x715 0x5041 0x9954 0x6b4 0x5243 0x98c5 0x63a 0x5445 0x984d 0x5fa 0x5646 0x97e6 0x5e1 0x5848 0x9793 0x5cc 0x5a4a 0x9746 0x5b7 0x5c4b 0x9700 0x5aa 0x5e4d 0x96c4 0x5aa 0x604f 0x9688 0x5aa 0x6250 0x964c 0x5aa 0x6452 0x9618 0x5aa 0x6653 0x95e4 0x5aa 0x6855 0x95b6 0x5aa 0x6a57 0x958b 0x5b2 0x6c58 0x9560 0x5c3 0x6e5a 0x9536 0x5c3 0x705c 0x950b 0x5c3 0x725d 0x94e8 0x5d6 0x745f 0x94c5 0x5dc 0x7661 0x94a3 0x5dc 0x7862 0x9481 0x5dc 0x7a64 0x9460 0x5e1 0x7c65 0x9446 0x5f5 0x7e67 0x9424 0x5f5 0x8069 0x9409 0x5f5 0x826a 0x93f0 0x5f5 0x846c 0x93db 0x601 0x866e 0x93c6 0x60e 0x886f 0x93ad 0x60a 0x8a71 0x9393 0x5f6 0x8c73 0x9382 0x60b 0x8e74 0x9362 0x5fb 0x9076 0x933a 0x5e6 0x9277 0x930f 0x5dc 0x9479 0x92e5 0x5dc 0x967b 0x92bc 0x5e0 0x987c 0x9299 0x5f5 0x9a7e 0x926f 0x5f5 0x9c80 0x9235 0x5f5 0x9e81 0x91f4 0x603 0xa083 0x91b4 0x619 0xa285 0x9175 0x627 0xa486 0x912d 0x62e 0xa688 0x90d8 0x659 0xa889 0x908b 0x659 0xaa8b 0x9061 0x67d 0xac8d 0x904b 0x6a8 0xae8e 0x9035 0x6dd 0xb090 0x9019 0x724 0xb292 0x8ff1 0x788 0xb493 0x8fac 0x833 0xb695 0x8eb5 0x933 0xb897 0x8cda 0xb09 0xba98 0x8a38 0x109e 0xbc9a 0x8657 0x217c 0xbe9b 0x8266 0x32a6 0xc09d 0x8079 0x2fc4 0xc29f 0x7f2b 0x2cac 0xc4a0 0x7c1a 0x251c 0xc6a2 0x7c1a 0x251c>;
			battery2_profile_t3_num = <0x64>;
			battery2_profile_t3 = <0x00 0xaab4 0x8b6 0x202 0xaa45 0x8dd 0x403 0xa9ce 0x8d1 0x605 0xa956 0x8ca 0x807 0xa8e3 0x8d5 0xa08 0xa871 0x8e3 0xc0a 0xa7f8 0x8e0 0xe0b 0xa777 0x8ca 0x100d 0xa6ff 0x8b5 0x120f 0xa680 0x8b1 0x1410 0xa606 0x8b1 0x1612 0xa58e 0x8b1 0x1814 0xa513 0x8b1 0x1a15 0xa493 0x8ae 0x1c17 0xa415 0x899 0x1e19 0xa3a5 0x8ad 0x201a 0xa32f 0x8b1 0x221c 0xa2b2 0x8a4 0x241d 0xa239 0x8a2 0x261f 0xa1c7 0x8b1 0x2821 0xa150 0x8b4 0x2a22 0xa0e1 0x8c9 0x2c24 0xa072 0x8de 0x2e26 0xa003 0x8e3 0x3027 0x9f99 0x8f0 0x3229 0x9f32 0x906 0x342b 0x9ecb 0x921 0x362c 0x9e63 0x949 0x382e 0x9df4 0x95f 0x3a2f 0x9d85 0x974 0x3c31 0x9d16 0x968 0x3e33 0x9cab 0x96d 0x4034 0x9c49 0x979 0x4236 0x9bed 0x97f 0x4438 0x9b97 0x994 0x4639 0x9b41 0x9aa 0x483b 0x9ae4 0x9ab 0x4a3d 0x9a7f 0x99b 0x4c3e 0x9a0e 0x978 0x4e40 0x9993 0x93b 0x5041 0x9913 0x8eb 0x5243 0x9896 0x8ac 0x5445 0x9826 0x86c 0x5646 0x97c7 0x83f 0x5848 0x976f 0x834 0x5a4a 0x9723 0x834 0x5c4b 0x96e2 0x834 0x5e4d 0x96a6 0x834 0x604f 0x966a 0x834 0x6250 0x962e 0x834 0x6452 0x95fa 0x834 0x6653 0x95c6 0x834 0x6855 0x9598 0x840 0x6a57 0x956a 0x845 0x6c58 0x953a 0x83e 0x6e5a 0x9518 0x866 0x705c 0x94ed 0x866 0x725d 0x94ca 0x879 0x745f 0x94a1 0x870 0x7661 0x947b 0x872 0x7862 0x945c 0x887 0x7a64 0x9441 0x898 0x7c65 0x941f 0x899 0x7e67 0x9405 0x8ae 0x8069 0x93f3 0x8b1 0x826a 0x93dc 0x8b1 0x846c 0x93cb 0x8c8 0x866e 0x93c0 0x8e3 0x886f 0x93af 0x8e7 0x8a71 0x939e 0x8fd 0x8c73 0x938d 0x928 0x8e74 0x9374 0x92e 0x9076 0x9355 0x93d 0x9277 0x932e 0x947 0x9479 0x9300 0x947 0x967b 0x92d0 0x956 0x987c 0x92ad 0x9ac 0x9a7e 0x927a 0x9d6 0x9c80 0x9238 0xa13 0x9e81 0x91f4 0xa62 0xa083 0x91ab 0xaad 0xa285 0x9161 0xafb 0xa486 0x9118 0xb6e 0xa688 0x90ba 0xc04 0xa889 0x9064 0xc99 0xaa8b 0x9032 0xd53 0xac8d 0x900d 0xe86 0xae8e 0x8fe7 0x1012 0xb090 0x8fb9 0x122f 0xb292 0x8f7f 0x1585 0xb493 0x8f21 0x1a89 0xb695 0x8e10 0x255f 0xb897 0x8bf8 0x3676 0xba98 0x8944 0x3fc5 0xbc9a 0x86cc 0x3f9d 0xbe9b 0x8448 0x394d 0xc09d 0x7b52 0x22f6 0xc29f 0x7972 0x1e5f 0xc4a0 0x7972 0x1e5f 0xc6a2 0x7972 0x1e5f>;
			battery2_profile_t4_num = <0x64>;
			battery2_profile_t4 = <0x00 0xaaa0 0xf3c 0x202 0xaa20 0xf67 0x403 0xa9a6 0xf6e 0x605 0xa92e 0xf6e 0x807 0xa8b7 0xf63 0xa08 0xa83f 0xf55 0xc0a 0xa7c7 0xf4e 0xe0b 0xa74f 0xf23 0x100d 0xa6cf 0xf23 0x120f 0xa655 0xf23 0x1410 0xa5d8 0xf07 0x1612 0xa55c 0xef1 0x1814 0xa4e4 0xef1 0x1a15 0xa46b 0xeeb 0x1c17 0xa3ed 0xec1 0x1e19 0xa375 0xebf 0x201a 0xa304 0xed0 0x221c 0xa28f 0xed8 0x241d 0xa217 0xed8 0x261f 0xa1a2 0xede 0x2821 0xa131 0xeee 0x2a22 0xa0ba 0xed9 0x2c24 0xa04a 0xed8 0x2e26 0x9fe1 0xefa 0x3027 0x9f7b 0xf17 0x3229 0x9f10 0xf36 0x342b 0x9ea1 0xf5b 0x362c 0x9e30 0xf6e 0x382e 0x9db9 0xf6e 0x3a2f 0x9d41 0xf46 0x3c31 0x9cd6 0xf4d 0x3e33 0x9c6a 0xf55 0x4034 0x9bff 0xf4c 0x4236 0x9b98 0xf3c 0x4438 0x9b32 0xf3c 0x4639 0x9ad4 0xf3c 0x483b 0x9a66 0xf14 0x4a3d 0x99f7 0xefa 0x4c3e 0x9982 0xebe 0x4e40 0x990e 0xe7b 0x5041 0x98a1 0xe50 0x5243 0x983d 0xe27 0x5445 0x97df 0xe12 0x5646 0x9788 0xde9 0x5848 0x9739 0xdee 0x5a4a 0x96f1 0xe03 0x5c4b 0x96ac 0xdff 0x5e4d 0x966a 0xde8 0x604f 0x962e 0xe10 0x6250 0x95f2 0xe10 0x6452 0x95c6 0xe4a 0x6653 0x958e 0xe3c 0x6855 0x955c 0xe41 0x6a57 0x9531 0xe63 0x6c58 0x9506 0xe79 0x6e5a 0x94dc 0xe90 0x705c 0x94ba 0xeba 0x725d 0x9498 0xed2 0x745f 0x9475 0xee7 0x7661 0x9453 0xefd 0x7862 0x9434 0xf0a 0x7a64 0x941c 0xf1d 0x7c65 0x940b 0xf6f 0x7e67 0x93fa 0xf84 0x8069 0x93e9 0xfad 0x826a 0x93de 0xfe7 0x846c 0x93d1 0x1027 0x866e 0x93c0 0x1067 0x886f 0x93af 0x10aa 0x8a71 0x939e 0x1100 0x8c73 0x938d 0x1155 0x8e74 0x936d 0x11ab 0x9076 0x934b 0x121e 0x9277 0x9328 0x129e 0x9479 0x9300 0x131f 0x967b 0x92cd 0x13a7 0x987c 0x9299 0x1452 0x9a7e 0x925d 0x14fd 0x9c80 0x921a 0x15cd 0x9e81 0x91d0 0x1694 0xa083 0x9187 0x178b 0xa285 0x9140 0x18c5 0xa486 0x90ee 0x1a1c 0xa688 0x9088 0x1b73 0xa889 0x903b 0x1d74 0xaa8b 0x9003 0x1fac 0xac8d 0x8fd5 0x22c4 0xae8e 0x8fa6 0x2727 0xb090 0x8f73 0x2df8 0xb292 0x8f37 0x3853 0xb493 0x8ed1 0x44c8 0xb695 0x8dea 0x4f3e 0xb897 0x8d26 0x4f77 0xba98 0x8c48 0x4d55 0xbc9a 0x8a67 0x48ac 0xbe9b 0x7d6e 0x283c 0xc09d 0x7d6e 0x283c 0xc29f 0x7d6e 0x283c 0xc4a0 0x7d6e 0x283c 0xc6a2 0x7d6e 0x283c>;
		};
	};

	fragment@18 {
		target = <0xffffffff>;

		__overlay__ {

			fingerprint_sensor@0 {
				compatible = "mediatek,mtk_finger";
				reg = <0x00>;
				spi-max-frequency = "\0I>";
				interrupt-parent = <0xffffffff>;
				interrupts = <0x05 0x08 0x05 0x00>;
				fingerprint_eint_gpio = <0xffffffff 0x05 0x00>;
				fingerprint,navigation_adjust1 = <0x00>;
				pinctrl-names = "fingerprint_spi_default\0fingerprint_spi_cs_low\0fingerprint_spi_cs_high\0fingerprint_spi_miso_low\0fingerprint_spi_miso_high\0fingerprint_spi_mosi_low\0fingerprint_spi_mosi_high\0fingerprint_spi_mclk_low\0fingerprint_spi_mclk_high\0fingerprint_rst_low\0fingerprint_rst_high\0fingerprint_power_low\0fingerprint_power_high\0fingerprint_eint_as_int\0fingerprint_eint_in_low\0fingerprint_eint_in_float";
				pinctrl-0 = <0x14>;
				pinctrl-1 = <0x15>;
				pinctrl-2 = <0x16>;
				pinctrl-3 = <0x17>;
				pinctrl-4 = <0x18>;
				pinctrl-5 = <0x19>;
				pinctrl-6 = <0x1a>;
				pinctrl-7 = <0x1b>;
				pinctrl-8 = <0x1c>;
				pinctrl-9 = <0x1d>;
				pinctrl-10 = <0x1e>;
				pinctrl-11 = <0x1f>;
				pinctrl-12 = <0x20>;
				pinctrl-13 = <0x21>;
				pinctrl-14 = <0x22>;
				pinctrl-15 = <0x23>;
				status = "okay";
			};
		};
	};

	fragment@19 {
		target = <0xffffffff>;

		__overlay__ {

			fingerprint_spi_default {
				phandle = <0x14>;
			};

			fingerprint_spi_cs_low {
				phandle = <0x15>;

				pins_cmd_dat {
					pinmux = <0x9c01>;
					slew-rate = <0x01>;
					output-low;
				};
			};

			fingerprint_spi_cs_high {
				phandle = <0x16>;

				pins_cmd_dat {
					pinmux = <0x9c01>;
					slew-rate = <0x01>;
					output-high;
				};
			};

			fingerprint_spi_miso_low {
				phandle = <0x17>;

				pins_cmd_dat {
					pinmux = <0x9b01>;
					slew-rate = <0x00>;
					bias-pull-up = <0x00>;
				};
			};

			fingerprint_spi_miso_high {
				phandle = <0x18>;

				pins_cmd_dat {
					pinmux = <0x9b01>;
					bias-disable;
				};
			};

			fingerprint_spi_mosi_low {
				phandle = <0x19>;

				pins_cmd_dat {
					pinmux = <0x9d01>;
					slew-rate = <0x01>;
					output-low;
				};
			};

			fingerprint_spi_mosi_high {
				phandle = <0x1a>;

				pins_cmd_dat {
					pinmux = <0x9d01>;
					slew-rate = <0x01>;
					output-high;
				};
			};

			fingerprint_spi_mclk_low {
				phandle = <0x1b>;

				pins_cmd_dat {
					pinmux = <0x9e01>;
					slew-rate = <0x01>;
					output-low;
				};
			};

			fingerprint_spi_mclk_high {
				phandle = <0x1c>;

				pins_cmd_dat {
					pinmux = <0x9e01>;
					slew-rate = <0x01>;
					output-high;
				};
			};

			fingerprint_rst_low {
				phandle = <0x1d>;

				pins_cmd_dat {
					pinmux = <0xab00>;
					slew-rate = <0x01>;
					output-low;
				};
			};

			fingerprint_rst_high {
				phandle = <0x1e>;

				pins_cmd_dat {
					pinmux = <0xab00>;
					slew-rate = <0x01>;
					output-high;
				};
			};

			fingerprint_power_low {
				phandle = <0x1f>;
			};

			fingerprint_power_high {
				phandle = <0x20>;
			};

			fingerprint_eint_as_int {
				phandle = <0x21>;

				pins_cmd_dat {
					pinmux = <0x500>;
					slew-rate = <0x00>;
					bias-disable;
				};
			};

			fingerprint_eint_in_low {
				phandle = <0x22>;

				pins_cmd_dat {
					pinmux = <0x500>;
					slew-rate = <0x00>;
					bias-pull-down = <0x00>;
				};
			};

			fingerprint_eint_in_float {
				phandle = <0x23>;

				pins_cmd_dat {
					pinmux = <0x500>;
					slew-rate = <0x00>;
					bias-disable;
				};
			};
		};
	};

	fragment@20 {
		target = <0xffffffff>;

		__overlay__ {
			compatible = "huawei,huawei_wifi_info";
			status = "okay";
			ini_type = "DUA_LX9N";
			wifi_chiptype = "WIFI_MTK_6631";
			power_limit = "DRA";
		};
	};

	fragment@21 {
		target = <0xffffffff>;

		__overlay__ {

			lcd_kit_pkn_auo_otm1901a_5p2_1080p_video_default {
				compatible = "auo_otm1901a_5p2_1080p_video_default";
				lcd-kit,panel-name = "AUO_OTM1901A 5.2' VIDEO TFT 1080 x 1920 DEFAULT";
				lcd-kit,panel-type = <0x01>;
				lcd-kit,panel-xres = <0x2d0>;
				lcd-kit,panel-yres = <0x640>;
				lcd-kit,panel-width = <0x41>;
				lcd-kit,panel-height = <0x8c>;
				lcd-kit,panel-on-cmds = <0x29 0x01 0x00 0x00 0x0a 0x00 0x02 0x00 0x00 0x29 0x01 0x00 0x00 0x0a 0x00 0x04 0xff 0x19 0x01 0x01 0x29 0x01 0x00 0x00 0x0a 0x00 0x02 0x00 0x80 0x29 0x01 0x00 0x00 0x0a 0x00 0x03 0xff 0x19 0x01 0x29 0x01 0x00 0x00 0x0a 0x00 0x02 0x00 0x88 0x29 0x01 0x00 0x00 0x0a 0x00 0x02 0xf3 0x00 0x29 0x01 0x00 0x00 0x0a 0x00 0x02 0x00 0xb0 0x29 0x01 0x00 0x00 0x0a 0x00 0x02 0xca 0x01 0x29 0x01 0x00 0x00 0x0a 0x00 0x02 0x00 0xb1 0x29 0x01 0x00 0x00 0x0a 0x00 0x02 0xca 0x01 0x29 0x01 0x00 0x00 0x0a 0x00 0x02 0x00 0xb3 0x29 0x01 0x00 0x00 0x0a 0x00 0x02 0xca 0x40 0x29 0x01 0x00 0x00 0x0a 0x00 0x02 0x00 0x00 0x29 0x01 0x00 0x00 0x0a 0x00 0x04 0xff 0xff 0xff 0xff 0x15 0x01 0x00 0x00 0x0a 0x00 0x02 0x35 0x01 0x15 0x01 0x00 0x00 0x0a 0x00 0x02 0x53 0x24 0x15 0x01 0x00 0x00 0x0a 0x00 0x02 0x55 0x00 0x15 0x01 0x00 0x00 0x0a 0x00 0x02 0x5e 0x28 0x05 0x01 0x00 0x00 0x78 0x01 0x02 0x11 0x00 0x05 0x01 0x00 0x00 0x64 0x01 0x02 0x29 0x00>;
				lcd-kit,panel-off-cmds = <0x05 0x01 0x00 0x00 0x3c 0x01 0x02 0x28 0x00 0x05 0x01 0x00 0x00 0x78 0x01 0x02 0x10 0x00>;
				lcd-kit,backlight-cmds = <0x15 0x01 0x00 0x00 0x00 0x00 0x02 0x51 0x00>;
				lcd-kit,tp-color-cmds = <0x06 0x01 0x00 0x00 0x0a 0x00 0x01 0xda>;
				lcd-kit,effect-on-cmds = <0x15 0x01 0x00 0x00 0x0a 0x00 0x02 0x55 0x81>;
				lcd-kit,panel-bl-maxnit-command = <0x06 0x01 0x00 0x00 0x0a 0x00 0x01 0xdb>;
				lcd-kit,panel-bl-maxnit-command-state = "dsi_lp_mode";
				lcd-kit,panel-lcm-type = <0x02>;
				lcd-kit,panel-ldi-dsi-mode = <0x01>;
				lcd-kit,panel-dsi-switch-mode = <0x00>;
				lcd-kit,panel-dsi-switch-mode-en = <0x00>;
				lcd-kit,panel-ldi-trans-seq = <0x00>;
				lcd-kit,panel-ldi-data-padding = <0x00>;
				lcd-kit,panel-ldi-packet-size = <0x100>;
				lcd-kit,panel-ldi-ps = <0x02>;
				lcd-kit,panel-vfp-lp = <0x00>;
				lcd-kit,panel-fbk-div = <0x01>;
				lcd-kit,panel-orientation = <0x01>;
				lcd-kit,panel-bpp = <0x02>;
				lcd-kit,panel-bgr-fmt = <0x00>;
				lcd-kit,panel-cmd-type = <0x08>;
				lcd-kit,panel-pxl-clk = <0x00>;
				lcd-kit,panel-pxl-clk-div = <0x00>;
				lcd-kit,panel-data-rate = <0x29d>;
				lcd-kit,mipi-lane-nums = <0x03>;
				lcd-kit,h-back-porch = <0x28>;
				lcd-kit,h-front-porch = <0x3c>;
				lcd-kit,h-pulse-width = <0x08>;
				lcd-kit,project-id-support = <0x01>;
				lcd-kit,default-project-id = "Y1639J1700";
				lcd-kit,v-back-porch = <0x14>;
				lcd-kit,v-front-porch = <0x0c>;
				lcd-kit,v-pulse-width = <0x04>;
				lcd-kit,mipi-clk-post-adjust = <0x00>;
				lcd-kit,mipi-lp11-flag = <0x00>;
				lcd-kit,esd-support = <0x00>;
				lcd-kit,tp-color-support = <0x01>;
				lcd-kit,lcd-vsp = <0x02 0x96 0x5b8d80>;
				lcd-kit,lcd-vsn = <0x02 0x97 0x5b8d80>;
				lcd-kit,lcd-reset = <0x02 0x2d 0x00>;
				lcd-kit,power-on-stage = <0x05 0x00 0x02 0x07 0x01 0x00 0x03 0x01 0x03 0x04 0x01 0x0a 0x05 0x01 0x02 0x05 0x00 0x02 0x05 0x01 0x0c 0x06 0x01 0x00 0x08 0x01 0x00>;
				lcd-kit,lp-on-stage = <0x00 0x00 0x00>;
				lcd-kit,hs-on-stage = <0x00 0x00 0x00>;
				lcd-kit,hs-off-stage = <0x00 0x00 0x00>;
				lcd-kit,lp-off-stage = <0x00 0x00 0x00>;
				lcd-kit,power-off-stage = <0x07 0x00 0x00 0x06 0x00 0x00 0x08 0x00 0x00 0x05 0x00 0x02 0x04 0x00 0x00 0x03 0x00 0x05>;
				lcd-kit,pt-support = <0x01>;
				lcd-kit,panel-density = <0x140>;
				lcd-kit,ssc-disable = <0x01>;
				lcd-kit,inversion-support = <0x00>;
				lcd-kit,check-reg-support = <0x00>;
				lcd-kit,panel-bl-min = <0x1e>;
				lcd-kit,panel-bl-max = <0x20d0>;
				lcd-kit,panel-bl-max-nit = <0x1c2>;
				lcd-kit,mipi-non-continue-enable = <0x00>;
				lcd-kit,panel-getblmaxnit-type = <0x01>;
				lcd-kit,panel-bl-ic-ctrl-type = <0x00>;
				lcd-kit,panel-bias-ic-ctrl-type = <0x00>;
				lcd-kit,panel-gpio-offset = <0x00>;
				phandle = <0x5b>;
			};
		};
	};

	fragment@22 {
		target = <0xffffffff>;

		__overlay__ {

			lcd_kit_pkn_hlt_icnl9911c_6p517 {
				compatible = "hlt_icnl9911c_6p517_hdplus_video";
				lcd-kit,panel-name = "HLT_ICNL9911C 6.517' VIDEO TFT 720 x 1600";
				lcd-kit,panel-type = <0x01>;
				lcd-kit,panel-xres = <0x2d0>;
				lcd-kit,panel-yres = <0x640>;
				lcd-kit,panel-width = <0x46>;
				lcd-kit,panel-height = <0x9c>;
				lcd-kit,panel-on-cmds = <0x39 0x01 0x00 0x00 0x0a 0x00 0x03 0xf0 0x5a 0x59 0x39 0x01 0x00 0x00 0x0a 0x00 0x03 0xf1 0xa5 0xa6 0x39 0x01 0x00 0x00 0x0a 0x00 0x1f 0xb0 0x82 0x81 0x05 0x04 0x87 0x86 0x84 0x85 0x66 0x66 0x33 0x33 0x20 0x01 0x01 0x78 0x01 0x01 0x0f 0x05 0x04 0x03 0x02 0x01 0x02 0x03 0x04 0x00 0x00 0x00 0x39 0x01 0x00 0x00 0x0a 0x00 0x1e 0xb1 0x11 0x42 0x86 0x00 0x01 0x01 0x01 0x66 0x01 0x01 0x04 0x08 0x54 0x00 0x00 0x00 0x44 0x40 0x02 0x01 0x40 0x02 0x01 0x40 0x02 0x01 0x40 0x02 0x01 0x39 0x01 0x00 0x00 0x0a 0x00 0x12 0xb2 0x54 0xc4 0x82 0x05 0x40 0x02 0x01 0x40 0x02 0x01 0x05 0x05 0x54 0x0c 0x0c 0x0d 0x0b 0x39 0x01 0x00 0x00 0x0a 0x00 0x20 0xb3 0x02 0x00 0x00 0x00 0x00 0x26 0x26 0x91 0xa2 0x33 0x44 0x00 0x26 0x00 0x18 0x01 0x02 0x08 0x20 0x30 0x08 0x09 0x44 0x20 0x40 0x20 0x40 0x08 0x09 0x22 0x33 0x39 0x01 0x00 0x00 0x0a 0x00 0x1d 0xb4 0x0a 0x02 0xdc 0x1d 0x00 0x02 0x02 0x02 0x02 0x12 0x10 0x02 0x02 0x0e 0x0c 0x04 0x03 0x03 0x03 0x03 0x03 0x03 0xff 0xff 0xfc 0x00 0x00 0x00 0x39 0x01 0x00 0x00 0x0a 0x00 0x1d 0xb5 0x0b 0x02 0xdc 0x1d 0x00 0x02 0x02 0x02 0x02 0x13 0x11 0x02 0x02 0x0f 0x0d 0x05 0x03 0x03 0x03 0x03 0x03 0x03 0xff 0xff 0xfc 0x00 0x00 0x00 0x39 0x01 0x00 0x00 0x0a 0x00 0x19 0xb8 0x00 0x00 0x00 0x00 0x00 0x00 0x00 0x00 0x00 0x00 0x00 0x00 0x00 0x00 0x00 0x00 0x00 0x00 0x00 0x00 0x00 0x00 0x00 0x00 0x39 0x01 0x00 0x00 0x0a 0x00 0x0e 0xbb 0x01 0x05 0x09 0x11 0x0d 0x19 0x1d 0x55 0x25 0x69 0x00 0x21 0x25 0x39 0x01 0x00 0x00 0x0a 0x00 0x0f 0xbc 0x00 0x00 0x00 0x00 0x02 0x20 0xff 0x00 0x03 0x33 0x01 0x73 0x33 0x00 0x39 0x01 0x00 0x00 0x0a 0x00 0x0b 0xbd 0xe9 0x02 0x4f 0xcf 0x72 0xa4 0x08 0x44 0xae 0x15 0x39 0x01 0x00 0x00 0x0a 0x00 0x0b 0xbe 0x65 0x65 0x50 0x46 0x0c 0x77 0x43 0x07 0x0e 0x0e 0x39 0x01 0x00 0x00 0x0a 0x00 0x09 0xbf 0x07 0x25 0x07 0x25 0x7f 0x00 0x11 0x04 0x39 0x01 0x00 0x00 0x0a 0x00 0x0a 0xc0 0x10 0xff 0xff 0xff 0xff 0xff 0x00 0xff 0x00 0x39 0x01 0x00 0x00 0x0a 0x00 0x14 0xc1 0xc0 0x0c 0x20 0x7c 0x04 0x32 0x32 0x04 0x2a 0x40 0x36 0x00 0x07 0xcf 0xff 0xff 0xc0 0x00 0xc0 0x15 0x01 0x00 0x00 0x0a 0x00 0x02 0xc2 0x00 0x39 0x01 0x00 0x00 0x0a 0x00 0x0a 0xc3 0x06 0x00 0xff 0x00 0xff 0x00 0x00 0x81 0x01 0x39 0x01 0x00 0x00 0x0a 0x00 0x0c 0xc5 0x03 0x1c 0xc0 0xc0 0x40 0x10 0x42 0x44 0x08 0x09 0x14 0x39 0x01 0x00 0x00 0x0a 0x00 0x0b 0xc6 0x87 0x96 0x2a 0x29 0x29 0x31 0x7f 0x34 0x08 0x04 0x39 0x01 0x00 0x00 0x0a 0x00 0x17 0xc7 0xfc 0xb7 0x8f 0x73 0x45 0x25 0xf6 0x4c 0x1c 0xf6 0xcf 0xa3 0xfc 0xd0 0xb2 0x88 0x70 0x4d 0x1a 0x7e 0xc0 0x00 0x39 0x01 0x00 0x00 0x0a 0x00 0x17 0xc8 0xfc 0xb7 0x8f 0x73 0x45 0x25 0xf6 0x4c 0x1c 0xf6 0xcf 0xa3 0xfc 0xd0 0xb2 0x88 0x70 0x4d 0x1a 0x7e 0xc0 0x00 0x15 0x01 0x00 0x00 0x0a 0x00 0x02 0xcb 0x00 0x39 0x01 0x00 0x00 0x0a 0x00 0x06 0xd0 0x80 0x0d 0xff 0x0f 0x61 0x15 0x01 0x00 0x00 0x0a 0x00 0x02 0xd2 0x42 0x39 0x01 0x00 0x00 0x0a 0x00 0x03 0xf1 0x5a 0x59 0x39 0x01 0x00 0x00 0x0a 0x00 0x03 0xf0 0xa5 0xa6 0x15 0x01 0x00 0x00 0x0a 0x00 0x02 0x35 0x00 0x15 0x01 0x00 0x00 0x78 0x01 0x02 0x11 0x00 0x15 0x01 0x00 0x00 0x32 0x01 0x02 0x29 0x00 0x15 0x01 0x00 0x00 0x0a 0x00 0x02 0x26 0x01>;
				lcd-kit,panel-on-cmds-state = "dsi_lp_mode";
				lcd-kit,panel-off-cmds = <0x15 0x01 0x00 0x00 0x0a 0x00 0x02 0x26 0x08 0x15 0x01 0x00 0x00 0x32 0x01 0x02 0x28 0x00 0x05 0x01 0x00 0x00 0x78 0x01 0x02 0x10 0x00>;
				lcd-kit,panel-off-cmds-state = "dsi_lp_mode";
				lcd-kit,backlight-cmds = <0x29 0x01 0x00 0x00 0x00 0x00 0x03 0x51 0xff 0xff>;
				lcd-kit,backlight-cmds-state = "dsi_lp_mode";
				lcd-kit,tp-color-cmds = <0x06 0x01 0x00 0x00 0x0a 0x00 0x01 0xda>;
				lcd-kit,inversion-dot-cmds = <0x29 0x01 0x00 0x00 0x05 0x01 0x04 0xff 0x98 0x81 0x02 0x29 0x01 0x00 0x00 0x0a 0x00 0x02 0x40 0x04 0x29 0x01 0x00 0x00 0x0a 0x00 0x04 0xff 0x98 0x81 0x00>;
				lcd-kit,inversion-column-cmds = <0x29 0x01 0x00 0x00 0x05 0x01 0x04 0xff 0x98 0x81 0x02 0x29 0x01 0x00 0x00 0x0a 0x00 0x02 0x40 0x00 0x29 0x01 0x00 0x00 0x0a 0x00 0x04 0xff 0x98 0x81 0x00>;
				lcd-kit,esd-reg-cmds = <0x06 0x01 0x00 0x00 0x0a 0x00 0x01 0x54 0x06 0x01 0x00 0x00 0x0a 0x00 0x03 0x09 0x00 0x00>;
				lcd-kit,esd-reg-cmds-state = "dsi_lp_mode";
				lcd-kit,esd-value = <0x2c 0x80 0x03 0x06>;
				lcd-kit,check-reg-cmds = <0x06 0x01 0x00 0x00 0x0a 0x00 0x01 0x0a>;
				lcd-kit,check-reg-cmds-state = "dsi_lp_mode";
				lcd-kit,check-reg-value = <0x9c>;
				lcd-kit,barcode-2d-cmds;
				lcd-kit,project-id-cmds;
				lcd-kit,project-id-cmds-state = "dsi_lp_mode";
				lcd-kit,panel-bl-maxnit-command = <0x06 0x01 0x00 0x00 0x0a 0x00 0x01 0xdb>;
				lcd-kit,panel-bl-maxnit-command-state = "dsi_lp_mode";
				lcd-kit,panel-lcm-type = <0x02>;
				lcd-kit,panel-ldi-dsi-mode = <0x01>;
				lcd-kit,panel-dsi-switch-mode = <0x00>;
				lcd-kit,panel-dsi-switch-mode-en = <0x00>;
				lcd-kit,panel-ldi-trans-seq = <0x00>;
				lcd-kit,panel-ldi-data-padding = <0x00>;
				lcd-kit,panel-ldi-packet-size = <0x100>;
				lcd-kit,panel-ldi-ps = <0x02>;
				lcd-kit,panel-vfp-lp = <0x00>;
				lcd-kit,panel-fbk-div = <0x01>;
				lcd-kit,panel-orientation = <0x01>;
				lcd-kit,panel-bpp = <0x02>;
				lcd-kit,panel-bgr-fmt = <0x00>;
				lcd-kit,panel-cmd-type = <0x08>;
				lcd-kit,panel-pxl-clk = <0x00>;
				lcd-kit,panel-pxl-clk-div = <0x00>;
				lcd-kit,panel-data-rate = <0x227>;
				lcd-kit,mipi-lane-nums = <0x04>;
				lcd-kit,h-back-porch = <0x32>;
				lcd-kit,h-front-porch = <0x32>;
				lcd-kit,h-pulse-width = <0x04>;
				lcd-kit,project-id-support = <0x01>;
				lcd-kit,default-project-id = "GPKNAC260";
				lcd-kit,v-back-porch = <0x0c>;
				lcd-kit,v-front-porch = <0x7c>;
				lcd-kit,v-pulse-width = <0x04>;
				lcd-kit,mipi-clk-post-adjust = <0x00>;
				lcd-kit,mipi-lp11-flag = <0x00>;
				lcd-kit,esd-support = <0x00>;
				lcd-kit,esd-recovery-bl-support = <0x00>;
				lcd-kit,tp-color-support = <0x00>;
				lcd-kit,lcd-vsp = <0x02 0x96 0x53ec60>;
				lcd-kit,lcd-vsn = <0x02 0x97 0x53ec60>;
				lcd-kit,lcd-reset = <0x02 0x2d 0x00>;
				lcd-kit,power-on-stage = <0x03 0x01 0x0a 0x04 0x01 0x14 0x0b 0x01 0x00 0x05 0x01 0x01 0x05 0x02 0x05 0x05 0x01 0x32 0x07 0x01 0x00 0x06 0x01 0x00 0x08 0x01 0x00>;
				lcd-kit,lp-on-stage = <0x00 0x00 0x00>;
				lcd-kit,hs-on-stage = <0x00 0x00 0x00>;
				lcd-kit,hs-off-stage = <0x00 0x00 0x00>;
				lcd-kit,lp-off-stage = <0x00 0x00 0x00>;
				lcd-kit,power-off-stage = <0x07 0x00 0x00 0x06 0x00 0x00 0x08 0x00 0x00 0x05 0x00 0x0a 0x04 0x00 0x14 0x03 0x00 0x0a>;
				lcd-kit,pt-support = <0x01>;
				lcd-kit,panel-density = <0x140>;
				lcd-kit,ssc-disable = <0x01>;
				lcd-kit,inversion-support = <0x00>;
				lcd-kit,check-reg-support = <0x01>;
				lcd-kit,panel-bl-min = <0x30>;
				lcd-kit,panel-bl-max = <0xfff>;
				lcd-kit,panel-bl-max-nit = <0x1c2>;
				lcd-kit,mipi-non-continue-enable = <0x01>;
				lcd-kit,panel-getblmaxnit-type = <0x01>;
				lcd-kit,panel-bl-ic-ctrl-type = <0x08>;
				lcd-kit,panel-bias-ic-ctrl-type = <0x03>;
				lcd-kit,oem-info-support = <0x00>;
				lcd-kit,oem-barcode-2d-support = <0x00>;
				lcd-kit,oem-barcode-2d-num-offset = <0x00>;
				lcd-kit,panel-on-always-reset = <0x01>;
				lcd-kit,panel-gpio-offset = <0x149>;
				phandle = <0x5c>;
			};
		};
	};

	fragment@23 {
		target = <0xffffffff>;

		__overlay__ {

			lcd_kit_pkn_tcl_ft8756_6p517 {
				compatible = "tcl_ft8756_6p517_hdplus_video";
				lcd-kit,panel-name = "TCL_FT8756 6.517' VIDEO TFT 720 x 1600";
				lcd-kit,panel-type = <0x01>;
				lcd-kit,panel-xres = <0x2d0>;
				lcd-kit,panel-yres = <0x640>;
				lcd-kit,panel-width = <0x46>;
				lcd-kit,panel-height = <0x9c>;
				lcd-kit,panel-on-cmds = <0x15 0x01 0x00 0x00 0x0a 0x00 0x02 0x00 0x00 0x39 0x01 0x00 0x00 0x0a 0x00 0x04 0xff 0x87 0x56 0x01 0x15 0x01 0x00 0x00 0x0a 0x00 0x02 0x00 0x80 0x39 0x01 0x00 0x00 0x0a 0x00 0x03 0xff 0x87 0x56 0x15 0x01 0x00 0x00 0x0a 0x00 0x02 0x00 0xa1 0x39 0x01 0x00 0x00 0x0a 0x00 0x07 0xb3 0x02 0xd0 0x06 0x40 0x20 0xfc 0x15 0x01 0x00 0x00 0x0a 0x00 0x02 0x00 0x80 0x39 0x01 0x00 0x00 0x0a 0x00 0x07 0xc0 0x00 0xc9 0x00 0x20 0x00 0x10 0x15 0x01 0x00 0x00 0x0a 0x00 0x02 0x00 0x90 0x39 0x01 0x00 0x00 0x0a 0x00 0x07 0xc0 0x00 0xc9 0x00 0x20 0x00 0x10 0x15 0x01 0x00 0x00 0x0a 0x00 0x02 0x00 0xa0 0x39 0x01 0x00 0x00 0x0a 0x00 0x07 0xc0 0x01 0xb0 0x00 0x20 0x00 0x10 0x15 0x01 0x00 0x00 0x0a 0x00 0x02 0x00 0xb0 0x39 0x01 0x00 0x00 0x0a 0x00 0x06 0xc0 0x00 0xc9 0x00 0x20 0x10 0x15 0x01 0x00 0x00 0x0a 0x00 0x02 0x00 0xc1 0x39 0x01 0x00 0x00 0x0a 0x00 0x09 0xc0 0x01 0x27 0x00 0xea 0x00 0xc5 0x01 0x5f 0x15 0x01 0x00 0x00 0x0a 0x00 0x02 0x00 0xd7 0x39 0x01 0x00 0x00 0x0a 0x00 0x07 0xc0 0x00 0xc5 0x00 0x20 0x00 0x10 0x15 0x01 0x00 0x00 0x0a 0x00 0x02 0x00 0xa3 0x39 0x01 0x00 0x00 0x0a 0x00 0x07 0xc1 0x00 0x24 0x00 0x24 0x00 0x02 0x15 0x01 0x00 0x00 0x0a 0x00 0x02 0x00 0x80 0x39 0x01 0x00 0x00 0x0a 0x00 0x11 0xce 0x01 0x81 0x09 0x13 0x00 0x90 0x00 0x98 0x00 0x60 0x00 0x65 0x00 0x90 0x00 0x98 0x15 0x01 0x00 0x00 0x0a 0x00 0x02 0x00 0x90 0x39 0x01 0x00 0x00 0x0a 0x00 0x10 0xce 0x00 0x8e 0x0e 0xb6 0x00 0x8e 0x80 0x09 0x13 0x00 0x04 0x00 0x0d 0x0d 0x08 0x15 0x01 0x00 0x00 0x0a 0x00 0x02 0x00 0xa0 0x39 0x01 0x00 0x00 0x0a 0x00 0x04 0xce 0x20 0x00 0x00 0x15 0x01 0x00 0x00 0x0a 0x00 0x02 0x00 0xb0 0x39 0x01 0x00 0x00 0x0a 0x00 0x04 0xce 0x22 0x00 0x00 0x15 0x01 0x00 0x00 0x0a 0x00 0x02 0x00 0xd1 0x39 0x01 0x00 0x00 0x0a 0x00 0x08 0xce 0x00 0x00 0x01 0x00 0x00 0x00 0x00 0x15 0x01 0x00 0x00 0x0a 0x00 0x02 0x00 0xe1 0x39 0x01 0x00 0x00 0x0a 0x00 0x0c 0xce 0x08 0x02 0x4d 0x02 0x4d 0x02 0x4d 0x00 0x00 0x00 0x00 0x15 0x01 0x00 0x00 0x0a 0x00 0x02 0x00 0xf1 0x39 0x01 0x00 0x00 0x0a 0x00 0x0a 0xce 0x0f 0x07 0x0a 0x00 0xc6 0x01 0xb4 0x00 0xf8 0x15 0x01 0x00 0x00 0x0a 0x00 0x02 0x00 0xb0 0x39 0x01 0x00 0x00 0x0a 0x00 0x05 0xcf 0x00 0x00 0x84 0x88 0x15 0x01 0x00 0x00 0x0a 0x00 0x02 0x00 0xb5 0x39 0x01 0x00 0x00 0x0a 0x00 0x05 0xcf 0x03 0x03 0x3c 0x40 0x15 0x01 0x00 0x00 0x0a 0x00 0x02 0x00 0xc0 0x39 0x01 0x00 0x00 0x0a 0x00 0x05 0xcf 0x06 0x06 0x14 0x18 0x15 0x01 0x00 0x00 0x0a 0x00 0x02 0x00 0xc5 0x39 0x01 0x00 0x00 0x0a 0x00 0x05 0xcf 0x00 0x00 0x08 0x0c 0x15 0x01 0x00 0x00 0x0a 0x00 0x02 0x00 0xe8 0x15 0x01 0x00 0x00 0x0a 0x00 0x02 0xc0 0x40 0x15 0x01 0x00 0x00 0x0a 0x00 0x02 0x00 0x80 0x39 0x01 0x00 0x00 0x0a 0x00 0x09 0xc2 0x84 0x00 0x05 0x8b 0x83 0x00 0x05 0x89 0x15 0x01 0x00 0x00 0x0a 0x00 0x02 0x00 0xa0 0x39 0x01 0x00 0x00 0x0a 0x00 0x10 0xc2 0x82 0x04 0x00 0x05 0x89 0x81 0x04 0x00 0x05 0x89 0x00 0x04 0x00 0x05 0x89 0x15 0x01 0x00 0x00 0x0a 0x00 0x02 0x00 0xb0 0x39 0x01 0x00 0x00 0x0a 0x00 0x10 0xc2 0x01 0x04 0x00 0x05 0x89 0x02 0x04 0x00 0x05 0x89 0x03 0x04 0x00 0x05 0x89 0x15 0x01 0x00 0x00 0x0a 0x00 0x02 0x00 0xc0 0x39 0x01 0x00 0x00 0x0a 0x00 0x0b 0xc2 0x04 0x04 0x00 0x05 0x89 0x05 0x04 0x00 0x05 0x89 0x15 0x01 0x00 0x00 0x0a 0x00 0x02 0x00 0xe0 0x39 0x01 0x00 0x00 0x0a 0x00 0x05 0xc2 0x77 0x77 0x77 0x77 0x15 0x01 0x00 0x00 0x0a 0x00 0x02 0x00 0xc0 0x39 0x01 0x00 0x00 0x0a 0x00 0x05 0xc3 0x99 0x99 0x99 0x99 0x15 0x01 0x00 0x00 0x0a 0x00 0x02 0x00 0x80 0x39 0x01 0x00 0x00 0x0a 0x00 0x11 0xcb 0x00 0xc5 0x00 0x00 0x05 0x05 0x00 0x05 0x0a 0x05 0xc5 0x00 0x05 0x05 0x00 0xc0 0x15 0x01 0x00 0x00 0x0a 0x00 0x02 0x00 0x90 0x39 0x01 0x00 0x00 0x0a 0x00 0x11 0xcb 0x00 0x00 0x00 0x00 0x00 0x00 0x00 0x00 0x00 0x00 0x00 0x00 0x00 0x00 0x00 0x00 0x15 0x01 0x00 0x00 0x0a 0x00 0x02 0x00 0xa0 0x39 0x01 0x00 0x00 0x0a 0x00 0x05 0xcb 0x00 0x00 0x00 0x00 0x15 0x01 0x00 0x00 0x0a 0x00 0x02 0x00 0xb0 0x39 0x01 0x00 0x00 0x0a 0x00 0x05 0xcb 0x10 0x51 0x94 0x50 0x15 0x01 0x00 0x00 0x0a 0x00 0x02 0x00 0xc0 0x39 0x01 0x00 0x00 0x0a 0x00 0x05 0xcb 0x10 0x51 0x94 0x50 0x15 0x01 0x00 0x00 0x0a 0x00 0x02 0x00 0x80 0x39 0x01 0x00 0x00 0x0a 0x00 0x11 0xcc 0x16 0x17 0x18 0x19 0x1a 0x1b 0x2d 0x25 0x25 0x2d 0x26 0x2d 0x00 0x29 0x03 0x2d 0x15 0x01 0x00 0x00 0x0a 0x00 0x02 0x00 0x90 0x39 0x01 0x00 0x00 0x0a 0x00 0x09 0xcc 0x07 0x09 0x0b 0x0d 0x2d 0x22 0x2d 0x24 0x15 0x01 0x00 0x00 0x0a 0x00 0x02 0x00 0x80 0x39 0x01 0x00 0x00 0x0a 0x00 0x11 0xcd 0x16 0x17 0x18 0x19 0x1a 0x1b 0x2d 0x25 0x25 0x2d 0x26 0x2d 0x00 0x29 0x02 0x2d 0x15 0x01 0x00 0x00 0x0a 0x00 0x02 0x00 0x90 0x39 0x01 0x00 0x00 0x0a 0x00 0x09 0xcd 0x06 0x08 0x0a 0x0c 0x2d 0x22 0x2d 0x24 0x15 0x01 0x00 0x00 0x0a 0x00 0x02 0x00 0xa0 0x39 0x01 0x00 0x00 0x0a 0x00 0x11 0xcc 0x16 0x17 0x18 0x19 0x1a 0x1b 0x2d 0x25 0x25 0x2d 0x26 0x2d 0x00 0x29 0x02 0x2d 0x15 0x01 0x00 0x00 0x0a 0x00 0x02 0x00 0xb0 0x39 0x01 0x00 0x00 0x0a 0x00 0x09 0xcc 0x08 0x06 0x0c 0x0a 0x2d 0x24 0x2d 0x23 0x15 0x01 0x00 0x00 0x0a 0x00 0x02 0x00 0xa0 0x39 0x01 0x00 0x00 0x0a 0x00 0x11 0xcd 0x16 0x17 0x18 0x19 0x1a 0x1b 0x2d 0x25 0x25 0x2d 0x26 0x2d 0x00 0x29 0x03 0x2d 0x15 0x01 0x00 0x00 0x0a 0x00 0x02 0x00 0xb0 0x39 0x01 0x00 0x00 0x0a 0x00 0x09 0xcd 0x09 0x07 0x0d 0x0b 0x2d 0x24 0x2d 0x23 0x15 0x01 0x00 0x00 0x0a 0x00 0x02 0x00 0x80 0x15 0x01 0x00 0x00 0x0a 0x00 0x02 0xa7 0x13 0x15 0x01 0x00 0x00 0x0a 0x00 0x02 0x00 0x82 0x39 0x01 0x00 0x00 0x0a 0x00 0x03 0xa7 0x22 0x02 0x15 0x01 0x00 0x00 0x0a 0x00 0x02 0x00 0x85 0x15 0x01 0x00 0x00 0x0a 0x00 0x02 0xc4 0x1c 0x15 0x01 0x00 0x00 0x0a 0x00 0x02 0x00 0xa0 0x39 0x01 0x00 0x00 0x0a 0x00 0x04 0xc4 0x8d 0xd8 0x8d 0x15 0x01 0x00 0x00 0x0a 0x00 0x02 0x00 0x93 0x15 0x01 0x00 0x00 0x0a 0x00 0x02 0xc5 0x37 0x15 0x01 0x00 0x00 0x0a 0x00 0x02 0x00 0x97 0x15 0x01 0x00 0x00 0x0a 0x00 0x02 0xc5 0x37 0x15 0x01 0x00 0x00 0x0a 0x00 0x02 0x00 0xb6 0x39 0x01 0x00 0x00 0x0a 0x00 0x03 0xc5 0x2d 0x2d 0x15 0x01 0x00 0x00 0x0a 0x00 0x02 0x00 0x97 0x15 0x01 0x00 0x00 0x0a 0x00 0x02 0xc4 0x01 0x15 0x01 0x00 0x00 0x0a 0x00 0x02 0x00 0x9b 0x15 0x01 0x00 0x00 0x0a 0x00 0x02 0xf5 0x4b 0x15 0x01 0x00 0x00 0x0a 0x00 0x02 0x00 0x93 0x39 0x01 0x00 0x00 0x0a 0x00 0x03 0xf5 0x00 0x00 0x15 0x01 0x00 0x00 0x0a 0x00 0x02 0x00 0x9d 0x15 0x01 0x00 0x00 0x0a 0x00 0x02 0xf5 0x49 0x15 0x01 0x00 0x00 0x0a 0x00 0x02 0x00 0x82 0x39 0x01 0x00 0x00 0x0a 0x00 0x03 0xf5 0x00 0x00 0x15 0x01 0x00 0x00 0x0a 0x00 0x02 0x00 0x8c 0x39 0x01 0x00 0x00 0x0a 0x00 0x04 0xc3 0x00 0x00 0x00 0x15 0x01 0x00 0x00 0x0a 0x00 0x02 0x00 0x84 0x39 0x01 0x00 0x00 0x0a 0x00 0x03 0xc5 0x28 0x28 0x15 0x01 0x00 0x00 0x0a 0x00 0x02 0x00 0xa4 0x15 0x01 0x00 0x00 0x0a 0x00 0x02 0xd7 0x00 0x15 0x01 0x00 0x00 0x0a 0x00 0x02 0x00 0x80 0x39 0x01 0x00 0x00 0x0a 0x00 0x03 0xf5 0x59 0x59 0x15 0x01 0x00 0x00 0x0a 0x00 0x02 0x00 0x84 0x39 0x01 0x00 0x00 0x0a 0x00 0x04 0xf5 0x59 0x59 0x59 0x15 0x01 0x00 0x00 0x0a 0x00 0x02 0x00 0x96 0x15 0x01 0x00 0x00 0x0a 0x00 0x02 0xf5 0x59 0x15 0x01 0x00 0x00 0x0a 0x00 0x02 0x00 0xa6 0x15 0x01 0x00 0x00 0x0a 0x00 0x02 0xf5 0x59 0x15 0x01 0x00 0x00 0x0a 0x00 0x02 0x00 0xca 0x15 0x01 0x00 0x00 0x0a 0x00 0x02 0xc0 0x80 0x15 0x01 0x00 0x00 0x0a 0x00 0x02 0x00 0xb1 0x15 0x01 0x00 0x00 0x0a 0x00 0x02 0xf5 0x1f 0x15 0x01 0x00 0x00 0x0a 0x00 0x02 0x00 0x00 0x39 0x01 0x00 0x00 0x0a 0x00 0x03 0xd8 0x2b 0x2b 0x15 0x01 0x00 0x00 0x0a 0x00 0x02 0x00 0x86 0x39 0x01 0x00 0x00 0x0a 0x00 0x07 0xc0 0x01 0x04 0x01 0x01 0x1b 0x03 0x15 0x01 0x00 0x00 0x0a 0x00 0x02 0x00 0x96 0x39 0x01 0x00 0x00 0x0a 0x00 0x07 0xc0 0x01 0x04 0x01 0x01 0x1b 0x03 0x15 0x01 0x00 0x00 0x0a 0x00 0x02 0x00 0xa6 0x39 0x01 0x00 0x00 0x0a 0x00 0x07 0xc0 0x01 0x04 0x01 0x01 0x3e 0x03 0x15 0x01 0x00 0x00 0x0a 0x00 0x02 0x00 0xe9 0x39 0x01 0x00 0x00 0x0a 0x00 0x07 0xc0 0x01 0x04 0x01 0x01 0x1b 0x03 0x15 0x01 0x00 0x00 0x0a 0x00 0x02 0x00 0xa3 0x39 0x01 0x00 0x00 0x0a 0x00 0x07 0xce 0x01 0x04 0x01 0x01 0x1b 0x03 0x15 0x01 0x00 0x00 0x0a 0x00 0x02 0x00 0xb3 0x39 0x01 0x00 0x00 0x0a 0x00 0x07 0xce 0x01 0x04 0x01 0x01 0x1b 0x03 0x15 0x01 0x00 0x00 0x0a 0x00 0x02 0x00 0x00 0x39 0x01 0x00 0x00 0x0a 0x00 0x29 0xe1 0x05 0x06 0x09 0x0f 0x7f 0x19 0x21 0x27 0x30 0x82 0x38 0x3e 0x44 0x48 0x63 0x4d 0x55 0x5b 0x62 0x4e 0x69 0x6f 0x77 0x7f 0x30 0x88 0x8d 0x93 0x9a 0x7f 0xa3 0xae 0xbc 0xc5 0x44 0xd0 0xe3 0xf3 0xff 0xd7 0x15 0x01 0x00 0x00 0x0a 0x00 0x02 0x00 0x00 0x39 0x01 0x00 0x00 0x0a 0x00 0x29 0xe2 0x05 0x06 0x09 0x0f 0x7f 0x19 0x21 0x27 0x30 0x82 0x38 0x3e 0x44 0x48 0x63 0x4d 0x55 0x5b 0x62 0x4e 0x69 0x6f 0x77 0x7f 0x30 0x88 0x8d 0x93 0x9a 0x7f 0xa3 0xae 0xbc 0xc5 0x44 0xd0 0xe3 0xf3 0xff 0xd7 0x15 0x01 0x00 0x00 0x0a 0x00 0x02 0x00 0x00 0x39 0x01 0x00 0x00 0x0a 0x00 0x29 0xe3 0x05 0x06 0x09 0x0f 0x7f 0x19 0x21 0x27 0x30 0x82 0x38 0x3e 0x44 0x48 0x63 0x4d 0x55 0x5b 0x62 0x4e 0x69 0x6f 0x77 0x7f 0x30 0x88 0x8d 0x93 0x9a 0x7f 0xa3 0xae 0xbc 0xc5 0x44 0xd0 0xe3 0xf3 0xff 0xd7 0x15 0x01 0x00 0x00 0x0a 0x00 0x02 0x00 0x00 0x39 0x01 0x00 0x00 0x0a 0x00 0x29 0xe4 0x05 0x06 0x09 0x0f 0x7f 0x19 0x21 0x27 0x30 0x82 0x38 0x3e 0x44 0x48 0x63 0x4d 0x55 0x5b 0x62 0x4e 0x69 0x6f 0x77 0x7f 0x30 0x88 0x8d 0x93 0x9a 0x7f 0xa3 0xae 0xbc 0xc5 0x44 0xd0 0xe3 0xf3 0xff 0xd7 0x15 0x01 0x00 0x00 0x0a 0x00 0x02 0x00 0x00 0x39 0x01 0x00 0x00 0x0a 0x00 0x29 0xe5 0x05 0x06 0x09 0x0f 0x7f 0x19 0x21 0x27 0x30 0x82 0x38 0x3e 0x44 0x48 0x63 0x4d 0x55 0x5b 0x62 0x4e 0x69 0x6f 0x77 0x7f 0x30 0x88 0x8d 0x93 0x9a 0x7f 0xa3 0xae 0xbc 0xc5 0x44 0xd0 0xe3 0xf3 0xff 0xd7 0x15 0x01 0x00 0x00 0x0a 0x00 0x02 0x00 0x00 0x39 0x01 0x00 0x00 0x0a 0x00 0x29 0xe6 0x05 0x06 0x09 0x0f 0x7f 0x19 0x21 0x27 0x30 0x82 0x38 0x3e 0x44 0x48 0x63 0x4d 0x55 0x5b 0x62 0x4e 0x69 0x6f 0x77 0x7f 0x30 0x88 0x8d 0x93 0x9a 0x7f 0xa3 0xae 0xbc 0xc5 0x44 0xd0 0xe3 0xf3 0xff 0xd7 0x15 0x01 0x00 0x00 0x0a 0x00 0x02 0x00 0xcc 0x15 0x01 0x00 0x00 0x0a 0x00 0x02 0xc0 0x13 0x15 0x01 0x00 0x00 0x0a 0x00 0x02 0x00 0x82 0x15 0x01 0x00 0x00 0x0a 0x00 0x02 0xc5 0x3a 0x05 0x01 0x00 0x00 0x78 0x01 0x01 0x11 0x05 0x01 0x00 0x00 0x23 0x01 0x01 0x29>;
				lcd-kit,panel-on-cmds-state = "dsi_lp_mode";
				lcd-kit,panel-off-cmds = <0x15 0x01 0x00 0x00 0x14 0x01 0x02 0x28 0x00 0x05 0x01 0x00 0x00 0xc8 0x01 0x02 0x10 0x00>;
				lcd-kit,panel-off-cmds-state = "dsi_lp_mode";
				lcd-kit,backlight-cmds = <0x29 0x01 0x00 0x00 0x00 0x00 0x03 0x51 0xff 0xff>;
				lcd-kit,backlight-cmds-state = "dsi_lp_mode";
				lcd-kit,tp-color-cmds = <0x06 0x01 0x00 0x00 0x0a 0x00 0x01 0xda>;
				lcd-kit,inversion-dot-cmds = <0x29 0x01 0x00 0x00 0x05 0x01 0x04 0xff 0x98 0x81 0x02 0x29 0x01 0x00 0x00 0x0a 0x00 0x02 0x40 0x04 0x29 0x01 0x00 0x00 0x0a 0x00 0x04 0xff 0x98 0x81 0x00>;
				lcd-kit,inversion-column-cmds = <0x29 0x01 0x00 0x00 0x05 0x01 0x04 0xff 0x98 0x81 0x02 0x29 0x01 0x00 0x00 0x0a 0x00 0x02 0x40 0x00 0x29 0x01 0x00 0x00 0x0a 0x00 0x04 0xff 0x98 0x81 0x00>;
				lcd-kit,esd-reg-cmds = <0x06 0x01 0x00 0x00 0x0a 0x00 0x01 0x54 0x06 0x01 0x00 0x00 0x0a 0x00 0x03 0x09 0x00 0x00>;
				lcd-kit,esd-reg-cmds-state = "dsi_lp_mode";
				lcd-kit,esd-value = <0x2c 0x80 0x03 0x06>;
				lcd-kit,check-reg-cmds = <0x06 0x01 0x00 0x00 0x0a 0x00 0x01 0x0a>;
				lcd-kit,check-reg-cmds-state = "dsi_lp_mode";
				lcd-kit,check-reg-value = <0x9c>;
				lcd-kit,barcode-2d-cmds;
				lcd-kit,project-id-cmds;
				lcd-kit,project-id-cmds-state = "dsi_lp_mode";
				lcd-kit,panel-bl-maxnit-command = <0x06 0x01 0x00 0x00 0x0a 0x00 0x01 0xdb>;
				lcd-kit,panel-bl-maxnit-command-state = "dsi_lp_mode";
				lcd-kit,panel-lcm-type = <0x02>;
				lcd-kit,panel-ldi-dsi-mode = <0x01>;
				lcd-kit,panel-dsi-switch-mode = <0x00>;
				lcd-kit,panel-dsi-switch-mode-en = <0x00>;
				lcd-kit,panel-ldi-trans-seq = <0x00>;
				lcd-kit,panel-ldi-data-padding = <0x00>;
				lcd-kit,panel-ldi-packet-size = <0x100>;
				lcd-kit,panel-ldi-ps = <0x02>;
				lcd-kit,panel-vfp-lp = <0x00>;
				lcd-kit,panel-fbk-div = <0x01>;
				lcd-kit,panel-orientation = <0x01>;
				lcd-kit,panel-bpp = <0x02>;
				lcd-kit,panel-bgr-fmt = <0x00>;
				lcd-kit,panel-cmd-type = <0x08>;
				lcd-kit,panel-pxl-clk = <0x00>;
				lcd-kit,panel-pxl-clk-div = <0x00>;
				lcd-kit,panel-data-rate = <0x244>;
				lcd-kit,mipi-lane-nums = <0x04>;
				lcd-kit,h-back-porch = <0x12>;
				lcd-kit,h-front-porch = <0x20>;
				lcd-kit,h-pulse-width = <0x06>;
				lcd-kit,project-id-support = <0x01>;
				lcd-kit,default-project-id = "GPKN9W340";
				lcd-kit,v-back-porch = <0x0e>;
				lcd-kit,v-front-porch = <0x10>;
				lcd-kit,v-pulse-width = <0x02>;
				lcd-kit,mipi-clk-post-adjust = <0x00>;
				lcd-kit,mipi-lp11-flag = <0x00>;
				lcd-kit,esd-support = <0x00>;
				lcd-kit,esd-recovery-bl-support = <0x00>;
				lcd-kit,tp-color-support = <0x00>;
				lcd-kit,lcd-vsp = <0x02 0x96 0x53ec60>;
				lcd-kit,lcd-vsn = <0x02 0x97 0x53ec60>;
				lcd-kit,lcd-reset = <0x02 0x2d 0x00>;
				lcd-kit,tp-reset = <0x02 0xae 0x00>;
				lcd-kit,power-on-stage = <0x03 0x01 0x0a 0x04 0x01 0x14 0x07 0x01 0x05 0x05 0x01 0x05 0x05 0x02 0x05 0x05 0x01 0x0c 0x06 0x01 0x00 0x08 0x01 0x00>;
				lcd-kit,lp-on-stage = <0x00 0x00 0x00>;
				lcd-kit,hs-on-stage = <0x00 0x00 0x00>;
				lcd-kit,hs-off-stage = <0x00 0x00 0x00>;
				lcd-kit,lp-off-stage = <0x00 0x00 0x00>;
				lcd-kit,power-off-stage = <0x07 0x00 0x00 0x06 0x00 0x00 0x08 0x00 0x00 0x05 0x00 0x0a 0x04 0x00 0x14 0x03 0x00 0x0a>;
				lcd-kit,pt-support = <0x01>;
				lcd-kit,panel-density = <0x140>;
				lcd-kit,ssc-disable = <0x01>;
				lcd-kit,inversion-support = <0x00>;
				lcd-kit,check-reg-support = <0x01>;
				lcd-kit,panel-bl-min = <0x30>;
				lcd-kit,panel-bl-max = <0xfff>;
				lcd-kit,panel-bl-max-nit = <0x1c2>;
				lcd-kit,mipi-non-continue-enable = <0x01>;
				lcd-kit,panel-getblmaxnit-type = <0x01>;
				lcd-kit,panel-bl-ic-ctrl-type = <0x08>;
				lcd-kit,panel-bias-ic-ctrl-type = <0x03>;
				lcd-kit,oem-info-support = <0x00>;
				lcd-kit,oem-barcode-2d-support = <0x00>;
				lcd-kit,oem-barcode-2d-num-offset = <0x00>;
				lcd-kit,panel-on-always-reset = <0x01>;
				lcd-kit,panel-gpio-offset = <0x149>;
				phandle = <0x5d>;
			};
		};
	};

	fragment@24 {
		target = <0xffffffff>;

		__overlay__ {
			compatible = "huawei,lcd_panel_type";
			product_id = <0x3f0>;
			detect_type = <0x02>;
			gpio_id = <0xa9 0xb2>;
			support_lcd_type = "LCD_KIT";
			iovcc_ctrl_mode = <0x01>;
		};
	};

	fragment@25 {
		target = <0xffffffff>;

		__overlay__ {

			lcm_rst_out0_gpio {
				phandle = <0x24>;

				pins_cmd_dat {
					pinmux = <0x2d00>;
					slew-rate = <0x01>;
					output-low;
				};
			};

			lcm_rst_out1_gpio {
				phandle = <0x25>;

				pins_cmd_dat {
					pinmux = <0x2d00>;
					slew-rate = <0x01>;
					output-high;
				};
			};
		};
	};

	fragment@26 {
		target = <0xffffffff>;

		__overlay__ {
			pinctrl-names = "lcm_rst_out0_gpio\0lcm_rst_out1_gpio";
			pinctrl-0 = <0x24>;
			pinctrl-1 = <0x25>;
			status = "okay";
		};
	};

	fragment@27 {
		target = <0xffffffff>;

		__overlay__ {

			sm5109@3e {
				compatible = "sm,sm5109";
				reg = <0x3e>;
				sm5109_i2c_bus_id = <0x06>;
				sm5109_support = <0x01>;
			};

			aw,aw99703@36 {
				compatible = "aw,aw99703";
				aw99703_support = <0x01>;
				reg = <0x36>;
				aw99703_hw_enable = <0x01>;
				aw99703_i2c_bus_id = <0x06>;
				aw99703_hw_en_gpio = <0xa8>;
				aw99703_hw_en_pull_low = <0x00>;
				bl_on_lk_mdelay = <0x05>;
				bl_on_kernel_mdelay = <0x05>;
				aw99703_reg_pfm_67 = <0x1c>;
				aw99703_reg_boot_headroom_23 = <0x61>;
				aw99703_reg_pfm_threshold_25 = <0x61>;
				aw99703_reg_pfm_hys_24 = <0x4c>;
				aw99703_reg_boost_conctrol1 = <0x29>;
				aw99703_reg_af_high = <0x10>;
				aw99703_reg_af_low = <0x05>;
				aw99703_reg_soft_start_68 = <0x2c>;
				aw99703_reg_boot_duty_31 = <0xc0>;
				aw99703_reg_flash = <0x08>;
				aw99703_reg_lsb = <0x00>;
				aw99703_reg_msb = <0x01>;
				aw99703_reg_boost_conctrol2 = <0x80>;
				aw99703_reg_mode = <0x11>;
				aw99703_reg_led_current = <0x9b>;
				aw99703_reg_boot_duty_31_1 = <0x00>;
				aw99703_reg_flash_1 = <0x58>;
				aw99703_reg_soft_start_68_1 = <0x00>;
				aw99703_reg_boost_conctrol2_1 = <0x00>;
				bl_level = <0x7ff>;
				aw99703_10000_backlight = <0x01>;
				aw99703_check_fault_support = <0x01>;
			};

			ktd,ktd3136@36 {
				compatible = "ktd,ktd3136";
				ktd3136_support = <0x01>;
				reg = <0x36>;
				ktd3136_hw_enable = <0x01>;
				ktd3136_i2c_bus_id = <0x06>;
				ktd3136_hw_en_gpio = <0xa8>;
				ktd3136_hw_en_pull_low = <0x00>;
				bl_on_lk_mdelay = <0x05>;
				bl_on_kernel_mdelay = <0x05>;
				ktd3136_reg_ctrl_a_current_set = <0x99>;
				ktd3136_reg_ctrl_a_bl_cfg = <0x60>;
				ktd3136_reg_pwm_cfg = <0x9f>;
				ktd3136_reg_boost_ctrl = <0x10>;
				ktd3136_reg_ctrl_a_lsb = <0x00>;
				ktd3136_reg_ctrl_a_msb = <0x00>;
				bl_level = <0x7ff>;
				ktd3136_10000_backlight = <0x01>;
				ktd3136_check_fault_support = <0x01>;
			};
		};
	};

	fragment@28 {
		target = <0xffffffff>;

		__overlay__ {

			consys_default {
				phandle = <0x26>;
			};

			gpslna@0 {
				phandle = <0x27>;

				pins_cmd_dat {
					pinmux = <0x5b00>;
					slew-rate = <0x00>;
					bias-disable;
					output-low;
				};
			};

			gpslna@1 {
				phandle = <0x28>;

				pins_cmd_dat {
					pinmux = <0x5b00>;
					slew-rate = <0x01>;
					output-high;
				};
			};

			gpslna@2 {
				phandle = <0x29>;

				pins_cmd_dat {
					pinmux = <0x5b00>;
					slew-rate = <0x01>;
					output-low;
				};
			};
		};
	};

	fragment@29 {
		target = <0xffffffff>;

		__overlay__ {
			pinctrl-names = "default\0gps_lna_state_init\0gps_lna_state_oh\0gps_lna_state_ol";
			pinctrl-0 = <0x26>;
			pinctrl-1 = <0x27>;
			pinctrl-2 = <0x28>;
			pinctrl-3 = <0x29>;
			status = "okay";
		};
	};

	fragment@30 {
		target = <0xffffffff>;

		__overlay__ {
			compatible = "huawei,huawei_scp_info";
			direction_number = <0x01>;
			status = "okay";
		};
	};

	fragment@31 {
		target = <0xffffffff>;

		__overlay__ {
			compatible = "hisi,shell-temp";
			interval = <0x1388>;
			bias = <0x323de>;
			count = <0x07>;
			tsensor_para = "10000\0100000\00";
			ntc_para = "2000\080000\0-20000";
			status = "ok";

			sensors {

				sensor0 {
					type = "msm_therm";
					coef = "868\01001\0-1255\0-75\0441\05634\021564";
				};

				sensor1 {
					type = "pa_therm0";
					coef = "-9134\0246\0-3722\0-49\0-2055\01165\0528";
				};

				sensor2 {
					type = "pmic_xo_therm";
					coef = "3064\02003\0-1505\04557\0-1930\03606\023016";
				};

				sensor3 {
					type = "COOL_THERM";
					coef = "2546\01325\01294\0-283\022\0622\0591";
				};

				sensor4 {
					type = "battery";
					coef = "-19490000\0-8326000\0-2006000\05061000\013771000\021888000\028522000";
				};
			};
		};
	};

	fragment@32 {
		target = <0xffffffff>;

		__overlay__ {
			compatible = "hisi,shell-temp";
			interval = <0x1388>;
			bias = <0x1d45d>;
			count = <0x07>;
			tsensor_para = "10000\0100000\00";
			ntc_para = "2000\080000\0-20000";
			status = "ok";

			sensors {

				sensor0 {
					type = "msm_therm";
					coef = "-18327\0-9672\0-7228\0-7465\0-5568\0-3765\09593";
				};

				sensor1 {
					type = "pa_therm0";
					coef = "-10931\0371\0-3992\0-434\0-1295\0395\07499";
				};

				sensor2 {
					type = "pmic_xo_therm";
					coef = "16425\07838\0704\08406\0485\06907\031231";
				};

				sensor3 {
					type = "COOL_THERM";
					coef = "360\0-770\0-383\0-1926\0-1220\0-2214\0-2643";
				};

				sensor4 {
					type = "battery";
					coef = "-27172000\0-12732000\0-1811000\09335000\023012000\037954000\050219000";
				};
			};
		};
	};

	fragment@33 {
		target = <0xffffffff>;

		__overlay__ {
			compatible = "hisi,shell-temp";
			interval = <0x1388>;
			bias = <0x375af>;
			count = <0x07>;
			tsensor_para = "10000\0100000\00";
			ntc_para = "2000\080000\0-20000";
			status = "ok";

			sensors {

				sensor0 {
					type = "msm_therm";
					coef = "7498\04840\02485\02938\03072\05179\010244";
				};

				sensor1 {
					type = "pa_therm0";
					coef = "2921\0714\00\01344\0-320\01261\07368";
				};

				sensor2 {
					type = "pmic_xo_therm";
					coef = "-4242\0-2814\0-2126\0-2362\0-2662\0-1648\0-4888";
				};

				sensor3 {
					type = "COOL_THERM";
					coef = "516\0742\0257\0-685\0-580\0-519\0-556";
				};

				sensor4 {
					type = "battery";
					coef = "12689000\011794000\010256000\08488000\08378000\07054000\04871000";
				};
			};
		};
	};

	fragment@34 {
		target = <0xffffffff>;

		__overlay__ {
			pinctrl-names = "aud_clk_mosi_off\0aud_clk_mosi_on\0aud_clk_miso_off\0aud_clk_miso_on\0aud_dat_mosi_off\0aud_dat_mosi_on\0aud_dat_miso_off\0aud_dat_miso_on\0aud_switch_en_high\0aud_switch_en_low\0aud_rcv_en_high\0aud_rcv_en_low";
			pinctrl-0 = <0x2a>;
			pinctrl-1 = <0x2b>;
			pinctrl-2 = <0x2c>;
			pinctrl-3 = <0x2d>;
			pinctrl-4 = <0x2e>;
			pinctrl-5 = <0x2f>;
			pinctrl-6 = <0x30>;
			pinctrl-7 = <0x31>;
			pinctrl-8 = <0x32>;
			pinctrl-9 = <0x33>;
			pinctrl-10 = <0x34>;
			pinctrl-11 = <0x35>;
			status = "okay";
		};
	};

	fragment@35 {
		target = <0xffffffff>;

		__overlay__ {

			aud_clk_mosi_off {
				phandle = <0x2a>;

				pins_cmd0_dat {
					pinmux = <0x8800>;
				};
			};

			aud_clk_mosi_on {
				phandle = <0x2b>;

				pins_cmd0_dat {
					pinmux = <0x8801>;
				};
			};

			aud_clk_miso_off {
				phandle = <0x2c>;

				pins_cmd0_dat {
					pinmux = <0x8c00>;
				};
			};

			aud_clk_miso_on {
				phandle = <0x2d>;

				pins_cmd0_dat {
					pinmux = <0x8c01>;
				};
			};

			aud_dat_mosi_off {
				phandle = <0x2e>;

				pins_cmd1_dat {
					pinmux = <0x8a00>;
					input-enable;
					slew-rate = <0x00>;
					bias-disable;
				};

				pins_cmd2_dat {
					pinmux = <0x8b00>;
					input-enable;
					slew-rate = <0x00>;
					bias-disable;
				};
			};

			aud_dat_mosi_on {
				phandle = <0x2f>;

				pins_cmd1_dat {
					pinmux = <0x8a01>;
				};

				pins_cmd2_dat {
					pinmux = <0x8b01>;
				};
			};

			aud_dat_miso_off {
				phandle = <0x30>;

				pins_cmd1_dat {
					pinmux = <0x8e00>;
					input-enable;
					slew-rate = <0x00>;
					bias-disable;
				};

				pins_cmd2_dat {
					pinmux = <0x8f00>;
					input-enable;
					slew-rate = <0x00>;
					bias-disable;
				};
			};

			aud_dat_miso_on {
				phandle = <0x31>;

				pins_cmd1_dat {
					pinmux = <0x8e01>;
				};

				pins_cmd2_dat {
					pinmux = <0x8f01>;
				};
			};

			aud_switch_en_high {
				phandle = <0x32>;

				pins_cmd_dat {
					pinmux = <0xaa00>;
					slew-rate = <0x01>;
					output-high;
				};
			};

			aud_switch_en_low {
				phandle = <0x33>;

				pins_cmd_dat {
					pinmux = <0xaa00>;
					slew-rate = <0x01>;
					output-low;
				};
			};

			aud_rcv_en_high {
				phandle = <0x34>;

				pins_cmd_dat {
					pinmux = <0xab00>;
					slew-rate = <0x01>;
					output-high;
				};
			};

			aud_rcv_en_low {
				phandle = <0x35>;

				pins_cmd_dat {
					pinmux = <0xab00>;
					slew-rate = <0x01>;
					output-low;
				};
			};
		};
	};

	fragment@36 {
		target = <0xffffffff>;

		__overlay__ {
			simple-pa-gpio-enale = <0xffffffff 0xaa 0x00>;
			use_two_in_one_speaker = <0x01>;
		};
	};

	fragment@37 {
		target = <0xffffffff>;

		__overlay__ {
			audio_param_path = "odm/etc/audio/audio_param_aw87318";
			audio_param_ce_path = "odm/etc/audio/audio_param_ce_aw87318";
		};
	};

	fragment@38 {
		target = <0xffffffff>;

		__overlay__ {
			accdet-mic-vol = <0x06>;
			headset-mode-setting = <0x500 0x500 0x01 0x1f0 0x800 0x800 0x20 0x44>;
			accdet-plugout-debounce = <0x01>;
			accdet-mic-mode = <0x01>;
			headset-eint-level-pol = <0x08>;
			headset-three-key-threshold = <0x00 0x50 0xdc 0x190>;
			headset-three-key-threshold-CDD = <0x00 0x79 0xc0 0x258>;
			headset-four-key-threshold = <0x00 0x3a 0x79 0xc0 0x190>;
			pinctrl-names = "default\0state_eint_as_int";
			pinctrl-0 = <0x36>;
			pinctrl-1 = <0x37>;
			status = "okay";
		};
	};

	fragment@39 {
		target = <0xffffffff>;

		__overlay__ {

			accdetdefault {
				phandle = <0x36>;
			};

			accdeteint@0 {
				phandle = <0x37>;

				pins_cmd_dat {
					pinmux = <0x900>;
					slew-rate = <0x00>;
					bias-disable;
				};
			};
		};
	};

	fragment@40 {
		target = <0xffffffff>;

		__overlay__ {
			status = "disabled";
		};
	};

	fragment@41 {
		target = <0xffffffff>;

		__overlay__ {
			compatible = "huawei,huawei_fm_info";
			status = "okay";
			fm,fm_elna_pins = <0xffffffff 0x07 0x00>;
		};
	};

	fragment@42 {
		target = <0xffffffff>;

		__overlay__ {
			regulator-min-microvolt = <0x2dc6c0>;
			regulator-max-microvolt = <0x2dc6c0>;
			regulator-default-on = <0x02>;
			regulator-always-on;
			regulator-boot-on;
		};
	};

	fragment@43 {
		target = <0xffffffff>;

		__overlay__ {

			flashlight@63 {
				compatible = "mediatek,flashlights_aw36514_i2c";
				reg = <0x63>;
				status = "okay";
			};
		};
	};

	fragment@44 {
		target = <0xffffffff>;

		__overlay__ {
			#address-cells = <0x01>;
			#size-cells = <0x00>;
			clock-frequency = <0x61a80>;
			mediatek,use-open-drain;

			camera_main@10 {
				compatible = "mediatek,camera_main";
				reg = <0x10>;
				status = "okay";
				phandle = <0x5e>;
			};

			camera_main_eeprom@50 {
				compatible = "mediatek,camera_main_eeprom";
				reg = <0x50>;
				status = "okay";
				phandle = <0x5f>;
			};

			camera_main_af@0c {
				compatible = "mediatek,camera_main_af";
				reg = <0x0c>;
				status = "okay";
				phandle = <0x60>;
			};
		};
	};

	fragment@45 {
		target = <0xffffffff>;

		__overlay__ {
			#address-cells = <0x01>;
			#size-cells = <0x00>;
			clock-frequency = <0x61a80>;
			mediatek,use-open-drain;

			camera_sub@36 {
				compatible = "mediatek,camera_sub";
				reg = <0x36>;
				status = "okay";
				phandle = <0x61>;
			};

			camera_sub_eeprom@52 {
				compatible = "mediatek,camera_sub_eeprom";
				reg = <0x52>;
				status = "okay";
				phandle = <0x62>;
			};

			camera_main_two@17 {
				compatible = "mediatek,camera_main_two";
				reg = <0x17>;
				status = "okay";
				phandle = <0x63>;
			};

			camera_main_two_eeprom@50 {
				compatible = "mediatek,camera_main_two_eeprom";
				reg = <0x50>;
				status = "okay";
				phandle = <0x64>;
			};

			camera_sub_two@22 {
				compatible = "mediatek,camera_sub_two";
				reg = <0x22>;
				status = "okay";
				phandle = <0x65>;
			};

			camera_sub_two_eeprom@55 {
				compatible = "mediatek,camera_sub_two_eeprom";
				reg = <0x55>;
				status = "okay";
				phandle = <0x66>;
			};
		};
	};

	fragment@46 {
		target = <0xffffffff>;

		__overlay__ {

			camera_pins_cam0_mclk_on {
				phandle = <0x45>;

				pins_cmd_dat {
					pinmux = <0x6301>;
				};
			};

			camera_pins_cam0_mclk_off {
				phandle = <0x46>;

				pins_cmd_dat {
					pinmux = <0x6300>;
				};
			};

			camera_pins_cam1_mclk_on {
				phandle = <0x47>;

				pins_cmd_dat {
					pinmux = <0x6301>;
				};
			};

			camera_pins_cam1_mclk_off {
				phandle = <0x48>;

				pins_cmd_dat {
					pinmux = <0x6300>;
				};
			};

			camera_pins_cam2_mclk_on {
				phandle = <0x67>;

				pins_cmd_dat {
					pinmux = <0x6c01>;
				};
			};

			camera_pins_cam2_mclk_off {
				phandle = <0x68>;

				pins_cmd_dat {
					pinmux = <0x6c00>;
				};
			};

			cam0@0 {
				phandle = <0x39>;

				pins_cmd_dat {
					pinmux = <0x6500>;
					slew-rate = <0x01>;
					output-low;
				};
			};

			cam0@1 {
				phandle = <0x3a>;

				pins_cmd_dat {
					pinmux = <0x6500>;
					slew-rate = <0x01>;
					output-high;
				};
			};

			cam0@2 {
				phandle = <0x3b>;
			};

			cam0@3 {
				phandle = <0x3c>;
			};

			cam1@0 {
				phandle = <0x3d>;

				pins_cmd_dat {
					pinmux = <0x6600>;
					slew-rate = <0x01>;
					output-low;
				};
			};

			cam1@1 {
				phandle = <0x3e>;

				pins_cmd_dat {
					pinmux = <0x6600>;
					slew-rate = <0x01>;
					output-high;
				};
			};

			cam1@2 {
				phandle = <0x3f>;

				pins_cmd_dat {
					pinmux = <0x6200>;
					slew-rate = <0x01>;
					output-low;
				};
			};

			cam1@3 {
				phandle = <0x40>;

				pins_cmd_dat {
					pinmux = <0x6200>;
					slew-rate = <0x01>;
					output-high;
				};
			};

			cam2@0 {
				phandle = <0x41>;
			};

			cam2@1 {
				phandle = <0x42>;
			};

			cam2@2 {
				phandle = <0x43>;

				pins_cmd_dat {
					pinmux = <0x6b00>;
					slew-rate = <0x01>;
					output-low;
				};
			};

			cam2@3 {
				phandle = <0x44>;

				pins_cmd_dat {
					pinmux = <0x6b00>;
					slew-rate = <0x01>;
					output-high;
				};
			};

			cam2@vcama0 {
				phandle = <0x69>;

				pins_cmd_dat {
					pinmux = <0x2a00>;
					slew-rate = <0x01>;
					output-low;
				};
			};

			cam2@vcama1 {
				phandle = <0x6a>;

				pins_cmd_dat {
					pinmux = <0x2a00>;
					slew-rate = <0x01>;
					output-high;
				};
			};

			camdefault {
				phandle = <0x38>;

				pins_cmd_dat {
					pinmux = <0x6d00>;
					slew-rate = <0x00>;
					bias-disable;
				};
			};
		};
	};

	fragment@47 {
		target = <0xffffffff>;

		__overlay__ {
			pinctrl-names = "default\0cam0_rst0\0cam0_rst1\0cam0_pnd0\0cam0_pnd1\0cam1_rst0\0cam1_rst1\0cam1_pnd0\0cam1_pnd1\0cam2_rst0\0cam2_rst1\0cam2_pnd0\0cam2_pnd1\0cam0_mclk_on\0cam0_mclk_off\0cam1_mclk_on\0cam1_mclk_off\0cam2_mclk_on\0cam2_mclk_off";
			pinctrl-0 = <0x38>;
			pinctrl-1 = <0x39>;
			pinctrl-2 = <0x3a>;
			pinctrl-3 = <0x3b>;
			pinctrl-4 = <0x3c>;
			pinctrl-5 = <0x3d>;
			pinctrl-6 = <0x3e>;
			pinctrl-7 = <0x3f>;
			pinctrl-8 = <0x40>;
			pinctrl-9 = <0x41>;
			pinctrl-10 = <0x42>;
			pinctrl-11 = <0x43>;
			pinctrl-12 = <0x44>;
			pinctrl-13 = <0x45>;
			pinctrl-14 = <0x46>;
			pinctrl-15 = <0x47>;
			pinctrl-16 = <0x48>;
			cam0_vcama-supply = <0xffffffff>;
			cam0_vcamd-supply = <0xffffffff>;
			cam0_vcamio-supply = <0xffffffff>;
			cam0_vcamaf-supply = <0xffffffff>;
			cam1_vcama-supply = <0xffffffff>;
			cam1_vcamd-supply = <0xffffffff>;
			cam1_vcamio-supply = <0xffffffff>;
			cam2_vcama-supply = <0xffffffff>;
			cam2_vcamio-supply = <0xffffffff>;
			cam0_enable_sensor = "c645uai_m090_pkn c645wmr_m010_pkn c645wmr_m0a0_pkn c645xba_m0c0_pkn";
			cam1_enable_sensor = "c264hqf_m0d0_pkn c264keh_m0c0_pkn c264keh_m0f0_pkn c264keh_m0e0_pkn";
			cam2_enable_sensor = "c637yga_m010_pkn c637eoy_m0c0_pkn c637yga_m0b0_pkn";
			status = "okay";
		};
	};

	fragment@48 {
		target = <0xffffffff>;

		__overlay__ {

			default {
				phandle = <0x49>;

				pins_cmd_dat {
					pinmux = <0x600>;
					slew-rate = <0x01>;
					output-high;
				};
			};

			hwen_high {
				phandle = <0x4a>;

				pins_cmd_dat {
					pinmux = <0x600>;
					slew-rate = <0x01>;
					output-high;
				};
			};

			hwen_low {
				phandle = <0x4b>;

				pins_cmd_dat {
					pinmux = <0x600>;
					slew-rate = <0x01>;
					output-low;
				};
			};

			strobe_high {
				phandle = <0x4c>;

				pins_cmd_dat {
					pinmux = <0x5a00>;
					slew-rate = <0x01>;
					output-high;
				};
			};

			strobe_low {
				phandle = <0x4d>;

				pins_cmd_dat {
					pinmux = <0x5a00>;
					slew-rate = <0x01>;
					output-low;
				};
			};
		};
	};

	fragment@49 {
		target = <0xffffffff>;

		__overlay__ {
			pinctrl-names = "default\0hwen_high\0hwen_low\0strobe_high\0strobe_low";
			pinctrl-0 = <0x49>;
			pinctrl-1 = <0x4a>;
			pinctrl-2 = <0x4b>;
			pinctrl-3 = <0x4c>;
			pinctrl-4 = <0x4d>;
			status = "okay";
		};
	};

	fragment@50 {
		target = <0xffffffff>;

		__overlay__ {
			product-name = "PknHmsCam";
		};
	};

	fragment@51 {
		target = <0xffffffff>;

		__overlay__ {
			compatible = "mediatek,psensor";
			status = "okay";
			psensor,ldo_ven = <0xffffffff 0x61 0x00>;
		};
	};

	fragment@52 {
		target = <0xffffffff>;

		__overlay__ {
			mtk,boardid = <0x04 0x05 0x03 0x05>;
			mtk,board_name = "PKN_LX3_VA";
			mtk,product_name = "PKN-LX3";
			hardware_version = "HL1PKNM";
		};
	};

	fragment@53 {
		target = <0xffffffff>;

		__overlay__ {
			expect_value = <0x801>;
		};
	};

	fragment@54 {
		target = <0xffffffff>;

		__overlay__ {

			adc_channel@ {
				compatible = "mediatek,adc_channel";
				mediatek,temperature0 = <0x00>;
				mediatek,temperature1 = <0x01>;
				mediatek,adc_fdd_rf_params_dynamic_custom_ch = <0x02>;
				status = "okay";
			};
		};
	};

	fragment@55 {
		target = <0xffffffff>;

		__overlay__ {
			mediatek,clkbuf-quantity = <0x07>;
			mediatek,clkbuf-config = <0x02 0x01 0x01 0x02 0x00 0x00 0x00>;
			mediatek,clkbuf-driving-current = <0x01 0x01 0x01 0x01 0x01 0x01 0x01>;
			status = "okay";
		};
	};

	fragment@56 {
		target = <0xffffffff>;

		__overlay__ {
			#address-cells = <0x01>;
			#size-cells = <0x00>;
			clock-frequency = <0x61a80>;
			mediatek,use-open-drain;

			cap_touch@5d {
				compatible = "mediatek,cap_touch";
				reg = <0x5d>;
				status = "okay";
				phandle = <0x6b>;
			};
		};
	};

	fragment@57 {
		target = <0xffffffff>;

		__overlay__ {
			#address-cells = <0x01>;
			#size-cells = <0x00>;
			clock-frequency = <0x61a80>;
			mediatek,use-open-drain;
		};
	};

	fragment@58 {
		target = <0xffffffff>;

		__overlay__ {
			#address-cells = <0x01>;
			#size-cells = <0x00>;
			clock-frequency = <0x61a80>;
			mediatek,use-open-drain;
		};
	};

	fragment@59 {
		target = <0xffffffff>;

		__overlay__ {
			#address-cells = <0x01>;
			#size-cells = <0x00>;
			clock-frequency = <0x61a80>;
			mediatek,use-open-drain;

			speaker_amp@34 {
				compatible = "mediatek,speaker_amp";
				reg = <0x34>;
				status = "okay";
				phandle = <0x6c>;
			};

			slave_charger@4b {
				compatible = "mediatek,slave_charger";
				reg = <0x4b>;
				status = "okay";
				phandle = <0x6d>;
			};

			nfc@08 {
				compatible = "mediatek,nfc";
				reg = <0x08>;
				status = "okay";
				phandle = <0x6e>;
			};

			ext_buck_lp4@57 {
				compatible = "mediatek,ext_buck_lp4";
				reg = <0x57>;
				status = "okay";
				phandle = <0x6f>;
			};

			ext_buck_lp4x@50 {
				compatible = "mediatek,ext_buck_lp4x";
				reg = <0x50>;
				status = "okay";
				phandle = <0x70>;
			};
		};
	};

	fragment@60 {
		target = <0xffffffff>;

		__overlay__ {
			#address-cells = <0x01>;
			#size-cells = <0x00>;
			clock-frequency = <0x61a80>;
			mediatek,use-open-drain;
		};
	};

	fragment@61 {
		target = <0xffffffff>;

		__overlay__ {
			#address-cells = <0x01>;
			#size-cells = <0x00>;
			clock-frequency = <0x33e140>;
			mediatek,use-push-pull;

			subpmic_pmu@34 {
				compatible = "mediatek,subpmic_pmu";
				reg = <0x34>;
				status = "okay";
				phandle = <0x71>;
			};

			usb_type_c@4e {
				compatible = "mediatek,usb_type_c";
				reg = <0x4e>;
				status = "okay";
				phandle = <0x72>;
			};
		};
	};

	fragment@62 {
		target = <0xffffffff>;

		__overlay__ {
			#address-cells = <0x01>;
			#size-cells = <0x00>;
			clock-frequency = <0x61a80>;
			mediatek,use-open-drain;

			ext_buck_vgpu@55 {
				compatible = "mediatek,ext_buck_vgpu";
				reg = <0x55>;
				status = "okay";
				phandle = <0x73>;
			};
		};
	};

	fragment@63 {
		target = <0xffffffff>;

		__overlay__ {
			#address-cells = <0x01>;
			#size-cells = <0x00>;
			clock-frequency = <0x61a80>;
			mediatek,use-open-drain;
		};
	};

	fragment@64 {
		target = <0xffffffff>;

		__overlay__ {
			#address-cells = <0x01>;
			#size-cells = <0x00>;
			clock-frequency = <0x61a80>;
			mediatek,use-open-drain;
		};
	};

	fragment@65 {
		target = <0xffffffff>;

		__overlay__ {
			#address-cells = <0x01>;
			#size-cells = <0x00>;
			clock-frequency = <0x61a80>;
			mediatek,use-open-drain;
		};
	};

	fragment@66 {
		target = <0xffffffff>;

		__overlay__ {
			GPIO_SIM2_SIO = <0xffffffff 0x23 0x00>;
			GPIO_SIM2_SRST = <0xffffffff 0x24 0x00>;
			GPIO_SIM2_SCLK = <0xffffffff 0x25 0x00>;
			GPIO_SIM1_SCLK = <0xffffffff 0x26 0x00>;
			GPIO_SIM1_SRST = <0xffffffff 0x27 0x00>;
			GPIO_SIM1_SIO = <0xffffffff 0x28 0x00>;
			GPIO_SIM2_HOT_PLUG = <0xffffffff 0x2e 0x00>;
			GPIO_SIM1_HOT_PLUG = <0xffffffff 0x2f 0x00>;
			GPIO_FDD_BAND_SUPPORT_DETECT_4TH_PIN = <0xffffffff 0xa3 0x00>;
			GPIO_FDD_BAND_SUPPORT_DETECT_3RD_PIN = <0xffffffff 0xa4 0x00>;
			GPIO_FDD_BAND_SUPPORT_DETECT_2ND_PIN = <0xffffffff 0xa5 0x00>;
			GPIO_FDD_BAND_SUPPORT_DETECT_1ST_PIN = <0xffffffff 0xa6 0x00>;
			GPIO_FDD_BAND_SUPPORT_DETECT_5TH_PIN = <0xffffffff 0xa7 0x00>;
		};
	};

	fragment@67 {
		target = <0xffffffff>;

		__overlay__ {
			gpio_init_default = <0x00 0x00 0x00 0x00 0x01 0x01 0x01 0x01 0x00 0x00 0x00 0x01 0x01 0x01 0x02 0x00 0x00 0x00 0x01 0x01 0x01 0x03 0x00 0x00 0x00 0x01 0x01 0x01 0x04 0x05 0x00 0x00 0x01 0x01 0x00 0x05 0x00 0x00 0x00 0x01 0x01 0x00 0x06 0x00 0x00 0x00 0x01 0x00 0x00 0x07 0x00 0x00 0x00 0x01 0x01 0x00 0x08 0x07 0x00 0x00 0x01 0x01 0x00 0x09 0x00 0x00 0x00 0x01 0x01 0x00 0x0a 0x00 0x00 0x00 0x01 0x00 0x00 0x0b 0x00 0x00 0x00 0x01 0x01 0x00 0x0c 0x00 0x00 0x00 0x01 0x01 0x00 0x0d 0x03 0x00 0x00 0x01 0x00 0x00 0x0e 0x03 0x01 0x00 0x00 0x00 0x00 0x0f 0x03 0x01 0x00 0x00 0x00 0x00 0x10 0x03 0x01 0x00 0x00 0x00 0x00 0x11 0x06 0x00 0x00 0x01 0x00 0x00 0x12 0x06 0x01 0x00 0x00 0x00 0x00 0x13 0x06 0x01 0x00 0x00 0x00 0x00 0x14 0x06 0x01 0x00 0x00 0x00 0x00 0x15 0x03 0x00 0x00 0x01 0x01 0x00 0x16 0x03 0x00 0x01 0x01 0x01 0x00 0x17 0x00 0x00 0x00 0x01 0x01 0x00 0x18 0x03 0x00 0x00 0x01 0x00 0x00 0x19 0x01 0x00 0x00 0x01 0x00 0x00 0x1a 0x01 0x01 0x00 0x00 0x00 0x00 0x1b 0x01 0x01 0x00 0x00 0x00 0x00 0x1c 0x01 0x01 0x00 0x00 0x00 0x00 0x1d 0x01 0x01 0x00 0x00 0x00 0x01 0x1e 0x01 0x00 0x00 0x01 0x01 0x01 0x1f 0x01 0x00 0x00 0x01 0x01 0x01 0x20 0x01 0x00 0x00 0x01 0x01 0x01 0x21 0x01 0x00 0x00 0x01 0x01 0x01 0x22 0x01 0x00 0x00 0x01 0x01 0x01 0x23 0x01 0x00 0x00 0x01 0x01 0x00 0x24 0x01 0x01 0x00 0x00 0x00 0x00 0x25 0x01 0x01 0x00 0x00 0x00 0x00 0x26 0x01 0x01 0x00 0x00 0x00 0x00 0x27 0x01 0x01 0x00 0x00 0x00 0x00 0x28 0x01 0x00 0x00 0x01 0x01 0x00 0x29 0x01 0x00 0x00 0x01 0x01 0x00 0x2a 0x00 0x00 0x00 0x01 0x00 0x00 0x2b 0x01 0x01 0x00 0x00 0x00 0x00 0x2c 0x01 0x00 0x00 0x01 0x00 0x00 0x2d 0x01 0x01 0x01 0x00 0x00 0x00 0x2e 0x01 0x00 0x00 0x01 0x01 0x00 0x2f 0x01 0x00 0x00 0x01 0x01 0x00 0x30 0x01 0x00 0x00 0x01 0x01 0x01 0x31 0x01 0x00 0x00 0x01 0x01 0x01 0x32 0x01 0x00 0x00 0x01 0x01 0x01 0x33 0x01 0x00 0x00 0x01 0x01 0x01 0x34 0x01 0x01 0x00 0x01 0x00 0x00 0x35 0x01 0x01 0x00 0x01 0x00 0x00 0x36 0x01 0x01 0x00 0x01 0x00 0x00 0x37 0x01 0x01 0x00 0x01 0x00 0x00 0x38 0x01 0x01 0x00 0x01 0x00 0x00 0x39 0x01 0x01 0x00 0x01 0x00 0x00 0x3a 0x00 0x00 0x00 0x01 0x00 0x00 0x3b 0x01 0x00 0x00 0x01 0x00 0x00 0x3c 0x01 0x00 0x00 0x01 0x00 0x00 0x3d 0x01 0x00 0x00 0x01 0x00 0x00 0x3e 0x01 0x00 0x00 0x01 0x00 0x00 0x3f 0x01 0x00 0x00 0x01 0x00 0x00 0x40 0x01 0x00 0x00 0x01 0x00 0x00 0x41 0x01 0x00 0x00 0x01 0x00 0x00 0x42 0x01 0x00 0x00 0x01 0x00 0x00 0x43 0x01 0x00 0x00 0x01 0x00 0x00 0x44 0x01 0x00 0x00 0x01 0x00 0x00 0x45 0x01 0x01 0x00 0x01 0x00 0x00 0x46 0x01 0x01 0x00 0x01 0x00 0x00 0x47 0x01 0x01 0x00 0x01 0x00 0x00 0x48 0x01 0x01 0x00 0x01 0x00 0x00 0x49 0x01 0x01 0x00 0x01 0x00 0x00 0x4a 0x01 0x01 0x00 0x01 0x00 0x00 0x4b 0x01 0x01 0x00 0x01 0x00 0x00 0x4c 0x01 0x01 0x00 0x01 0x00 0x00 0x4d 0x01 0x01 0x00 0x01 0x00 0x00 0x4e 0x01 0x01 0x00 0x01 0x00 0x00 0x4f 0x01 0x00 0x00 0x01 0x00 0x00 0x50 0x01 0x00 0x00 0x01 0x00 0x00 0x51 0x01 0x00 0x00 0x01 0x01 0x01 0x52 0x01 0x00 0x00 0x01 0x01 0x01 0x53 0x01 0x00 0x00 0x01 0x01 0x01 0x54 0x01 0x00 0x00 0x01 0x01 0x01 0x55 0x01 0x01 0x00 0x01 0x00 0x00 0x56 0x01 0x01 0x00 0x01 0x00 0x00 0x57 0x00 0x01 0x00 0x00 0x00 0x00 0x58 0x00 0x01 0x00 0x01 0x00 0x00 0x59 0x01 0x00 0x00 0x01 0x00 0x00 0x5a 0x02 0x01 0x00 0x00 0x00 0x00 0x5b 0x00 0x01 0x00 0x01 0x00 0x00 0x5c 0x01 0x01 0x00 0x00 0x00 0x00 0x5d 0x01 0x00 0x00 0x01 0x01 0x00 0x5e 0x01 0x00 0x00 0x01 0x01 0x00 0x5f 0x01 0x00 0x00 0x01 0x01 0x00 0x60 0x01 0x01 0x00 0x00 0x00 0x00 0x61 0x00 0x01 0x00 0x00 0x00 0x00 0x62 0x00 0x01 0x00 0x00 0x00 0x00 0x63 0x01 0x01 0x00 0x00 0x00 0x00 0x64 0x01 0x01 0x00 0x00 0x00 0x00 0x65 0x00 0x01 0x00 0x00 0x00 0x00 0x66 0x00 0x01 0x00 0x00 0x00 0x00 0x67 0x01 0x00 0x00 0x01 0x01 0x01 0x68 0x01 0x00 0x00 0x01 0x01 0x01 0x69 0x01 0x00 0x00 0x01 0x01 0x01 0x6a 0x01 0x00 0x00 0x01 0x01 0x01 0x6b 0x00 0x00 0x00 0x01 0x00 0x00 0x6c 0x01 0x01 0x00 0x00 0x00 0x00 0x6d 0x00 0x00 0x00 0x01 0x00 0x00 0x6e 0x00 0x00 0x00 0x01 0x00 0x00 0x6f 0x00 0x00 0x00 0x01 0x00 0x00 0x70 0x00 0x00 0x00 0x01 0x00 0x00 0x71 0x00 0x00 0x00 0x01 0x00 0x00 0x72 0x00 0x00 0x00 0x01 0x00 0x00 0x73 0x00 0x00 0x00 0x01 0x00 0x00 0x74 0x00 0x00 0x00 0x01 0x00 0x00 0x75 0x00 0x00 0x00 0x01 0x00 0x00 0x76 0x00 0x00 0x00 0x01 0x00 0x00 0x77 0x00 0x00 0x00 0x01 0x00 0x00 0x78 0x00 0x00 0x00 0x01 0x00 0x00 0x79 0x00 0x00 0x00 0x01 0x00 0x00 0x7a 0x01 0x00 0x00 0x01 0x01 0x01 0x7b 0x01 0x00 0x00 0x01 0x01 0x01 0x7c 0x01 0x01 0x00 0x00 0x00 0x01 0x7d 0x01 0x00 0x00 0x01 0x01 0x01 0x7e 0x01 0x00 0x00 0x01 0x01 0x01 0x7f 0x01 0x00 0x00 0x01 0x01 0x01 0x80 0x01 0x00 0x00 0x01 0x01 0x01 0x81 0x01 0x00 0x00 0x01 0x01 0x01 0x82 0x01 0x00 0x00 0x01 0x01 0x01 0x83 0x01 0x00 0x00 0x01 0x00 0x01 0x84 0x01 0x00 0x00 0x01 0x01 0x01 0x85 0x01 0x01 0x01 0x00 0x00 0x01 0x86 0x01 0x00 0x00 0x01 0x00 0x01 0x87 0x01 0x01 0x00 0x00 0x00 0x00 0x88 0x01 0x01 0x00 0x00 0x00 0x00 0x89 0x01 0x01 0x00 0x00 0x00 0x00 0x8a 0x01 0x01 0x00 0x00 0x00 0x00 0x8b 0x01 0x01 0x00 0x00 0x00 0x00 0x8c 0x01 0x00 0x00 0x01 0x00 0x00 0x8d 0x01 0x00 0x00 0x01 0x00 0x00 0x8e 0x01 0x00 0x00 0x01 0x00 0x00 0x8f 0x01 0x00 0x00 0x01 0x00 0x00 0x90 0x01 0x00 0x00 0x01 0x00 0x00 0x91 0x01 0x01 0x01 0x00 0x00 0x00 0x92 0x01 0x00 0x00 0x01 0x00 0x00 0x93 0x01 0x01 0x00 0x00 0x00 0x00 0x94 0x01 0x01 0x00 0x00 0x00 0x00 0x95 0x01 0x01 0x00 0x00 0x00 0x00 0x96 0x00 0x01 0x00 0x00 0x00 0x00 0x97 0x00 0x01 0x00 0x00 0x00 0x00 0x98 0x00 0x01 0x00 0x01 0x00 0x00 0x99 0x00 0x01 0x00 0x00 0x00 0x00 0x9a 0x00 0x01 0x00 0x01 0x00 0x00 0x9b 0x07 0x01 0x00 0x00 0x00 0x00 0x9c 0x07 0x00 0x00 0x01 0x00 0x00 0x9d 0x07 0x00 0x00 0x01 0x00 0x00 0x9e 0x07 0x00 0x00 0x01 0x00 0x00 0x9f 0x00 0x01 0x00 0x00 0x00 0x00 0xa0 0x00 0x01 0x00 0x00 0x00 0x00 0xa1 0x01 0x00 0x00 0x01 0x01 0x01 0xa2 0x01 0x00 0x00 0x01 0x01 0x01 0xa3 0x00 0x00 0x00 0x01 0x00 0x00 0xa4 0x00 0x00 0x00 0x01 0x00 0x00 0xa5 0x00 0x00 0x00 0x01 0x00 0x00 0xa6 0x00 0x00 0x00 0x01 0x00 0x00 0xa7 0x00 0x00 0x00 0x01 0x00 0x00 0xa8 0x00 0x00 0x00 0x01 0x01 0x00 0xa9 0x00 0x01 0x00 0x00 0x00 0x00 0xaa 0x00 0x01 0x00 0x00 0x00 0x00 0xab 0x00 0x00 0x00 0x01 0x00 0x00 0xac 0x00 0x01 0x01 0x00 0x00 0x00 0xad 0x00 0x01 0x01 0x00 0x00 0x00 0xae 0x00 0x01 0x00 0x00 0x00 0x00 0xaf 0x00 0x01 0x00 0x00 0x00 0x00 0xb0 0x00 0x01 0x00 0x00 0x00 0x00 0xb1 0x00 0x01 0x00 0x00 0x00 0x00 0xb2 0x00 0x01 0x00 0x00 0x00 0x00 0xb3 0x00 0x00 0x00 0x01 0x00 0x00>;
		};
	};

	fragment@68 {
		target = <0xffffffff>;

		__overlay__ {
			interrupt-parent = <0xffffffff>;
			interrupts = <0x00 0x02 0x00 0x00>;
			status = "okay";
		};
	};

	fragment@69 {
		target = <0xffffffff>;

		__overlay__ {
			interrupt-parent = <0xffffffff>;
			interrupts = <0x01 0x02 0x01 0x00>;
			status = "okay";
		};
	};

	fragment@70 {
		target = <0xffffffff>;

		__overlay__ {
			interrupt-parent = <0xffffffff>;
			interrupts = <0x07 0x08 0x07 0x00>;
			status = "okay";
		};
	};

	fragment@71 {
		target = <0xffffffff>;

		__overlay__ {
			interrupt-parent = <0xffffffff>;
			interrupts = <0x09 0x08 0x09 0x00>;
			deb-gpios = <0xffffffff 0x09 0x00>;
			debounce = <0x3e800>;
			status = "okay";
		};
	};

	fragment@72 {
		target = <0xffffffff>;

		__overlay__ {
			interrupt-parent = <0xffffffff>;
			interrupts = <0x0a 0x04 0x0a 0x00>;
			status = "okay";
		};
	};

	fragment@73 {
		target = <0xffffffff>;

		__overlay__ {
			interrupt-parent = <0xffffffff>;
			interrupts = <0x0b 0x02 0x0b 0x00>;
			status = "okay";
		};
	};

	fragment@74 {
		target = <0xffffffff>;

		__overlay__ {
			interrupt-parent = <0xffffffff>;
			interrupts = <0x17 0x08 0x17 0x00>;
			status = "okay";
		};
	};

	fragment@75 {
		target = <0xffffffff>;

		__overlay__ {
			interrupt-parent = <0xffffffff>;
			interrupts = <0x2c 0x01 0x2c 0x01>;
			status = "okay";
		};
	};

	fragment@76 {
		target = <0xffffffff>;

		__overlay__ {
			interrupt-parent = <0xffffffff>;
			interrupts = <0x90 0x04 0x90 0x01>;
			status = "okay";
		};
	};

	fragment@77 {
		target = <0xffffffff>;

		__overlay__ {
			interrupt-parent = <0xffffffff>;
			interrupts = <0x93 0x08 0x29 0x01>;
			deb-gpios = <0xffffffff 0x29 0x00>;
			debounce = <0x7d00>;
			status = "okay";
		};
	};

	fragment@78 {
		target = <0xffffffff>;

		__overlay__ {
			compatible = "mediatek,md1_sim1_hot_plug_eint-eint";
			interrupts = <0x00 0x08>;
			debounce = <0x00 0x2710>;
			dedicated = <0x00 0x00>;
			src_pin = <0x00 0x01>;
			sockettype = <0x00 0x00>;
			status = "okay";
		};
	};

	fragment@79 {
		target = <0xffffffff>;

		__overlay__ {
			compatible = "mediatek,md1_sim2_hot_plug_eint-eint";
			interrupts = <0x01 0x08>;
			debounce = <0x01 0x2710>;
			dedicated = <0x01 0x00>;
			src_pin = <0x01 0x02>;
			sockettype = <0x01 0x00>;
			status = "okay";
		};
	};

	fragment@80 {
		target = <0xffffffff>;

		__overlay__ {
			regulator-name = "vcama";
			regulator-default-on = <0x01>;
			status = "okay";
		};
	};

	fragment@81 {
		target = <0xffffffff>;

		__overlay__ {
			regulator-name = "vsim1";
			regulator-default-on = <0x01>;
			status = "okay";
		};
	};

	fragment@82 {
		target = <0xffffffff>;

		__overlay__ {
			regulator-name = "vsim2";
			regulator-default-on = <0x01>;
			status = "okay";
		};
	};

	fragment@83 {
		target = <0xffffffff>;

		__overlay__ {
			regulator-name = "vcamd";
			regulator-default-on = <0x01>;
			status = "okay";
		};
	};

	fragment@84 {
		target = <0xffffffff>;

		__overlay__ {
			regulator-name = "vcamio";
			regulator-default-on = <0x01>;
			status = "okay";
		};
	};

	fragment@85 {
		target = <0xffffffff>;

		__overlay__ {
			regulator-name = "vldo28";
			regulator-default-on = <0x01>;
			status = "okay";
		};
	};

	fragment@86 {
		target = <0xffffffff>;

		__overlay__ {
			status = "okay";
		};
	};

	fragment@87 {
		target = <0xffffffff>;

		__overlay__ {
			vtouch-supply = <0xffffffff>;
			status = "okay";
		};
	};

	fragment@88 {
		target = <0xffffffff>;

		__overlay__ {
			mediatek,kpd-key-debounce = <0x400>;
			mediatek,kpd-sw-pwrkey = <0x74>;
			mediatek,kpd-hw-pwrkey = <0x08>;
			mediatek,kpd-sw-rstkey = <0x73>;
			mediatek,kpd-hw-rstkey = <0x11>;
			mediatek,kpd-use-extend-type = <0x00>;
			mediatek,kpd-hw-map-num = <0x48>;
			mediatek,kpd-hw-init-map = <0x00 0x72 0x00 0x00 0x00 0x00 0x00 0x00 0x00 0x00 0x00 0x00 0x00 0x00 0x00 0x00 0x00 0x00 0x00 0x00 0x00 0x00 0x00 0x00 0x00 0x00 0x00 0x00 0x00 0x00 0x00 0x00 0x00 0x00 0x00 0x00 0x00 0x00 0x00 0x00 0x00 0x00 0x00 0x00 0x00 0x00 0x00 0x00 0x00 0x00 0x00 0x00 0x00 0x00 0x00 0x00 0x00 0x00 0x00 0x00 0x00 0x00 0x00 0x00 0x00 0x00 0x00 0x00 0x00 0x00 0x00 0x00>;
			mediatek,kpd-pwrkey-eint-gpio = <0x00>;
			mediatek,kpd-pwkey-gpio-din = <0x00>;
			mediatek,kpd-hw-dl-key0 = <0x11>;
			mediatek,kpd-hw-dl-key2 = <0x08>;
			mediatek,kpd-hw-recovery-key = <0x11>;
			mediatek,kpd-hw-factory-key = <0x01>;
			status = "okay";
		};
	};

	fragment@89 {
		target = <0xffffffff>;

		__overlay__ {
			clock-frequency = <0x61a80>;
		};
	};

	__symbols__ {
		ant_pins_all_default = "/fragment@2/__overlay__/ant_pins_all_default";
		ant_pins_id0_default = "/fragment@2/__overlay__/ant_pins_id0_default";
		ant_pins_id0_bias_up = "/fragment@2/__overlay__/ant_pins_id0_bias_up";
		ant_pins_id0_bias_down = "/fragment@2/__overlay__/ant_pins_id0_bias_down";
		ant_pins_id1_default = "/fragment@2/__overlay__/ant_pins_id1_default";
		ant_pins_id1_bias_up = "/fragment@2/__overlay__/ant_pins_id1_bias_up";
		ant_pins_id1_bias_down = "/fragment@2/__overlay__/ant_pins_id1_bias_down";
		ant_pins_id2_default = "/fragment@2/__overlay__/ant_pins_id2_default";
		ant_pins_id2_bias_up = "/fragment@2/__overlay__/ant_pins_id2_bias_up";
		ant_pins_id2_bias_down = "/fragment@2/__overlay__/ant_pins_id2_bias_down";
		ant_cable_det_default = "/fragment@4/__overlay__/ant_cable_det_default";
		ant_cable_det_idle = "/fragment@4/__overlay__/ant_cable_det_idle";
		led0 = "/fragment@5/__overlay__/led@0";
		led1 = "/fragment@5/__overlay__/led@1";
		led2 = "/fragment@5/__overlay__/led@2";
		led3 = "/fragment@5/__overlay__/led@3";
		led4 = "/fragment@5/__overlay__/led@4";
		led5 = "/fragment@5/__overlay__/led@5";
		led6 = "/fragment@5/__overlay__/led@6";
		vibrator0 = "/fragment@5/__overlay__/vibrator@0";
		ctp_pins_default = "/fragment@7/__overlay__/eint0default";
		ctp_pins_eint_as_int = "/fragment@7/__overlay__/eint@0";
		ctp_pins_eint_output0 = "/fragment@7/__overlay__/eintoutput0";
		ctp_pins_eint_output1 = "/fragment@7/__overlay__/eintoutput1";
		ctp_pins_rst_output0 = "/fragment@7/__overlay__/rstoutput0";
		ctp_pins_rst_output1 = "/fragment@7/__overlay__/rstoutput1";
		ctp_pins_cs_output0 = "/fragment@7/__overlay__/csoutput0";
		ctp_pins_cs_output1 = "/fragment@7/__overlay__/csoutput1";
		ctp_pins_spi_status = "/fragment@7/__overlay__/spistatus";
		sgm7220 = "/fragment@9/__overlay__/sgm7220@47";
		wusb3801x = "/fragment@9/__overlay__/wusb3801x@60";
		sy6974 = "/fragment@10/__overlay__/sy6974@6B";
		fingerprint_spi_default = "/fragment@19/__overlay__/fingerprint_spi_default";
		fingerprint_spi_cs_low = "/fragment@19/__overlay__/fingerprint_spi_cs_low";
		fingerprint_spi_cs_high = "/fragment@19/__overlay__/fingerprint_spi_cs_high";
		fingerprint_spi_miso_low = "/fragment@19/__overlay__/fingerprint_spi_miso_low";
		fingerprint_spi_miso_high = "/fragment@19/__overlay__/fingerprint_spi_miso_high";
		fingerprint_spi_mosi_low = "/fragment@19/__overlay__/fingerprint_spi_mosi_low";
		fingerprint_spi_mosi_high = "/fragment@19/__overlay__/fingerprint_spi_mosi_high";
		fingerprint_spi_mclk_low = "/fragment@19/__overlay__/fingerprint_spi_mclk_low";
		fingerprint_spi_mclk_high = "/fragment@19/__overlay__/fingerprint_spi_mclk_high";
		fingerprint_rst_low = "/fragment@19/__overlay__/fingerprint_rst_low";
		fingerprint_rst_high = "/fragment@19/__overlay__/fingerprint_rst_high";
		fingerprint_power_low = "/fragment@19/__overlay__/fingerprint_power_low";
		fingerprint_power_high = "/fragment@19/__overlay__/fingerprint_power_high";
		fingerprint_eint_as_int = "/fragment@19/__overlay__/fingerprint_eint_as_int";
		fingerprint_eint_in_low = "/fragment@19/__overlay__/fingerprint_eint_in_low";
		fingerprint_eint_in_float = "/fragment@19/__overlay__/fingerprint_eint_in_float";
		dsi_pkn_auo_otm1901a_5p2_1080p_video_default = "/fragment@21/__overlay__/lcd_kit_pkn_auo_otm1901a_5p2_1080p_video_default";
		dsi_pkn_hlt_icnl9911c_6p517 = "/fragment@22/__overlay__/lcd_kit_pkn_hlt_icnl9911c_6p517";
		dsi_pkn_tcl_ft8756_6p517 = "/fragment@23/__overlay__/lcd_kit_pkn_tcl_ft8756_6p517";
		mtkfb_pins_lcm_reset0 = "/fragment@25/__overlay__/lcm_rst_out0_gpio";
		mtkfb_pins_lcm_reset1 = "/fragment@25/__overlay__/lcm_rst_out1_gpio";
		consys_pins_default = "/fragment@28/__overlay__/consys_default";
		gpslna_pins_init = "/fragment@28/__overlay__/gpslna@0";
		gpslna_pins_oh = "/fragment@28/__overlay__/gpslna@1";
		gpslna_pins_ol = "/fragment@28/__overlay__/gpslna@2";
		aud_clk_mosi_off = "/fragment@35/__overlay__/aud_clk_mosi_off";
		aud_clk_mosi_on = "/fragment@35/__overlay__/aud_clk_mosi_on";
		aud_clk_miso_off = "/fragment@35/__overlay__/aud_clk_miso_off";
		aud_clk_miso_on = "/fragment@35/__overlay__/aud_clk_miso_on";
		aud_dat_mosi_off = "/fragment@35/__overlay__/aud_dat_mosi_off";
		aud_dat_mosi_on = "/fragment@35/__overlay__/aud_dat_mosi_on";
		aud_dat_miso_off = "/fragment@35/__overlay__/aud_dat_miso_off";
		aud_dat_miso_on = "/fragment@35/__overlay__/aud_dat_miso_on";
		aud_switch_en_high = "/fragment@35/__overlay__/aud_switch_en_high";
		aud_switch_en_low = "/fragment@35/__overlay__/aud_switch_en_low";
		aud_rcv_en_high = "/fragment@35/__overlay__/aud_rcv_en_high";
		aud_rcv_en_low = "/fragment@35/__overlay__/aud_rcv_en_low";
		accdet_pins_default = "/fragment@39/__overlay__/accdetdefault";
		accdet_pins_eint_as_int = "/fragment@39/__overlay__/accdeteint@0";
		camera_main_mtk = "/fragment@44/__overlay__/camera_main@10";
		camera_main_eeprom_mtk = "/fragment@44/__overlay__/camera_main_eeprom@50";
		camera_main_af_mtk = "/fragment@44/__overlay__/camera_main_af@0c";
		camera_sub_mtk = "/fragment@45/__overlay__/camera_sub@36";
		camera_sub_eeprom_mtk = "/fragment@45/__overlay__/camera_sub_eeprom@52";
		camera_main_two_mtk = "/fragment@45/__overlay__/camera_main_two@17";
		camera_main_two_eeprom_mtk = "/fragment@45/__overlay__/camera_main_two_eeprom@50";
		camera_sub_two_mtk = "/fragment@45/__overlay__/camera_sub_two@22";
		camera_sub_two_eeprom_mtk = "/fragment@45/__overlay__/camera_sub_two_eeprom@55";
		camera_pins_cam0_mclk_on = "/fragment@46/__overlay__/camera_pins_cam0_mclk_on";
		camera_pins_cam0_mclk_off = "/fragment@46/__overlay__/camera_pins_cam0_mclk_off";
		camera_pins_cam1_mclk_on = "/fragment@46/__overlay__/camera_pins_cam1_mclk_on";
		camera_pins_cam1_mclk_off = "/fragment@46/__overlay__/camera_pins_cam1_mclk_off";
		camera_pins_cam2_mclk_on = "/fragment@46/__overlay__/camera_pins_cam2_mclk_on";
		camera_pins_cam2_mclk_off = "/fragment@46/__overlay__/camera_pins_cam2_mclk_off";
		camera_pins_cam0_rst0 = "/fragment@46/__overlay__/cam0@0";
		camera_pins_cam0_rst1 = "/fragment@46/__overlay__/cam0@1";
		camera_pins_cam0_pnd0 = "/fragment@46/__overlay__/cam0@2";
		camera_pins_cam0_pnd1 = "/fragment@46/__overlay__/cam0@3";
		camera_pins_cam1_rst0 = "/fragment@46/__overlay__/cam1@0";
		camera_pins_cam1_rst1 = "/fragment@46/__overlay__/cam1@1";
		camera_pins_cam1_pnd0 = "/fragment@46/__overlay__/cam1@2";
		camera_pins_cam1_pnd1 = "/fragment@46/__overlay__/cam1@3";
		camera_pins_cam2_rst0 = "/fragment@46/__overlay__/cam2@0";
		camera_pins_cam2_rst1 = "/fragment@46/__overlay__/cam2@1";
		camera_pins_cam2_pnd0 = "/fragment@46/__overlay__/cam2@2";
		camera_pins_cam2_pnd1 = "/fragment@46/__overlay__/cam2@3";
		camera_pins_cam_ldo_rear2_vcama_0 = "/fragment@46/__overlay__/cam2@vcama0";
		camera_pins_cam_ldo_rear2_vcama_1 = "/fragment@46/__overlay__/cam2@vcama1";
		camera_pins_default = "/fragment@46/__overlay__/camdefault";
		flashlights_aw36514_pins_default = "/fragment@48/__overlay__/default";
		flashlights_aw36514_pins_hwen_high = "/fragment@48/__overlay__/hwen_high";
		flashlights_aw36514_pins_hwen_low = "/fragment@48/__overlay__/hwen_low";
		flashlights_aw36514_pins_strobe_high = "/fragment@48/__overlay__/strobe_high";
		flashlights_aw36514_pins_strobe_low = "/fragment@48/__overlay__/strobe_low";
		cap_touch_mtk = "/fragment@56/__overlay__/cap_touch@5d";
		speaker_amp_mtk = "/fragment@59/__overlay__/speaker_amp@34";
		slave_charger_mtk = "/fragment@59/__overlay__/slave_charger@4b";
		nfc_mtk = "/fragment@59/__overlay__/nfc@08";
		ext_buck_lp4_mtk = "/fragment@59/__overlay__/ext_buck_lp4@57";
		ext_buck_lp4x_mtk = "/fragment@59/__overlay__/ext_buck_lp4x@50";
		subpmic_pmu_mtk = "/fragment@61/__overlay__/subpmic_pmu@34";
		usb_type_c_mtk = "/fragment@61/__overlay__/usb_type_c@4e";
		ext_buck_vgpu_mtk = "/fragment@62/__overlay__/ext_buck_vgpu@55";
	};

	__fixups__ {
		dev_detect = "/fragment@0:target:0";
		antenna_boardid_detect = "/fragment@1:target:0\0/fragment@53:target:0";
		pio = "/fragment@2:target:0\0/fragment@4:target:0\0/fragment@7:target:0\0/fragment@8/__overlay__:interrupt-parent:0\0/fragment@8/__overlay__:cs_gpio:0\0/fragment@9/__overlay__/sgm7220@47:sgm7220,irq_gpio:0\0/fragment@9/__overlay__/wusb3801x@60:wusb3801,irq-gpio:0\0/fragment@10/__overlay__/sgm41511h@6B:gpio_int:0\0/fragment@10/__overlay__/sgm41511h@6B:gpio_cd:0\0/fragment@16/__overlay__:interrupt-parent:0\0/fragment@18/__overlay__/fingerprint_sensor@0:interrupt-parent:0\0/fragment@18/__overlay__/fingerprint_sensor@0:fingerprint_eint_gpio:0\0/fragment@19:target:0\0/fragment@25:target:0\0/fragment@28:target:0\0/fragment@35:target:0\0/fragment@36/__overlay__:simple-pa-gpio-enale:0\0/fragment@39:target:0\0/fragment@41/__overlay__:fm,fm_elna_pins:0\0/fragment@46:target:0\0/fragment@48:target:0\0/fragment@51/__overlay__:psensor,ldo_ven:0\0/fragment@66/__overlay__:GPIO_SIM2_SIO:0\0/fragment@66/__overlay__:GPIO_SIM2_SRST:0\0/fragment@66/__overlay__:GPIO_SIM2_SCLK:0\0/fragment@66/__overlay__:GPIO_SIM1_SCLK:0\0/fragment@66/__overlay__:GPIO_SIM1_SRST:0\0/fragment@66/__overlay__:GPIO_SIM1_SIO:0\0/fragment@66/__overlay__:GPIO_SIM2_HOT_PLUG:0\0/fragment@66/__overlay__:GPIO_SIM1_HOT_PLUG:0\0/fragment@66/__overlay__:GPIO_FDD_BAND_SUPPORT_DETECT_4TH_PIN:0\0/fragment@66/__overlay__:GPIO_FDD_BAND_SUPPORT_DETECT_3RD_PIN:0\0/fragment@66/__overlay__:GPIO_FDD_BAND_SUPPORT_DETECT_2ND_PIN:0\0/fragment@66/__overlay__:GPIO_FDD_BAND_SUPPORT_DETECT_1ST_PIN:0\0/fragment@66/__overlay__:GPIO_FDD_BAND_SUPPORT_DETECT_5TH_PIN:0\0/fragment@68/__overlay__:interrupt-parent:0\0/fragment@69/__overlay__:interrupt-parent:0\0/fragment@70/__overlay__:interrupt-parent:0\0/fragment@71/__overlay__:interrupt-parent:0\0/fragment@71/__overlay__:deb-gpios:0\0/fragment@72/__overlay__:interrupt-parent:0\0/fragment@73/__overlay__:interrupt-parent:0\0/fragment@74/__overlay__:interrupt-parent:0\0/fragment@75/__overlay__:interrupt-parent:0\0/fragment@76/__overlay__:interrupt-parent:0\0/fragment@77/__overlay__:interrupt-parent:0\0/fragment@77/__overlay__:deb-gpios:0";
		antenna_cable_detect = "/fragment@3:target:0";
		odm = "/fragment@5:target:0";
		mt6370_pmu = "/fragment@6:target:0\0/fragment@15:target:0";
		ts_kit = "/fragment@8:target:0";
		i2c0 = "/fragment@9:target:0\0/fragment@43:target:0\0/fragment@56:target:0";
		i2c5 = "/fragment@10:target:0\0/fragment@61:target:0\0/fragment@89:target:0";
		charger = "/fragment@11:target:0";
		huawei_charger = "/fragment@12:target:0";
		huawei_battery = "/fragment@13:target:0";
		lk_charger = "/fragment@14:target:0";
		otg_iddig = "/fragment@16:target:0\0/fragment@77:target:0";
		bat_gm30 = "/fragment@17:target:0";
		spi0 = "/fragment@18:target:0";
		huawei_wifi_info = "/fragment@20:target:0";
		huawei_lcd_config = "/fragment@21:target:0\0/fragment@22:target:0\0/fragment@23:target:0";
		huawei_lcd_panel = "/fragment@24:target:0";
		mtkfb = "/fragment@26:target:0";
		i2c6 = "/fragment@27:target:0\0/fragment@62:target:0";
		consys = "/fragment@29:target:0";
		huawei_scp_info = "/fragment@30:target:0";
		hisi_shell = "/fragment@31:target:0";
		shell_front = "/fragment@32:target:0";
		shell_back = "/fragment@33:target:0";
		audgpio = "/fragment@34:target:0";
		mt_soc_codec_name = "/fragment@36:target:0";
		audio_hw_config = "/fragment@37:target:0";
		accdet = "/fragment@38:target:0\0/fragment@71:target:0";
		smartpakit = "/fragment@40:target:0";
		huawei_fm_info = "/fragment@41:target:0";
		mt_pmic_vldo28_ldo_reg = "/fragment@42:target:0\0/fragment@47/__overlay__:cam0_vcamaf-supply:0\0/fragment@85:target:0\0/fragment@87/__overlay__:vtouch-supply:0";
		i2c2 = "/fragment@44:target:0\0/fragment@58:target:0";
		i2c4 = "/fragment@45:target:0\0/fragment@60:target:0";
		kd_camera_hw1 = "/fragment@47:target:0\0/fragment@86:target:0";
		mt_pmic_vcama_ldo_reg = "/fragment@47/__overlay__:cam0_vcama-supply:0\0/fragment@47/__overlay__:cam1_vcama-supply:0\0/fragment@47/__overlay__:cam2_vcama-supply:0\0/fragment@80:target:0";
		mt_pmic_vcamd_ldo_reg = "/fragment@47/__overlay__:cam0_vcamd-supply:0\0/fragment@47/__overlay__:cam1_vcamd-supply:0\0/fragment@83:target:0";
		mt_pmic_vcamio_ldo_reg = "/fragment@47/__overlay__:cam0_vcamio-supply:0\0/fragment@47/__overlay__:cam1_vcamio-supply:0\0/fragment@47/__overlay__:cam2_vcamio-supply:0\0/fragment@84:target:0";
		flashlights_aw36514 = "/fragment@49:target:0";
		product_name_camera = "/fragment@50:target:0";
		psensor_enable = "/fragment@51:target:0";
		rootparam = "/fragment@52:target:0";
		auxadc = "/fragment@54:target:0";
		pmic_clock_buffer_ctrl = "/fragment@55:target:0";
		i2c1 = "/fragment@57:target:0";
		i2c3 = "/fragment@59:target:0";
		i2c7 = "/fragment@63:target:0";
		i2c8 = "/fragment@64:target:0";
		i2c9 = "/fragment@65:target:0";
		gpio_usage_mapping = "/fragment@66:target:0";
		gpio = "/fragment@67:target:0";
		touch = "/fragment@68:target:0\0/fragment@87:target:0";
		msdc1_ins = "/fragment@69:target:0";
		smart_pa = "/fragment@70:target:0";
		irq_nfc = "/fragment@72:target:0";
		subpmic_pmu_eint = "/fragment@73:target:0";
		rt9465_slave_chr = "/fragment@74:target:0";
		dsi_te = "/fragment@75:target:0";
		main_pmic = "/fragment@76:target:0";
		md1_sim1_hot_plug_eint = "/fragment@78:target:0";
		md1_sim2_hot_plug_eint = "/fragment@79:target:0";
		mt_pmic_vsim1_ldo_reg = "/fragment@81:target:0";
		mt_pmic_vsim2_ldo_reg = "/fragment@82:target:0";
		keypad = "/fragment@88:target:0";
	};

	__local_fixups__ {

		fragment@1 {

			__overlay__ {
				pinctrl-0 = <0x00>;
				pinctrl-1 = <0x00>;
				pinctrl-2 = <0x00>;
				pinctrl-3 = <0x00>;
				pinctrl-4 = <0x00>;
				pinctrl-5 = <0x00>;
				pinctrl-6 = <0x00>;
				pinctrl-7 = <0x00>;
				pinctrl-8 = <0x00>;
				pinctrl-9 = <0x00>;
			};
		};

		fragment@3 {

			__overlay__ {
				pinctrl-0 = <0x00>;
				pinctrl-1 = <0x00>;
			};
		};

		fragment@8 {

			__overlay__ {

				node1 {
					pinctrl-0 = <0x00 0x04>;
					pinctrl-1 = <0x00 0x04>;
					pinctrl-2 = <0x00>;
					pinctrl-3 = <0x00>;
					pinctrl-4 = <0x00>;
					pinctrl-5 = <0x00>;
					pinctrl-6 = <0x00>;
					pinctrl-7 = <0x00>;
					pinctrl-8 = <0x00>;
				};

				node2 {
					pinctrl-0 = <0x00 0x04>;
					pinctrl-1 = <0x00 0x04>;
					pinctrl-2 = <0x00>;
					pinctrl-3 = <0x00>;
					pinctrl-4 = <0x00>;
					pinctrl-5 = <0x00>;
					pinctrl-6 = <0x00>;
					pinctrl-7 = <0x00>;
					pinctrl-8 = <0x00>;
				};
			};
		};

		fragment@18 {

			__overlay__ {

				fingerprint_sensor@0 {
					pinctrl-0 = <0x00>;
					pinctrl-1 = <0x00>;
					pinctrl-2 = <0x00>;
					pinctrl-3 = <0x00>;
					pinctrl-4 = <0x00>;
					pinctrl-5 = <0x00>;
					pinctrl-6 = <0x00>;
					pinctrl-7 = <0x00>;
					pinctrl-8 = <0x00>;
					pinctrl-9 = <0x00>;
					pinctrl-10 = <0x00>;
					pinctrl-11 = <0x00>;
					pinctrl-12 = <0x00>;
					pinctrl-13 = <0x00>;
					pinctrl-14 = <0x00>;
					pinctrl-15 = <0x00>;
				};
			};
		};

		fragment@26 {

			__overlay__ {
				pinctrl-0 = <0x00>;
				pinctrl-1 = <0x00>;
			};
		};

		fragment@29 {

			__overlay__ {
				pinctrl-0 = <0x00>;
				pinctrl-1 = <0x00>;
				pinctrl-2 = <0x00>;
				pinctrl-3 = <0x00>;
			};
		};

		fragment@34 {

			__overlay__ {
				pinctrl-0 = <0x00>;
				pinctrl-1 = <0x00>;
				pinctrl-2 = <0x00>;
				pinctrl-3 = <0x00>;
				pinctrl-4 = <0x00>;
				pinctrl-5 = <0x00>;
				pinctrl-6 = <0x00>;
				pinctrl-7 = <0x00>;
				pinctrl-8 = <0x00>;
				pinctrl-9 = <0x00>;
				pinctrl-10 = <0x00>;
				pinctrl-11 = <0x00>;
			};
		};

		fragment@38 {

			__overlay__ {
				pinctrl-0 = <0x00>;
				pinctrl-1 = <0x00>;
			};
		};

		fragment@47 {

			__overlay__ {
				pinctrl-0 = <0x00>;
				pinctrl-1 = <0x00>;
				pinctrl-2 = <0x00>;
				pinctrl-3 = <0x00>;
				pinctrl-4 = <0x00>;
				pinctrl-5 = <0x00>;
				pinctrl-6 = <0x00>;
				pinctrl-7 = <0x00>;
				pinctrl-8 = <0x00>;
				pinctrl-9 = <0x00>;
				pinctrl-10 = <0x00>;
				pinctrl-11 = <0x00>;
				pinctrl-12 = <0x00>;
				pinctrl-13 = <0x00>;
				pinctrl-14 = <0x00>;
				pinctrl-15 = <0x00>;
				pinctrl-16 = <0x00>;
			};
		};

		fragment@49 {

			__overlay__ {
				pinctrl-0 = <0x00>;
				pinctrl-1 = <0x00>;
				pinctrl-2 = <0x00>;
				pinctrl-3 = <0x00>;
				pinctrl-4 = <0x00>;
			};
		};
	};
};
